/* Generated by scripts/bench/hot-text/run.sh from 26 workload
   profiles; see scripts/bench/hot-text/hot_text.py. Do not edit. */
SECTIONS
{
  .text.hot :
  {
    *(.text*._RNvNtCs*_8clj_eval9core_lazy9skip_form*)
    *(.text*._RNvMs*_NtCs*_8clj_eval3envNtB*_17NamespaceRegistry21resolve_target_and_id*)
    *(.text*._RNvXs*_Cs*_10clojure_rsNtB*_3CliNtNtCs*_12clap_builder6derive14CommandFactory7command*)
    *(.text*._RINvMs*_NtNtCs*_12clap_builder7builder3argNtB*_3Arg12value_parserNtNtB*_12value_parser11ValueParserECs*_10clojure_rs*)
    *(.text*._RINvMNtNtCs*_12clap_builder7builder7commandNtB*_7Command3argNtNtB*_3arg3ArgEB*_*)
    *(.text*._RNvXs*_NtCs*_5alloc6stringNtB*_6StringNtNtCs*_4core3fmt5Write9write_str.541*)
    *(.text*._RNvMNtNtNtCs*_12clap_builder6parser7matches11matched_argNtB*_10MatchedArg13new_val_group*)
    *(.text*._RINvNtCs*_4core3ptr9drop_glueINtNtB*_6option6OptionINtNtNtCs*_5alloc3vec9into_iter8IntoIterNtNtNtCs*_12clap_builder4util9any_value8AnyValueEEECs*_10clojure_rs*)
    *(.text*._RNvNtNtCs*_4core5slice6memchr15memrchr_aligned*)
    *(.text*._RNCINvMs*_NtNtCs*_3std4sync4onceNtB*_4Once15call_once_forceNCINvMNtB*_9once_lockINtB*_8OnceLockINtNtNtNtB*_11collections4hash3map7HashMapReRNtNtCs*_8clj_eval8classemu9StaticRowEE10initializeNCINvB*_11get_or_initNCNvB*_10static_row0E0zE0E0B*_*)
    *(.text*._RNvXs*_NtNtCs*_4core4hash3sipINtB*_6HasherNtB*_11Sip13RoundsENtB*_6Hasher5writeCs*_9clj_value*)
    *(.text*._RINvMs*_NtCs*_9hashbrown3rawINtB*_8RawTableTNtNtCs*_5alloc6string6StringNtNtCs*_8clj_eval3env9NamespaceEE14reserve_rehashNCINvNtB*_3map11make_hasherB*_B*_INtNtCs*_4core4hash18BuildHasherDefaultNtCs*_10rustc_hash8FxHasherEE0EB*_*)
    *(.text*._RINvMs*_NtCs*_9hashbrown3mapINtB*_7HashMapNtNtCs*_5alloc6string6StringNtNtCs*_8clj_eval3env9NamespaceINtNtCs*_4core4hash18BuildHasherDefaultNtCs*_10rustc_hash8FxHasherEE7get_muteEB*_*)
    *(.text*._RNvXs*_NtNtNtCs*_4core4iter8adapters5chainINtB*_5ChainIB*_IB*_IB*_IB*_IB*_IB*_IB*_IB*_IB*_IB*_IB*_IB*_IB*_IB*_IB*_IB*_IB*_IB*_INtNtNtB*_5slice4iter4IterTReFG0_QL1_NtNtCs*_8clj_eval4eval9EvaluatorRL0_SNtNtCs*_9clj_value5value5ValueEINtNtB*_6result6ResultB*_NtNtB*_5error11NativeErrorEEEB*_EB*_EB*_EB*_EB*_EB*_EB*_EB*_EB*_EB*_EB*_EB*_EB*_EB*_EB*_EB*_EB*_EB*_EB*_ENtNtNtB*_6traits8iterator8Iterator9size_hintB*_*)
    *(.text*._RNvXs*_NtNtNtCs*_4core4iter8adapters5chainINtB*_5ChainIB*_IB*_IB*_IB*_IB*_IB*_IB*_IB*_IB*_IB*_INtNtNtB*_5slice4iter4IterTReFG0_QL1_NtNtCs*_8clj_eval4eval9EvaluatorRL0_SNtNtCs*_9clj_value5value5ValueEINtNtB*_6result6ResultB*_NtNtB*_5error11NativeErrorEEEB*_EB*_EB*_EB*_EB*_EB*_EB*_EB*_EB*_EB*_EB*_ENtNtNtB*_6traits8iterator8Iterator9size_hintB*_*)
    *(.text*._RNvMs*_NtCs*_9clj_value7keywordNtB*_7Keyword3new*)
    *(.text*._RNvMs*_NtCs*_5alloc4syncINtB*_3ArcNtNtCs*_9clj_value5value7MapDataE8make_mutB*_*)
    *(.text*._RNvMs*_NtCs*_5alloc4syncINtB*_3ArcNtNtCs*_9clj_value5value8MapShapeE9drop_slowB*_*)
    *(.text*._RINvNtCs*_4core3ptr9drop_glueINtNtNtCs*_5alloc3vec9into_iter8IntoIterTNtNtB*_6string6StringNtNtCs*_9clj_value5value5ValuebbEEECs*_8clj_eval*)
    *(.text*._RNvNtCs*_9clj_value5value9seq_items*)
    *(.text*._RNvMs*_NtCs*_5alloc7raw_vecNtB*_11RawVecInner11finish_growCs*_9clj_value*)
    *(.text*._RINvNtCs*_4core3ptr9drop_glueINtNtNtCs*_5alloc3vec9into_iter8IntoIterTNtNtCs*_9clj_value5value5ValueB*_EEEB*_*)
    *(.text*._RNvMs*_NtCs*_9clj_value5valueNtB*_3Map6insert*)
    *(.text*._RINvMs*_NtCs*_9hashbrown3rawINtB*_8RawTableTyINtNtCs*_5alloc4sync3ArcNtNtCs*_8clj_eval3env12VarAlterLockEEE14reserve_rehashNCINvNtB*_3map11make_hasheryB*_INtNtCs*_4core4hash18BuildHasherDefaultNtCs*_10rustc_hash8FxHasherEE0EB*_*)
    *(.text*._RNvMs*_NtCs*_5alloc7raw_vecINtB*_6RawVecNtNtCs*_8clj_eval10w6_runtime8XmlEventE8grow_oneB*_*)
    *(.text*._RINvYNtNtNtCs*_3std4hash6random11RandomStateNtNtCs*_4core4hash11BuildHasher8hash_oneRjECs*_8clj_eval*)
    *(.text*._RNvMs*_NtCs*_5alloc7raw_vecNtB*_11RawVecInner11finish_growCs*_10num_bigint*)
    *(.text*._RNvMs*_NtCs*_5alloc4syncINtB*_3ArcNtNtCs*_8clj_eval9core_lazy9LazyGroupE9drop_slowB*_*)
    *(.text*._RINvMNtNtCs*_3std4sync9once_lockINtB*_8OnceLockNtNtCs*_8clj_eval9core_lazy9LazyIndexE10initializeNCINvB*_11get_or_initNCNvB*_10try_insert0E0zEB*_*)
    *(.text*._RNvXs*_NtCs*_5alloc6stringNtB*_6StringNtNtCs*_4core3fmt5Write9write_str.691*)
    *(.text*._RNvXs*_NtCs*_9clj_value4trieINtB*_10PackedIterxENtNtNtNtCs*_4core4iter6traits8iterator8Iterator4nextB*_*)
    *(.text*._RINvNvMs*_NtCs*_5alloc7raw_vecINtB*_11RawVecInnerpE7reserve21do_reserve_and_handleNtNtB*_5alloc6GlobalECs*_10clj_reader*)
    *(.text*._RNvNtCs*_8clj_eval4eval12split_top_do*)
    *(.text*._RNvMs*_NtCs*_8clj_eval4evalNtB*_9Evaluator7analyze*)
    *(.text*._RNvYNCNvMs*_NtCs*_4rpds4listINtB*_4ListNtNtCs*_9clj_value5value5ValueNtNtNtNtCs*_7archery14shared_pointer4kind4arct5ArcTKE4iter0INtNtNtCs*_4core3ops8function6FnOnceTRINtB*_13SharedPointerB*_B*_EEE9call_onceB*_*)
    *(.text*._RNvNtCs*_8clj_eval4expr10needs_eval*)
    *(.text*._RNvMs*_NtCs*_8clj_eval2vmNtB*_5Scope3new*)
    *(.text*._RINvNtCs*_4core3ptr9drop_glueNtNtCs*_8clj_eval2vm5ScopeEB*_*)
    *(.text*._RINvNtCs*_4core3ptr9drop_glueINtNtCs*_5alloc5boxed3BoxNtNtCs*_8clj_eval4expr4ExprEEB*_*)
    *(.text*._RINvNtCs*_4core3ptr9drop_glueNtCs*_10clj_reader6ReaderECs*_8clj_eval*)
    *(.text*._RINvNtCs*_4core3ptr9drop_glueINtNtB*_6option6OptionINtNtNtNtCs*_5alloc11collections5btree3map8BTreeMaplNtNtCs*_9clj_value6symbol6SymbolEEECs*_10clojure_rs*)
    *(.text*._RNvMs*_NtCs*_8clj_eval4exprNtB*_8Analyzer16direct_or_invoke*)
    *(.text*._RNvNtCs*_8clj_eval6vm_ops11update_ctor*)
    *(.text*._RNvMs*_NtCs*_8clj_eval2vmNtB*_7Operand4eval*)
    *(.text*._RNvNtCs*_8clj_eval2ns10strict_sym*)
    *(.text*._RNvNtCs*_8clj_eval2ns9opt_pairs*)
    *(.text*._RNvMCs*_10clj_readerNtB*_6Reader15wrapping_reader*)
    *(.text*._RNvNtCs*_8clj_eval6macros7expand1*)
    *(.text*._RNvNtCs*_9clj_value5print17print_meta_prefix*)
    *(.text*._RNvXs*_NtCs*_4core3fmtRNtNtCs*_9clj_value6symbol6SymbolNtB*_7Display3fmtB*_*)
    *(.text*._RNvXNtNtCs*_5alloc3vec21spec_from_iter_nestedINtB*_3VecNtNtCs*_9clj_value5value5ValueEINtB*_18SpecFromIterNestedB*_NtB*_10VectorIterE9from_iterCs*_8clj_eval*)
    *(.text*._RNvMs*_NtCs*_8clj_eval3envNtB*_14SharedRegistry19namespace_target_in*)
    *(.text*._RINvYNtNtNtCs*_3std4hash6random11RandomStateNtNtCs*_4core4hash11BuildHasher8hash_oneRINtNtCs*_5alloc4sync3ArceEECs*_9clj_value*)
    *(.text*._RNvMs*_NtCs*_8clj_eval2vmNtB*_8Compiler11compile_let*)
    *(.text*._RNvMs*_NtCs*_5alloc7raw_vecINtB*_6RawVecINtNtB*_4sync3ArceEE8grow_oneCs*_8clj_eval*)
    *(.text*._RNCNvMs*_NtCs*_8clj_eval2vmNtB*_8Compiler12compile_bodys*_0B*_*)
    *(.text*._RNvMs*_Cs*_8smallvecINtB*_8SmallVecANtNtCs*_9clj_value5value5Valuej4_E8try_growCs*_8clj_eval*)
    *(.text*._RNvNtCs*_8clj_eval4vars18push_checked_entry*)
    *(.text*._RNvMs*_NtCs*_8triomphe3arcINtB*_3ArcINtNtNtCs*_4rpds3map5entry5EntryNtNtCs*_9clj_value5value5ValueB*_EE9drop_slowB*_*)
    *(.text*._RNvNtCs*_8clj_eval2ns14native_require*)
    *(.text*._RNvNtCs*_8clj_eval2ns12ns_form_meta*)
    *(.text*._RNvNtCs*_8clj_eval8classemu12import_class*)
    *(.text*._RNvNtCs*_8clj_eval2ns11mark_member*)
    *(.text*._RNvNtCs*_8clj_eval4coll17native_conj_owned*)
    *(.text*._RNvMs*_NtNtNtCs*_5alloc11collections5btree3mapINtB*_8IntoIterTjNtNtB*_6string6StringERNtNtNtCs*_12clap_builder7builder3arg3ArgE10dying_nextB*_*)
    *(.text*._RINvNtCs*_4core3ptr9drop_glueNCNvMs*_NtCs*_8clj_eval2vmNtB*_8Compiler6escape0EB*_*)
    *(.text*._RINvNtCs*_8clj_eval4core13compare_namedNtNtCs*_9clj_value6symbol6SymbolB*_EB*_*)
    *(.text*._RNvNtCs*_8clj_eval2io14native_println*)
    *(.text*._RNvNtCs*_8clj_eval4lazy12realize_deep*)
    *(.text*._RNvNtCs*_8clj_eval2io12check_writer*)
    *(.text*._RNvNtCs*_8clj_eval8printsys21method_dispatch_value*)
    *(.text*._RNvNtCs*_8clj_eval8printsys14scalar_default*)
    *(.text*._RINvNtCs*_4core3ptr9drop_glueNCNvNtCs*_8clj_eval2vm6global0EB*_*)
    *(.text*._RINvNtCs*_4core3ptr9drop_glueNCNvMs*_NtCs*_8clj_eval2vmNtB*_8Compiler11compile_let0EB*_*)
    *(.text*._RNvNvNtNtNtNtCs*_3std3sys4args4unix3imp15ARGV_INIT_ARRAY12init_wrapper*)
    *(.text*._RNvMs*_NtCs*_5alloc7raw_vecINtB*_6RawVecNtNtNtCs*_12clap_builder7builder7command7CommandE8grow_oneB*_*)
    *(.text*._RNvXs*_NtCs*_3std4pathNtB*_10ComponentsNtNtNtNtCs*_4core4iter6traits12double_ended19DoubleEndedIterator9next_back*)
    *(.text*._RNvXs*_NtCs*_4core3fmtRNtNtCs*_5alloc6string6StringNtB*_7Display3fmtCs*_10clojure_rs*)
    *(.text*._RNvMNtNtCs*_12clap_builder6parser11arg_matcherNtB*_10ArgMatcher10add_val_to*)
    *(.text*._RNvXs*_NtNtCs*_12clap_builder7builder12value_parserNtB*_18PathBufValueParserNtB*_16TypedValueParser5parse*)
    *(.text*._RINvNtCs*_4core3ptr9drop_glueINtNtCs*_5alloc3vec3VecNtNtNtCs*_12clap_builder4util9any_value8AnyValueEECs*_10clojure_rs*)
    *(.text*._RINvMs*_NtNtNtCs*_12clap_builder6parser7matches11arg_matchesNtB*_10ArgMatches16try_remove_arg_tNtNtCs*_5alloc6string6StringECs*_10clojure_rs*)
    *(.text*._RNvNtNtCs*_3std3sys2fs8metadata*)
    *(.text*._RNvNtNtNtCs*_3std3sys6random5linux19hashmap_random_keys*)
    *(.text*._RNCINvMs*_NtNtCs*_3std4sync4onceNtB*_4Once15call_once_forceNCNvMNtB*_9lazy_lockINtB*_8LazyLockINtNtCs*_5alloc4sync3ArcINtNtNtNtB*_11collections4hash3map7HashMapNtNtB*_6string6StringB*_EEE5force0E0Cs*_8clj_eval*)
    *(.text*._RNvYNCNvNvNtCs*_8clj_eval8classemu18default_import_map3MAP0INtNtNtCs*_4core3ops8function6FnOnceuE9call_onceB*_*)
    *(.text*._RNvMs*_NtNtCs*_4core3str4iterINtB*_13SplitInternalcE9next_backCs*_10clojure_rs*)
    *(.text*._RNCINvMNtNtCs*_3std4sync9once_lockINtB*_8OnceLockINtNtNtNtB*_11collections4hash3map7HashMapReRNtNtCs*_8clj_eval8classemu9StaticRowEE10initializeNCINvB*_11get_or_initNCNvB*_10static_row0E0zE0B*_*)
    *(.text*._RNCINvMs*_NtNtCs*_3std4sync4onceNtB*_4Once15call_once_forceNCINvMNtB*_9once_lockINtB*_8OnceLockINtNtNtB*_6poison5mutex5MutexINtNtNtNtB*_11collections4hash3map7HashMapReINtNtCs*_5alloc4sync3ArcINtNtB*_3set7HashSetB*_EEEEE10initializeNCINvB*_11get_or_initNvYB*_NtNtCs*_4core7default7Default7defaultE0zE0E0Cs*_8clj_eval*)
    *(.text*._RNCINvMs*_NtNtCs*_3std4sync4onceNtB*_4Once15call_once_forceNCNvMNtB*_9lazy_lockINtB*_8LazyLockANtNtCs*_9clj_value5value5Valuej2_E5force0E0Cs*_8clj_eval*)
    *(.text*._RINvXs*_NtCs*_9clj_value5valueNtB*_5ValueNtNtCs*_4core4hash4Hash4hashNtCs*_10rustc_hash8FxHasherEB*_*)
    *(.text*._RINvYINtNtCs*_4core4hash18BuildHasherDefaultNtCs*_10rustc_hash8FxHasherENtB*_11BuildHasher8hash_oneRNtNtCs*_9clj_value6symbol6SymbolECs*_8clj_eval*)
    *(.text*._RNvMs*_NtCs*_9clj_value5valueNtB*_3Map10insert_mut*)
    *(.text*._RINvNtCs*_4core3ptr9drop_glueNtNtCs*_9clj_value5value5ValueEB*_*)
    *(.text*._RNvMs*_NtCs*_5alloc4syncINtB*_3ArcNtNtCs*_9clj_value5value8SmallMapE9drop_slowB*_*)
    *(.text*._RNvMs*_NtCs*_5alloc4syncINtB*_3ArcNtNtCs*_9clj_value6symbol10SymbolDataE9drop_slowB*_*)
    *(.text*._RNvMNtCs*_9clj_value8ref_kindNtB*_3Ref3new*)
    *(.text*._RNvNtCs*_9clj_value5value7new_map*)
    *(.text*._RNvMs*_NtCs*_9clj_value4trieINtB*_6PackedxE8from_vecB*_*)
    *(.text*._RNCINvMs*_NtNtCs*_3std4sync4onceNtB*_4Once15call_once_forceNCINvMNtB*_9once_lockINtB*_8OnceLockINtNtNtB*_6poison5mutex5MutexINtNtNtNtCs*_5alloc2io8buffered9bufreader9BufReaderNtNtNtB*_2io5stdio8StdinRawEEE10initializeNCINvB*_11get_or_initNCNvB*_5stdin0E0zE0E0B*_*)
    *(.text*._RNvMs*_NtCs*_8triomphe3arcINtB*_3ArcINtNtNtCs*_4rpds3map13hash_trie_map4NodeNtNtCs*_9clj_value5value5ValueB*_NtNtNtNtCs*_7archery14shared_pointer4kind4arct5ArcTKEE6as_ptrB*_*)
    *(.text*._RNvMs*_NtCs*_5alloc7raw_vecNtB*_11RawVecInner11finish_growCs*_8clj_eval*)
    *(.text*._RNvMs*_NtCs*_8clj_eval4evalNtB*_9Evaluator14read_next_live*)
    *(.text*._RNvMs*_NtCs*_9clj_value5valueNtB*_3Map4iter*)
    *(.text*._RINvXs*_NtCs*_9clj_value6symbolNtB*_6SymbolNtNtCs*_4core4hash4Hash4hashNtNtNtCs*_3std4hash6random13DefaultHasherEB*_*)
    *(.text*._RNvNtCs*_10clj_reader6symbol12match_symbol*)
    *(.text*._RNvMs*_NtCs*_9clj_value5valueNtB*_4List9with_meta*)
    *(.text*._RNvNtCs*_8clj_eval6macros16macroexpand_full*)
    *(.text*._RNvMs*_NtCs*_8clj_eval4exprNtB*_8Analyzer10current_ns*)
    *(.text*._RNvMs*_NtCs*_8clj_eval3envNtB*_14SharedRegistry9import_in*)
    *(.text*._RNvNtCs*_5alloc5boxed14box_new_uninit.661*)
    *(.text*._RNvMs*_NtCs*_8clj_eval3envNtB*_14SharedRegistry5ns_id*)
    *(.text*._RINvNtCs*_4core3ptr9drop_glueINtCs*_8smallvec8SmallVecANtNtCs*_9clj_value5value5Valuej8_EECs*_8clj_eval*)
    *(.text*._RINvNtCs*_4core3ptr9drop_glueNtNtCs*_8clj_eval4expr4ExprEB*_*)
    *(.text*._RNvMs*_NtCs*_8triomphe3arcINtB*_3ArcINtNtNtCs*_4rpds3map5entry5EntryNtNtCs*_9clj_value5value5ValueuEE9drop_slowB*_*)
    *(.text*._RNvMs*_NtCs*_5alloc4syncINtB*_3ArcNtNtCs*_9clj_value5value3MapE9drop_slowB*_*)
    *(.text*._RINvNtCs*_4core3ptr9drop_glueNtNtCs*_8clj_eval4eval9LiveFormsEB*_*)
    *(.text*._RNvMs*_NtCs*_8clj_eval4evalNtB*_9Evaluator16deref_var_cached*)
    *(.text*._RNvYFG_QL0_NtNtCs*_8clj_eval4eval9EvaluatorINtCs*_8smallvec8SmallVecANtNtCs*_9clj_value5value5Valuej4_EEINtNtCs*_4core6result6ResultB*_NtNtB*_5error11NativeErrorEINtNtNtB*_3ops8function2FnTQB*_B*_EE4callB*_*)
    *(.text*._RNvNtCs*_8clj_eval4lazy14collect_packed*)
    *(.text*._RINvXNtNtCs*_5alloc3vec14spec_from_elemNtNtCs*_9clj_value5value5ValueNtB*_12SpecFromElem9from_elemNtNtB*_5alloc6GlobalECs*_8clj_eval*)
    *(.text*._RINvNtCs*_4core3ptr9drop_glueNtNtCs*_9clj_value3seq11RepeatValueECs*_8clj_eval*)
    *(.text*._RINvNtCs*_4core3ptr9drop_glueSNtNtCs*_8clj_eval2vm7OperandEB*_*)
    *(.text*._RINvNtCs*_4core3ptr9drop_glueNCNvMs*_NtCs*_8clj_eval2vmNtB*_8Compiler17compile_data_forms*_0EB*_*)
    *(.text*._RNvNtCs*_8clj_eval6macros14is_private_var*)
    *(.text*._RINvMs*_NtCs*_5alloc3vecINtB*_3VecNtNtCs*_9clj_value5value5ValueE16extend_desugaredINtNtNtNtCs*_4core4iter8adapters6cloned6ClonedINtNtB*_4skip4SkipINtNtB*_3map3MapINtNtCs*_4rpds4list7IterPtrB*_NtNtNtNtCs*_7archery14shared_pointer4kind4arct5ArcTKEFG_RL0_INtB*_13SharedPointerB*_B*_EERL0_B*_EEEECs*_8clj_eval*)
    *(.text*._RNvMs*_NtCs*_8clj_eval4evalNtB*_9Evaluator4call*)
    *(.text*._RNvNtCs*_8clj_eval8fx4_form5qcall*)
    *(.text*._RNvMs*_NtCs*_8clj_eval4exprNtB*_8Analyzer9parse_let*)
    *(.text*._RNvMs*_NtCs*_8clj_eval4exprNtB*_8Analyzer12analyze_body*)
    *(.text*._RNvMs*_NtCs*_8clj_eval2vmNtB*_8Compiler11compile_try*)
    *(.text*._RINvNtCs*_4core3ptr9drop_glueINtNtCs*_5alloc3vec3VecINtNtB*_5boxed3BoxDG1_INtNtNtB*_3ops8function2FnTQL2_NtNtCs*_8clj_eval4eval9EvaluatorQL1_INtNtB*_2vm5FrameL0_EEEp6OutputINtNtB*_6result6ResultNtNtCs*_9clj_value5value5ValueNtNtB*_5error6SignalENtNtB*_6marker4SendNtB*_4SyncEL_EEEB*_*)
    *(.text*._RNvMs*_NtCs*_5alloc4syncINtB*_3ArcINtNtNtCs*_4rpds3map13hash_trie_map11HashTrieMapNtNtCs*_9clj_value5value5ValueB*_NtNtNtNtCs*_7archery14shared_pointer4kind4arct5ArcTKINtNtCs*_4core4hash18BuildHasherDefaultNtCs*_10rustc_hash8FxHasherEEE9drop_slowB*_*)
    *(.text*._RNvNtCs*_8clj_eval2ns14expand_libspec*)
    *(.text*._RNvXs*_NtCs*_9clj_value4trieNtB*_4IterNtNtNtNtCs*_4core4iter6traits8iterator8Iterator4nextB*_*)
    *(.text*._RNvMs*_NtCs*_9clj_value5valueNtB*_3Map16from_kvs_checked*)
    *(.text*._RNvNtCs*_8clj_eval2ns8ns_value*)
    *(.text*._RNvMs*_NtCs*_5alloc4syncINtB*_3ArcINtNtNtNtCs*_3std11collections4hash3map7HashMapNtNtB*_6string6StringIB*_NtNtCs*_9clj_value5class8ClassValEINtNtCs*_4core4hash18BuildHasherDefaultNtCs*_10rustc_hash8FxHasherEEE8make_mutCs*_8clj_eval*)
    *(.text*._RNvNtCs*_8clj_eval4coll8conj_one*)
    *(.text*._RNvMs*_NtNtCs*_5alloc11collections9vec_dequeINtB*_8VecDequeTyNtNtCs*_9clj_value5value5ValueEE4growCs*_8clj_eval*)
    *(.text*._RNvMs*_NtCs*_5alloc7raw_vecINtB*_6RawVecNtNtCs*_9clj_value4host10HostMethodE8grow_oneCs*_8clj_eval*)
    *(.text*._RINvNtCs*_4core3ptr9drop_glueINtNtCs*_5alloc3vec3VecNtNtCs*_8clj_eval4expr8NsClauseEEB*_*)
    *(.text*._RNvNtCs*_8clj_eval4core11jvm_compare*)
    *(.text*._RNvNtCs*_8clj_eval2ns10run_loaded*)
    *(.text*._RNvMs*_NtCs*_5alloc4syncINtB*_3ArcNtNtCs*_9clj_value5value10VectorDataE9drop_slowB*_*)
    *(.text*._RNvXs*_NtNtNtCs*_4core3fmt3num3impxNtB*_7Display3fmt*)
    *(.text*._RNvMs*_NtCs*_8clj_eval4evalNtB*_9Evaluator13join_drainers*)
    *(.text*._RNCINvMs*_NtNtCs*_3std4sync4onceNtB*_4Once9call_onceNCNvNtB*_2rt7cleanup0E0B*_*)
    *(.text*._RINvNvMs*_NtCs*_5alloc7raw_vecINtB*_11RawVecInnerpE7reserve21do_reserve_and_handleNtNtB*_5alloc6GlobalECs*_8clj_eval*)
    *(.text*._RNvMs*_NtCs*_8clj_eval3envNtB*_17NamespaceRegistry10resolve_in*)
    *(.text*._RNvMs*_NtCs*_5alloc7raw_vecNtB*_11RawVecInner15try_allocate_inCs*_8clj_eval*)
    *(.text*._RNvXs*_Cs*_10clojure_rsNtB*_7CommandNtNtCs*_12clap_builder6derive10Subcommand19augment_subcommands*)
    *(.text*._RNvMs*_NtCs*_5alloc7raw_vecINtB*_6RawVecNtNtNtCs*_12clap_builder4util2id2IdE8grow_oneB*_*)
    *(.text*._RNvCs*_7___rustc12___rust_alloc*)
    *(.text*._RNvMs*_NtNtCs*_12clap_builder7builder7commandNtB*_7Command21__propagate_subcommand*)
    *(.text*._RINvMs*_NtNtCs*_12clap_builder7builder3argNtB*_3Arg4helpReEB*_*)
    *(.text*._RINvMs*_NtNtCs*_12clap_builder7builder3argNtB*_3Arg10value_nameReEB*_*)
    *(.text*._RNvMs*_NtNtCs*_12clap_builder7builder7commandNtB*_7Command14required_graph*)
    *(.text*._RNvNvNtCs*_5alloc3fmt6format12format_inner*)
    *(.text*._RNvMs*_NtNtCs*_12clap_builder6parser6parserNtB*_6Parser5react*)
    *(.text*._RNvNtNtCs*_12clap_builder6parser9validator23gather_direct_conflicts*)
    *(.text*._RINvNtCs*_4core3ptr9drop_glueNtNtNtCs*_12clap_builder7builder3arg3ArgECs*_10clojure_rs*)
    *(.text*._RINvNtCs*_4core3ptr9drop_glueINtNtNtNtB*_4iter8adapters7flatten7FlattenINtNtNtCs*_5alloc3vec9into_iter8IntoIterINtB*_3VecNtNtNtCs*_12clap_builder4util9any_value8AnyValueEEEECs*_10clojure_rs*)
    *(.text*._RINvMNtNtCs*_3std4sync9once_lockINtB*_8OnceLockINtNtNtNtB*_11collections4hash3map7HashMapReRNtNtCs*_8clj_eval8classemu9StaticRowEE10initializeNCINvB*_11get_or_initNCNvB*_10static_row0E0zEB*_*)
    *(.text*._RINvMs*_NtCs*_9hashbrown3rawINtB*_8RawTableTReINtNtCs*_5alloc4sync3ArcNtNtCs*_9clj_value5class8ClassValEEE14reserve_rehashNCINvNtB*_3map11make_hasherB*_B*_NtNtNtCs*_3std4hash6random11RandomStateE0ECs*_8clj_eval*)
    *(.text*._RNvMs*_NtCs*_9clj_value6symbolNtB*_6Symbol3new*)
    *(.text*._RNvXs*_NtCs*_9clj_value5valueNtB*_5ValueNtNtCs*_4core5clone5Clone5clone.644*)
    *(.text*._RINvMs*_NtCs*_9hashbrown3rawNtB*_13RawTableInner22fallible_with_capacityNtNtCs*_5alloc5alloc6GlobalECs*_9clj_value*)
    *(.text*._RNvNtCs*_9clj_value5value12intern_shape*)
    *(.text*._RNvMs*_NtCs*_8clj_eval3envNtB*_9Namespace11drop_import*)
    *(.text*._RINvNtCs*_4core3ptr9drop_glueNtNtCs*_9clj_value5value5ValueECs*_8clj_eval*)
    *(.text*._RNvXs*_NtCs*_9clj_value5valueNtB*_5ValueNtNtCs*_4core3cmp9PartialEq2eq*)
    *(.text*._RINvMs*_NtCs*_9hashbrown3mapINtB*_7HashMapNtNtCs*_5alloc6string6StringNtNtCs*_8clj_eval3env9NamespaceINtNtCs*_4core4hash18BuildHasherDefaultNtCs*_10rustc_hash8FxHasherEE3geteEB*_*)
    *(.text*._RINvNtCs*_4core3ptr9drop_glueNtNtCs*_9clj_value5value7MapDataEB*_*)
    *(.text*._RNvMs*_NtCs*_5alloc4syncINtB*_3ArceE9drop_slowCs*_9clj_value*)
    *(.text*._RNvNtCs*_9clj_value5value17fresh_empty_small*)
    *(.text*._RNvNtCs*_8clj_eval2ns7def_var*)
    *(.text*._RNCINvXs*_NtNtNtCs*_7archery14shared_pointer4kind4arctNtB*_5ArcTKNtB*_17SharedPointerKind8make_mutINtNtNtCs*_4rpds3map13hash_trie_map4NodeNtNtCs*_9clj_value5value5ValueB*_B*_EE0B*_*)
    *(.text*._RNvMs*_NtCs*_8clj_eval3envNtB*_14SharedRegistry12lookup_in_ns*)
    *(.text*._RNvNtCs*_8clj_eval9core_lazy7head_of*)
    *(.text*._RNvNtCs*_8clj_eval9core_lazy8register*)
    *(.text*._RNCINvMs*_NtNtCs*_3std4sync4onceNtB*_4Once15call_once_forceNCINvMNtB*_9once_lockINtB*_8OnceLockNtNtCs*_8clj_eval9core_lazy9LazyIndexE10initializeNCINvB*_11get_or_initNCNvB*_10try_insert0E0zE0E0B*_*)
    *(.text*._RNvMCs*_10clj_readerNtB*_6Reader19consume_whitespaces*)
    *(.text*._RNvXNtCs*_4core3anyNtNtCs*_8clj_eval3ext8NsHandleNtB*_3Any7type_idB*_*)
    *(.text*._RNvNtCs*_8clj_eval6reader14sync_reader_ns*)
    *(.text*._RNvMs*_NtCs*_9hashbrown3mapINtB*_7HashMapNtNtCs*_5alloc6string6StringB*_NtNtNtCs*_3std4hash6random11RandomStateE6insertCs*_8clj_eval*)
    *(.text*._RNvMs*_NtCs*_5alloc4syncINtB*_3ArcDG0_INtNtNtCs*_4core3ops8function2FnTQL1_NtNtCs*_8clj_eval4eval9EvaluatorRL0_SNtNtCs*_9clj_value5value5ValueEEp6OutputINtNtB*_6result6ResultB*_NtNtB*_5error11NativeErrorENtNtB*_6marker4SendNtB*_4SyncEL_E9drop_slowB*_*)
    *(.text*._RNvXNtNtCs*_5alloc3vec21spec_from_iter_nestedINtB*_3VecNtNtCs*_9clj_value5value5ValueEINtB*_18SpecFromIterNestedB*_NtB*_10VectorIterE9from_iterB*_*)
    *(.text*._RINvYNtNtNtCs*_3std4hash6random11RandomStateNtNtCs*_4core4hash11BuildHasher8hash_oneRNtNtCs*_9clj_value6symbol6SymbolECs*_8clj_eval*)
    *(.text*._RNvMs*_NtCs*_8clj_eval3envNtB*_14SharedRegistry17intern_def_target*)
    *(.text*._RNvMs*_NtCs*_8clj_eval3envNtB*_14SharedRegistry14take_meta_lazy*)
    *(.text*._RNvNtCs*_8clj_eval2vm7site_of*)
    *(.text*._RNCNvNtCs*_8clj_eval2vm14direct_general0B*_*)
    *(.text*._RINvMs*_NtCs*_9hashbrown3rawINtB*_8RawTableTyNtNtCs*_9clj_value5value5ValueEE14reserve_rehashNCINvNtB*_3map11make_hasheryB*_INtNtCs*_4core4hash18BuildHasherDefaultNtCs*_10rustc_hash8FxHasherEE0ECs*_8clj_eval*)
    *(.text*._RNvMs*_NtCs*_8clj_eval4evalNtB*_9Evaluator18call_direct_values*)
    *(.text*._RNvNtCs*_8clj_eval4seqs13native_repeat*)
    *(.text*._RINvNtCs*_4core3ptr9drop_glueINtCs*_8smallvec8SmallVecANtNtCs*_9clj_value5value5Valuej4_EECs*_8clj_eval*)
    *(.text*._RNvNtCs*_8clj_eval13typeinternals11handle_inst*)
    *(.text*._RNvNtCs*_8clj_eval9hierarchy21native_make_hierarchy*)
    *(.text*._RNvMs*_NtCs*_5alloc4syncINtB*_3ArcShE9drop_slowCs*_14regex_automata*)
    *(.text*._RINvNtCs*_4core3ptr9drop_glueINtNtCs*_9hashbrown3raw8RawTableTINtNtCs*_5alloc4sync3ArceETNtNtCs*_9clj_value6symbol6SymbolyEEEECs*_8clj_eval*)
    *(.text*._RINvNvMs*_NtCs*_5alloc7raw_vecINtB*_11RawVecInnerpE7reserve21do_reserve_and_handleNtNtB*_5alloc6GlobalECs*_9clj_value*)
    *(.text*._RNvNtCs*_9clj_value5value13intern_string*)
    *(.text*._RNvMs*_NtCs*_8clj_eval7vm_liveNtB*_4Walk8bindings*)
    *(.text*._RNvCs*_7___rustc14___rust_realloc*)
    *(.text*._RNvMs*_NtCs*_8triomphe3arcINtB*_3ArcINtNtNtCs*_4rpds3map13hash_trie_map4NodeNtNtCs*_9clj_value5value5ValueB*_NtNtNtNtCs*_7archery14shared_pointer4kind4arct5ArcTKEE9drop_slowB*_*)
    *(.text*._RINvNtCs*_4core3ptr9drop_glueINtNtNtNtCs*_4rpds3map13hash_trie_map18sparse_array_usize16SparseArrayUsizeINtNtCs*_7archery14shared_pointer13SharedPointerINtB*_4NodeNtNtCs*_9clj_value5value5ValueB*_NtNtNtB*_4kind4arct5ArcTKEB*_EEEB*_*)
    *(.text*._RNvXs*_NtCs*_5alloc6stringNtB*_6StringNtNtCs*_4core5clone5Clone5clone*)
    *(.text*._RNvXs*_NtCs*_5alloc3vecINtB*_3VecNtNtCs*_9clj_value5value5ValueENtNtCs*_4core5clone5Clone5cloneCs*_8clj_eval*)
    *(.text*._RNvMs*_NtCs*_8clj_eval4evalNtB*_9Evaluator4eval*)
    *(.text*._RNvNtCs*_8clj_eval2ns19import_package_list*)
    *(.text*._RNvMs*_NtNtNtCs*_5alloc11collections5btree3mapINtB*_8BTreeMapyNtNtB*_7set_val9SetValZSTE6insertCs*_8clj_eval*)
    *(.text*._RNvMs*_NtCs*_5alloc7raw_vecINtB*_6RawVecNtNtCs*_8clj_eval4expr10KeyBindingE8grow_oneB*_*)
    *(.text*._RNvMs*_NtNtNtCs*_5alloc11collections5btree3mapINtB*_8IntoIterINtNtB*_5boxed3BoxShEjE10dying_nextCs*_12aho_corasick*)
    *(.text*._RNvMs*_NtCs*_5alloc4syncINtB*_3ArcNtNtCs*_9clj_value4trie4PVecE9drop_slowB*_*)
    *(.text*._RNvMs*_NtCs*_8clj_eval3envNtB*_8Bindings7set_top*)
    *(.text*._RNvNtCs*_8clj_eval3env13unbind_counts*)
    *(.text*._RNvNtCs*_8clj_eval4coll17compare_sort_keys*)
    *(.text*._RINvNtNtCs*_5alloc2io4read19default_read_to_endNtNtCs*_3std2fs4FileEB*_*)
    *(.text*._RNvMs*_NtCs*_8clj_eval3envNtB*_14SharedRegistry9lookup_in*)
    *(.text*._RINvNtCs*_9clj_value5value15hash_value_restNtCs*_10rustc_hash8FxHasherEB*_*)
    *(.text*._RNvNtCs*_9clj_value5print12pr_to_string*)
    *(.text*._RINvMNtNtCs*_3std4sync9once_lockINtB*_8OnceLockINtNtB*_14reentrant_lock13ReentrantLockINtNtCs*_4core4cell7RefCellINtNtNtNtCs*_5alloc2io8buffered10linewriter10LineWriterNtNtNtB*_2io5stdio9StdoutRawEEEE10initializeNCINvB*_11get_or_initNCNvB*_6stdout0E0zEB*_*)
    *(.text*._RNCINvMs*_NtNtCs*_3std4sync4onceNtB*_4Once15call_once_forceNCINvMNtB*_9once_lockINtB*_8OnceLockINtNtB*_14reentrant_lock13ReentrantLockINtNtCs*_4core4cell7RefCellINtNtNtNtCs*_5alloc2io8buffered10linewriter10LineWriterNtNtNtB*_2io5stdio9StdoutRawEEEE10initializeNCINvB*_11get_or_initNCNvB*_6stdout0E0zE0E0B*_*)
    *(.text*._RNvXs*_NtNtCs*_3std2io5stdioNtB*_10StdoutLockNtNtNtCs*_4core2io5write5Write9write_all*)
    *(.text*._RINvNtCs*_4core3ptr9drop_glueINtNtCs*_5alloc3vec3VecNtNtCs*_9clj_value5value5ValueEECs*_10clojure_rs*)
    *(.text*._RNvMs*_NtCs*_5alloc7raw_vecINtB*_6RawVecINtNtNtCs*_4rpds3map13hash_trie_map13EntryWithHashNtNtCs*_9clj_value5value5ValueB*_NtNtNtNtCs*_7archery14shared_pointer4kind4arct5ArcTKEE8grow_oneB*_*)
    *(.text*._RNvMs*_NtCs*_8clj_eval4exprNtB*_8Analyzer20check_class_operator*)
    *(.text*._RINvNvMs*_NtCs*_5alloc7raw_vecINtB*_11RawVecInnerpE7reserve21do_reserve_and_handleNtNtB*_5alloc6GlobalECs*_12clap_builder*)
    *(.text*._RNvMs*_NtNtCs*_12clap_builder7builder7commandNtB*_7Command11__build_self*)
    *(.text*._RNvXs*_NtCs*_4core7convertReINtB*_4IntoNtNtNtCs*_12clap_builder7builder10styled_str9StyledStrE4intoB*_*)
    *(.text*._RNvMs*_NtCs*_12clap_builder7mkeymapNtB*_7MKeyMap4push*)
    *(.text*._RNvMs*_NtNtCs*_12clap_builder6output5usageNtB*_5Usage23get_required_usage_from*)
    *(.text*._RNvMs*_NtNtCs*_12clap_builder6parser6parserNtB*_6Parser16start_custom_arg*)
    *(.text*._RNvMs*_NtNtCs*_12clap_builder4util8flat_mapINtB*_5EntryNtNtB*_2id2IdNtNtNtNtB*_6parser7matches11matched_arg10MatchedArgE9or_insertB*_*)
    *(.text*._RNvMs*_NtCs*_5alloc7raw_vecINtB*_6RawVecNtNtCs*_12clap_builder7mkeymap3KeyE8grow_oneB*_*)
    *(.text*._RNvMs*_NtNtCs*_12clap_builder6parser6parserNtB*_6Parser12add_defaults*)
    *(.text*._RNvMNtNtCs*_12clap_builder6parser11arg_matcherNtB*_10ArgMatcher21fill_in_global_values*)
    *(.text*._RINvNtCs*_4core3ptr9drop_glueNtNtNtNtCs*_12clap_builder6parser7matches11arg_matches10ArgMatchesEB*_*)
    *(.text*._RNvNtNtNtCs*_3std3sys2fs4unix9try_statx*)
    *(.text*._RNvMs*_NtCs*_3std2fsNtB*_11OpenOptions5__open*)
    *(.text*._RNCNvNvNtCs*_8clj_eval8classemu18default_import_map3MAP0B*_*)
    *(.text*._RINvMs*_NtCs*_9hashbrown3rawINtB*_8RawTableTNtNtCs*_5alloc6string6StringINtNtB*_4sync3ArcNtNtCs*_9clj_value5class8ClassValEEE14reserve_rehashNCINvNtB*_3map11make_hasherB*_B*_INtNtCs*_4core4hash18BuildHasherDefaultNtCs*_10rustc_hash8FxHasherEE0ECs*_8clj_eval*)
    *(.text*._RNvNtCs*_8clj_eval8classemu12static_class*)
    *(.text*._RNvNtCs*_8clj_eval8classemu10static_row*)
    *(.text*._RINvYNtNtNtCs*_3std4hash6random11RandomStateNtNtCs*_4core4hash11BuildHasher8hash_oneRNtNtCs*_5alloc6string6StringECs*_8clj_eval*)
    *(.text*._RNvXs*_NtNtNtCs*_4core4iter8adapters5chainINtB*_5ChainIB*_IB*_IB*_IB*_IB*_IB*_INtNtNtB*_5slice4iter4IterTReFG0_QL1_NtNtCs*_8clj_eval4eval9EvaluatorRL0_SNtNtCs*_9clj_value5value5ValueEINtNtB*_6result6ResultB*_NtNtB*_5error11NativeErrorEEEB*_EB*_EB*_EB*_EB*_EB*_EB*_ENtNtNtB*_6traits8iterator8Iterator9size_hintB*_*)
    *(.text*._RNvXs*_NtNtNtCs*_4core4iter8adapters5chainINtB*_5ChainIB*_IB*_IB*_IB*_INtNtNtB*_5slice4iter4IterTReFG0_QL1_NtNtCs*_8clj_eval4eval9EvaluatorRL0_SNtNtCs*_9clj_value5value5ValueEINtNtB*_6result6ResultB*_NtNtB*_5error11NativeErrorEEEB*_EB*_EB*_EB*_EB*_ENtNtNtB*_6traits8iterator8Iterator9size_hintB*_*)
    *(.text*._RNvMs*_NtCs*_8clj_eval4evalNtB*_9Evaluator20install_native_inner*)
    *(.text*._RNvYNCNvNvMs*_NtCs*_8clj_eval3envNtB*_9Namespace6intern4KEYS0INtNtNtCs*_4core3ops8function6FnOnceuE9call_onceB*_*)
    *(.text*._RNvNtNtNtNtCs*_3std3sys12thread_local11destructors10linux_like8register*)
    *(.text*._RNvMs*_NtCs*_5alloc3vecINtB*_3VecNtNtCs*_9clj_value5value5ValueE16into_boxed_sliceB*_*)
    *(.text*._RINvMs*_NtCs*_9hashbrown3rawINtB*_8RawTableTINtNtCs*_5alloc3vec3VecNtNtCs*_9clj_value5value5ValueEINtNtB*_4sync4WeakNtB*_8MapShapeEEE14reserve_rehashNCINvNtB*_3map11make_hasherB*_B*_INtNtCs*_4core4hash18BuildHasherDefaultNtCs*_10rustc_hash8FxHasherEE0EB*_*)
    *(.text*._RINvMs*_NtCs*_9hashbrown3rawINtB*_8RawTableTyINtNtCs*_5alloc4sync3ArceEEE14reserve_rehashNCINvNtB*_3map11make_hasheryB*_INtNtCs*_4core4hash18BuildHasherDefaultNtCs*_10rustc_hash8FxHasherEE0ECs*_8clj_eval*)
    *(.text*._RNvXs*_NtCs*_10clj_reader4optsNtB*_10ReaderOptsNtNtCs*_4core7default7Default7default*)
    *(.text*._RNvNtCs*_8clj_eval4core17default_reader_fn*)
    *(.text*._RINvXs*_NtCs*_9clj_value6symbolNtB*_6SymbolNtNtCs*_4core4hash4Hash4hashNtCs*_10rustc_hash8FxHasherEB*_*)
    *(.text*._RNvNtCs*_9clj_value5value12port_pair_eq*)
    *(.text*._RNvMs*_NtCs*_5alloc7raw_vecINtB*_6RawVecTNtNtCs*_9clj_value5value5ValueB*_EE8grow_oneB*_*)
    *(.text*._RNvMs*_NtCs*_8clj_eval3envNtB*_8Bindings10push_frame*)
    *(.text*._RNvMs*_NtCs*_5alloc7raw_vecINtB*_6RawVecNtNtCs*_8clj_eval9core_lazy9LazyGroupE8grow_oneB*_*)
    *(.text*._RNvMs*_NtCs*_8clj_eval4evalNtB*_9Evaluator13live_forms_at*)
    *(.text*._RNvNtCs*_8clj_eval2ns10deref_core*)
    *(.text*._RNvMs*_NtCs*_8clj_eval4evalNtB*_9Evaluator15current_ns_name*)
    *(.text*._RNvXs*_NtCs*_8clj_eval3extNtB*_8NsHandleNtNtCs*_9clj_value9extension14ExtensionValue6as_any*)
    *(.text*._RNvNtCs*_8clj_eval3env12class_map_of*)
    *(.text*._RNvNtCs*_8clj_eval4core21snapshot_data_readers*)
    *(.text*._RNvXs*_NtCs*_9clj_value5valueNtB*_10VectorIterNtNtNtNtCs*_4core4iter6traits8iterator8Iterator4next*)
    *(.text*._RNvNtCs*_8clj_eval4core14table_snapshot*)
    *(.text*._RNvXs*_NtCs*_9clj_value5valueNtB*_7MapIterNtNtNtNtCs*_4core4iter6traits8iterator8Iterator4next*)
    *(.text*._RNvMs*_NtCs*_9hashbrown3mapINtB*_7HashMapNtNtCs*_9clj_value6symbol6SymboluNtNtNtCs*_3std4hash6random11RandomStateE6insertCs*_8clj_eval*)
    *(.text*._RNvMNtCs*_10clj_reader4collNtB*_6Reader11list_reader*)
    *(.text*._RNvMNtCs*_10clj_reader4collNtB*_6Reader14read_delimited*)
    *(.text*._RNvYNCNvNvMNtCs*_10clj_reader4collNtB*_6Reader11list_reader2KW0INtNtNtCs*_4core3ops8function6FnOnceuE9call_onceB*_*)
    *(.text*._RNvNtCs*_8clj_eval4core16needs_resolution*)
    *(.text*._RNvNtCs*_8clj_eval5error8meta_int*)
    *(.text*._RNvNtCs*_8clj_eval6macros16is_identity_head*)
    *(.text*._RNvNtCs*_8clj_eval4lazy12is_seq_value*)
    *(.text*._RINvNtCs*_4core3ptr9drop_glueNtNtCs*_8clj_eval4expr8AnalyzerEB*_*)
    *(.text*._RNvMs*_NtCs*_8clj_eval4evalNtB*_9Evaluator10def_finish*)
    *(.text*._RNvNtCs*_8clj_eval6vm_ops10value_ctor*)
    *(.text*._RNvMs*_NtCs*_8clj_eval2vmNtB*_8Compiler7operand*)
    *(.text*._RNvXs*_NtCs*_9clj_value3seqNtB*_11RepeatValueNtNtB*_9extension14ExtensionValue6as_any*)
    *(.text*._RNvMs*_NtCs*_5alloc4syncINtB*_3ArcINtNtNtNtCs*_3std11collections4hash3map7HashMapIB*_eETNtNtCs*_9clj_value6symbol6SymbolyEINtNtCs*_4core4hash18BuildHasherDefaultNtCs*_10rustc_hash8FxHasherEEE9drop_slowCs*_8clj_eval*)
    *(.text*._RNvNtCs*_8clj_eval14builtin_expand10assert_vec*)
    *(.text*._RNvNtCs*_9clj_value5print13print_scalars*)
    *(.text*._RNvNtCs*_8clj_eval8fx4_form13is_vector_val*)
    *(.text*._RNvNtCs*_8clj_eval4expr18vector_shape_items*)
    *(.text*._RNvYNCNvNtCs*_9clj_value5value11STRING_POOL0INtNtNtCs*_4core3ops8function6FnOnceuE9call_onceB*_*)
    *(.text*._RNvMs*_NtCs*_8clj_eval2vmNtB*_8Compiler14compile_effect*)
    *(.text*._RNvNtCs*_8clj_eval4vars12push_entries*)
    *(.text*._RNvNtCs*_8clj_eval2ns17source_path_value*)
    *(.text*._RNvMs*_NtCs*_8clj_eval2vmNtB*_8Compiler12visible_locs*)
    *(.text*._RNvXNtCs*_9hashbrown3mapINtB*_7HashMapINtNtCs*_5alloc4sync3ArceETNtNtCs*_9clj_value6symbol6SymbolyEINtNtCs*_4core4hash18BuildHasherDefaultNtCs*_10rustc_hash8FxHasherEENtNtB*_5clone5Clone5cloneCs*_8clj_eval*)
    *(.text*._RNvNtCs*_8clj_eval3stm10sync_begin*)
    *(.text*._RNvMs*_NtCs*_8clj_eval4evalNtB*_9Evaluator11invoke_args*)
    *(.text*._RNvNtCs*_8clj_eval3stm14native_commute*)
    *(.text*._RNvNtCs*_8clj_eval3stm10pop_commit*)
    *(.text*._RINvNtCs*_4core3ptr9drop_glueINtNtNtNtCs*_5alloc11collections5btree3map8BTreeMapyyEECs*_8clj_eval*)
    *(.text*._RINvNtCs*_4core3ptr9drop_glueNtNtCs*_8clj_eval3stm9InstalledEB*_*)
    *(.text*._RNvNtCs*_8clj_eval2ns16native_load_file*)
    *(.text*._RINvNtCs*_4core3ptr9drop_glueNtNtCs*_9clj_value5value11VectorInnerEB*_*)
    *(.text*._RNvXs*_NtCs*_8clj_eval2ioNtB*_6WriterNtNtCs*_9clj_value9extension14ExtensionValue6as_any*)
    *(.text*._RNvNtCs*_8clj_eval8classemu14class_of_value*)
    *(.text*._RNvNtCs*_8clj_eval5multi14invoke_multifn*)
    *(.text*._RNvNtCs*_8clj_eval2io9flush_out*)
    *(.text*._RNvMs*_NtCs*_5alloc4syncINtB*_3ArcINtNtB*_3vec3VeccEE9drop_slowCs*_9clj_value*)
    *(.text*._RNvNtCs*_8clj_eval11concurrency8join_all*)
    *(.text*._RINvMs*_NtCs*_9hashbrown3rawINtB*_8RawTableTjuEE14reserve_rehashNCINvNtB*_3map11make_hasherjuNtNtNtCs*_3std4hash6random11RandomStateE0ECs*_8clj_eval*)
    *(.text*._RNvNtCs*_8clj_eval6macros12is_macro_var*)
    *(.text*._RNvYNCNvNvNtCs*_8clj_eval6macros12is_macro_var2KW0INtNtNtCs*_4core3ops8function6FnOnceuE9call_onceB*_*)
    *(.text*._RNvMs*_NtCs*_8clj_eval3envNtB*_14SharedRegistry9meta_flag*)
    *(.text*._RNvCs*_10clojure_rs4main*)
    *(.text*._RNvNtNtCs*_4core3str8converts9from_utf8*)
    *(.text*._RNvMs*_NtCs*_5alloc7raw_vecNtB*_11RawVecInner11finish_growCs*_3std*)
    *(.text*._RNvMs*_NtCs*_5alloc7raw_vecINtB*_6RawVecNtNtNtNtCs*_12clap_builder6parser7matches11matched_arg10MatchedArgE8grow_oneB*_*)
    *(.text*._RNvMNtNtCs*_12clap_builder6parser9validatorNtB*_9Validator8validate*)
    *(.text*._RINvMNtNtCs*_12clap_builder4util8flat_mapINtB*_7FlatMapNtNtB*_2id2IdNtNtNtNtB*_6parser7matches11matched_arg10MatchedArgE12remove_entryeECs*_10clojure_rs*)
    *(.text*._RINvMNtNtCs*_3std4sync9once_lockINtB*_8OnceLockINtNtNtB*_6poison5mutex5MutexINtNtNtNtB*_11collections4hash3map7HashMapReINtNtCs*_5alloc4sync3ArcNtNtCs*_9clj_value5class8ClassValEEEE10initializeNCINvB*_11get_or_initNvYB*_NtNtCs*_4core7default7Default7defaultE0zECs*_8clj_eval*)
    *(.text*._RNvXs*_NtNtNtCs*_4core4iter8adapters5chainINtB*_5ChainIB*_IB*_IB*_IB*_IB*_IB*_IB*_IB*_IB*_IB*_IB*_IB*_IB*_IB*_IB*_IB*_IB*_IB*_IB*_IB*_IB*_IB*_IB*_IB*_INtNtNtB*_5slice4iter4IterTReFG0_QL1_NtNtCs*_8clj_eval4eval9EvaluatorRL0_SNtNtCs*_9clj_value5value5ValueEINtNtB*_6result6ResultB*_NtNtB*_5error11NativeErrorEEEB*_EB*_EB*_EB*_EB*_EB*_EB*_EB*_EB*_EB*_EB*_EB*_EB*_EB*_EB*_EB*_EB*_EB*_EB*_EB*_EB*_EB*_EB*_EB*_EB*_ENtNtNtB*_6traits8iterator8Iterator9size_hintB*_*)
    *(.text*._RNvXs*_NtNtNtCs*_4core4iter8adapters5chainINtB*_5ChainIB*_IB*_INtNtNtB*_5slice4iter4IterTReFG0_QL1_NtNtCs*_8clj_eval4eval9EvaluatorRL0_SNtNtCs*_9clj_value5value5ValueEINtNtB*_6result6ResultB*_NtNtB*_5error11NativeErrorEEEB*_EB*_EB*_ENtNtNtB*_6traits8iterator8Iterator9size_hintB*_*)
    *(.text*._RNvMs*_NtCs*_9hashbrown3mapINtB*_7HashMapyINtNtCs*_5alloc4sync3ArceEINtNtCs*_4core4hash18BuildHasherDefaultNtCs*_10rustc_hash8FxHasherEE6insertCs*_8clj_eval*)
    *(.text*._RNvMs*_NtCs*_8clj_eval3envNtB*_17NamespaceRegistry6intern*)
    *(.text*._RNvMs*_NtCs*_5alloc4syncINtB*_3ArcNtNtCs*_9clj_value5value7SetDataE8make_mutB*_*)
    *(.text*._RNvMs*_NtCs*_9clj_value5valueNtB*_4List8from_vec*)
    *(.text*._RINvMs*_NtCs*_9hashbrown3rawNtB*_13RawTableInner22fallible_with_capacityNtNtCs*_5alloc5alloc6GlobalECs*_10clj_reader*)
    *(.text*._RNvXs*_NtCs*_10clj_reader4optsNtB*_10ReaderOptsNtNtCs*_4core5clone5Clone5clone*)
    *(.text*._RINvMNtNtCs*_3std4sync9once_lockINtB*_8OnceLockINtNtNtB*_6poison5mutex5MutexINtNtNtNtCs*_5alloc2io8buffered9bufreader9BufReaderNtNtNtB*_2io5stdio8StdinRawEEE10initializeNCINvB*_11get_or_initNCNvB*_5stdin0E0zEB*_*)
    *(.text*._RINvNtCs*_4core3ptr9drop_glueNtNtCs*_10clj_reader4opts10ReaderOptsECs*_8clj_eval*)
    *(.text*._RNvMs*_NtCs*_9hashbrown3rawINtB*_8RawTableTINtNtCs*_5alloc3vec3VecNtNtCs*_9clj_value5value5ValueEINtNtB*_4sync4WeakNtB*_8MapShapeEEE5eraseB*_*)
    *(.text*._RNvNtCs*_8clj_eval8printsys15method_fn_value*)
    *(.text*._RINvNtCs*_4core3ptr9drop_glueINtNtNtCs*_4rpds3map13hash_trie_map6BucketNtNtCs*_9clj_value5value5ValueB*_NtNtNtNtCs*_7archery14shared_pointer4kind4arct5ArcTKEEB*_*)
    *(.text*._RNvNtCs*_8clj_eval8printsys14char_map_value*)
    *(.text*._RNvNtCs*_8clj_eval2ns8core_var*)
    *(.text*._RNvMs*_NtCs*_8clj_eval4evalNtB*_9Evaluator12push_binding*)
    *(.text*._RNvNtCs*_8clj_eval2ns14set_ns_current*)
    *(.text*._RNvNtCs*_8clj_eval9core_lazy4plan*)
    *(.text*._RNvMs*_NtCs*_5alloc7raw_vecINtB*_6RawVecyE8grow_oneCs*_10num_bigint*)
    *(.text*._RNvMs*_NtCs*_8clj_eval4evalNtB*_9Evaluator18deref_var_unforced*)
    *(.text*._RNvMs*_NtCs*_8clj_eval3envNtB*_14SharedRegistry11root_cloned*)
    *(.text*._RNvNtCs*_8clj_eval4core22snapshot_default_layer*)
    *(.text*._RINvMs*_NtCs*_9hashbrown3rawINtB*_8RawTableTNtNtCs*_9clj_value6symbol6SymboluEE14reserve_rehashNCINvNtB*_3map11make_hasherB*_uNtNtNtCs*_3std4hash6random11RandomStateE0ECs*_8clj_eval*)
    *(.text*._RNvNtCs*_8clj_eval8classemu16identical_values*)
    *(.text*._RNvMs*_NtCs*_5alloc7raw_vecINtB*_6RawVecNtNtCs*_9clj_value5value5ValueE8grow_oneB*_*)
    *(.text*._RINvNtCs*_4core3ptr9drop_glueNtNtCs*_9clj_value5value5ValueECs*_10clj_reader*)
    *(.text*._RNvMs*_NtCs*_9clj_value5valueNtB*_5Value4meta*)
    *(.text*._RNvMs*_NtCs*_9clj_value5valueNtB*_5Value9with_meta*)
    *(.text*._RNvNtCs*_8clj_eval4core16drain_fired_tags*)
    *(.text*._RNvNtCs*_8clj_eval4core9map_needs*)
    *(.text*._RNvNtCs*_8clj_eval6macros18macroexpand1_value*)
    *(.text*._RNvMs*_NtCs*_8clj_eval4exprNtB*_8Analyzer7analyze*)
    *(.text*._RNvMs*_NtCs*_8clj_eval4exprNtB*_8Analyzer16check_def_target*)
    *(.text*._RNvMs*_NtCs*_8clj_eval3envNtB*_9Namespace10get_import*)
    *(.text*._RNvNtCs*_8clj_eval7vm_live9last_uses*)
    *(.text*._RNCNvMs*_NtCs*_8clj_eval2vmNtB*_8Compiler11compile_defs*_0B*_*)
    *(.text*._RINvNtCs*_4core3ptr9drop_glueNCNvMs*_NtCs*_8clj_eval2vmNtB*_8Compiler11compile_defs*_0EB*_*)
    *(.text*._RNvMs*_NtCs*_8clj_eval4evalNtB*_9Evaluator17site_direct_check*)
    *(.text*._RNvNtCs*_8clj_eval4lazy10is_seqable*)
    *(.text*._RNvMs*_NtCs*_5alloc3vecINtB*_3VecNtNtCs*_9clj_value5value5ValueE11extend_withCs*_8clj_eval*)
    *(.text*._RNvYNCNvNtCs*_8clj_eval13typeinternals11VECNODE_DEF0INtNtNtCs*_4core3ops8function6FnOnceuE9call_onceB*_*)
    *(.text*._RNvNtCs*_9clj_value9hierarchy18make_hierarchy_map*)
    *(.text*._RNvNtCs*_8clj_eval2ns10refer_into*)
    *(.text*._RNvCs*_10clojure_rs10clj_string*)
    *(.text*._RNvMs*_NtCs*_8clj_eval4evalNtB*_9Evaluator6invoke*)
    *(.text*._RNvNtCs*_8clj_eval14builtin_expand14expand_binding*)
    *(.text*._RNvNtCs*_8clj_eval14builtin_expand10expand_let*)
    *(.text*._RNvMs*_NtCs*_8clj_eval2vmNtB*_8Compiler12compile_body*)
    *(.text*._RNvNtCs*_8clj_eval6macros15native_hash_map*)
    *(.text*._RNvXs*_NtNtCs*_4rpds3map13hash_trie_mapINtB*_7IterPtrNtNtCs*_9clj_value5value5ValueB*_NtNtNtNtCs*_7archery14shared_pointer4kind4arct5ArcTKENtNtNtNtCs*_4core4iter6traits8iterator8Iterator4nextB*_*)
    *(.text*._RNvYNCNvMs*_NtNtCs*_4rpds3map13hash_trie_mapINtB*_11HashTrieMapNtNtCs*_9clj_value5value5ValueB*_NtNtNtNtCs*_7archery14shared_pointer4kind4arct5ArcTKINtNtCs*_4core4hash18BuildHasherDefaultNtCs*_10rustc_hash8FxHasherEE4iter0INtNtNtB*_3ops8function6FnOnceTRINtB*_13SharedPointerINtNtB*_5entry5EntryB*_B*_EB*_EEE9call_onceB*_*)
    *(.text*._RNvNtCs*_8clj_eval2ns8libs_set*)
    *(.text*._RNvMNtCs*_10clj_reader4collNtB*_6Reader11checked_map*)
    *(.text*._RNvNtCs*_8clj_eval2vm9frame_env*)
    *(.text*._RINvMs*_NtCs*_8clj_eval3envNtB*_14SharedRegistry11with_ns_mutuNCNvNtB*_2ns12eval_ns_forms*_0EB*_*)
    *(.text*._RNvNtCs*_8clj_eval2ns14run_ns_clauses*)
    *(.text*._RINvXs*_Cs*_8smallvecINtB*_8SmallVecANtNtCs*_9clj_value5value5Valuej4_EINtNtNtNtCs*_4core4iter6traits7collect6ExtendB*_E6extendINtNtNtB*_8adapters6cloned6ClonedINtNtNtB*_5slice4iter4IterB*_EEECs*_8clj_eval*)
    *(.text*._RNvNtCs*_8clj_eval4coll15sorted_conj_set*)
    *(.text*._RNvMs*_NtCs*_9clj_value5valueNtB*_3Set20with_ordered_members*)
    *(.text*._RINvNtCs*_4core3ptr9drop_glueSTNtNtCs*_9clj_value5agent5AgentNtB*_12QueuedActionEECs*_8clj_eval*)
    *(.text*._RNvMs*_NtCs*_8clj_eval3envNtB*_8Bindings8truncate*)
    *(.text*._RNvNvNtCs*_3std2fs14read_to_string5inner*)
    *(.text*._RNvNvMs*_NtCs*_4core3fmtNtB*_9Formatter12pad_integral12write_prefix*)
    *(.text*._RNvMs*_NtNtCs*_3std6thread6threadNtB*_6Thread3new*)
    *(.text*._RNvNtCs*_8clj_eval8printsys13bind_core_var*)
    *(.text*._RNvNtCs*_8clj_eval5multi17resolve_hierarchy*)
    *(.text*._RINvNtCs*_4core3ptr9drop_glueNtNtCs*_9clj_value5value5ValueECs*_10clojure_rs*)
    *(.text*._RNvMs*_NtCs*_5alloc7raw_vecINtB*_6RawVecNtNtCs*_8clj_eval2re14BoundaryAssertE8grow_oneB*_*)
    *(.text*._RNvNtNtNtNtNtCs*_3std3sys3pal4unix14stack_overflow11thread_info16set_current_info*)
    *(.text*._RINvNtNtCs*_3std3sys9backtrace28___rust_begin_short_backtraceFENtNtB*_7process8ExitCodeB*_ECs*_10clojure_rs*)
    *(.text*._RNvMs*_NtCs*_5alloc7raw_vecINtB*_6RawVecNtNtNtCs*_12clap_builder7builder3arg3ArgE8grow_oneB*_*)
    *(.text*._RINvNvMs*_NtCs*_5alloc7raw_vecINtB*_11RawVecInnerpE7reserve21do_reserve_and_handleNtNtB*_5alloc6GlobalEB*_*)
    *(.text*._RNvXs*_NtNtCs*_12clap_builder7builder12value_parserNtB*_17StringValueParserNtB*_14AnyValueParser15possible_valuesB*_*)
    *(.text*._RNvXs*_NtNtCs*_12clap_builder7builder12value_parserNtB*_18PathBufValueParserNtB*_14AnyValueParser7type_idB*_*)
    *(.text*._RINvNtCs*_4core3ptr9drop_glueNtNtNtCs*_12clap_builder6parser6parser11ParseResultEB*_*)
    *(.text*._RNvMNtNtCs*_12clap_builder6parser11arg_matcherNtB*_10ArgMatcher10subcommand*)
    *(.text*._RNvXs*_NtNtNtCs*_4core4iter8adapters7flattenINtB*_13FlattenCompatINtNtNtCs*_5alloc3vec9into_iter8IntoIterINtB*_3VecNtNtNtCs*_12clap_builder4util9any_value8AnyValueEEIB*_B*_EENtNtNtB*_6traits8iterator8Iterator4nextCs*_10clojure_rs*)
    *(.text*._RNvXNtCs*_4core3anyNtNtCs*_3std4path7PathBufNtB*_3Any7type_idCs*_12clap_builder*)
    *(.text*._RNvMNtCs*_5alloc6stringNtB*_6String15from_utf8_lossy*)
    *(.text*._RNvMs*_NtNtNtNtCs*_3std3sys4sync4once5futexNtB*_4Once4call*)
    *(.text*._RINvMs*_NtCs*_9hashbrown3rawNtB*_13RawTableInner22fallible_with_capacityNtNtCs*_5alloc5alloc6GlobalECs*_8clj_eval*)
    *(.text*._RINvMs*_NtCs*_9hashbrown3rawINtB*_8RawTableTReRNtNtCs*_8clj_eval8classemu9StaticRowEE14reserve_rehashNCINvNtB*_3map11make_hasherB*_B*_NtNtNtCs*_3std4hash6random11RandomStateE0EB*_*)
    *(.text*._RINvYNtNtNtCs*_3std4hash6random11RandomStateNtNtCs*_4core4hash11BuildHasher8hash_oneReECs*_8clj_eval*)
    *(.text*._RNvMs*_NtCs*_9hashbrown3mapINtB*_7HashMapNtNtCs*_5alloc6string6StringINtNtB*_4sync3ArcNtNtCs*_9clj_value5class8ClassValEINtNtCs*_4core4hash18BuildHasherDefaultNtCs*_10rustc_hash8FxHasherEE6insertCs*_8clj_eval*)
    *(.text*._RNvXs*_NtNtNtCs*_4core4iter8adapters5chainINtB*_5ChainIB*_IB*_IB*_IB*_IB*_IB*_IB*_IB*_IB*_IB*_IB*_IB*_IB*_IB*_IB*_IB*_IB*_IB*_IB*_IB*_IB*_IB*_IB*_IB*_IB*_IB*_INtNtNtB*_5slice4iter4IterTReFG0_QL1_NtNtCs*_8clj_eval4eval9EvaluatorRL0_SNtNtCs*_9clj_value5value5ValueEINtNtB*_6result6ResultB*_NtNtB*_5error11NativeErrorEEEB*_EB*_EB*_EB*_EB*_EB*_EB*_EB*_EB*_EB*_EB*_EB*_EB*_EB*_EB*_EB*_EB*_EB*_EB*_EB*_EB*_EB*_EB*_EB*_EB*_EB*_EB*_ENtNtNtB*_6traits8iterator8Iterator9size_hintB*_*)
    *(.text*._RINvMs*_NtCs*_9hashbrown3rawINtB*_8RawTableTyNtNtCs*_8clj_eval3env8VarStateEE14reserve_rehashNCINvNtB*_3map11make_hasheryB*_INtNtCs*_4core4hash18BuildHasherDefaultNtCs*_10rustc_hash8FxHasherEE0EB*_*)
    *(.text*._RNvMs*_NtCs*_9hashbrown3mapINtB*_7HashMapyNtNtCs*_8clj_eval3env8VarStateINtNtCs*_4core4hash18BuildHasherDefaultNtCs*_10rustc_hash8FxHasherEE6insertB*_*)
    *(.text*._RNvYNCNvNtCs*_9clj_value5value15EMPTY_MAP_SHAPE0INtNtNtCs*_4core3ops8function6FnOnceuE9call_onceB*_*)
    *(.text*._RNvMs*_NtCs*_9clj_value5valueNtB*_4List10push_front*)
    *(.text*._RINvNtCs*_4core3ptr9drop_glueINtNtCs*_4rpds4list4ListNtNtCs*_9clj_value5value5ValueNtNtNtNtCs*_7archery14shared_pointer4kind4arct5ArcTKEEB*_*)
    *(.text*._RNvMs*_NtCs*_5alloc7raw_vecINtB*_6RawVecINtNtB*_3vec3VecNtNtCs*_9clj_value5value5ValueEE8grow_oneCs*_8clj_eval*)
    *(.text*._RNvMs*_NtCs*_8clj_eval3envNtB*_14SharedRegistry12install_lazy*)
    *(.text*._RINvNtCs*_4core3ptr9drop_glueINtNtNtCs*_5alloc3vec9into_iter8IntoIterNtNtCs*_8clj_eval9core_lazy9LazyGroupEEB*_*)
    *(.text*._RNvMs*_NtCs*_8clj_eval3envNtB*_14SharedRegistry17install_meta_lazy*)
    *(.text*._RNvMs*_NtCs*_8clj_eval4evalNtB*_9Evaluator14eval_source_at*)
    *(.text*._RNvMs*_NtCs*_8clj_eval4evalNtB*_9Evaluator14read_forms_pre*)
    *(.text*._RNvMs*_NtCs*_8clj_eval3envNtB*_17NamespaceRegistry5state*)
    *(.text*._RNvMs*_NtCs*_8clj_eval3envNtB*_14SharedRegistry11reader_maps*)
    *(.text*._RNvYNCNvNvNtCs*_8clj_eval3env17default_class_map3MAP0INtNtNtCs*_4core3ops8function6FnOnceuE9call_onceB*_*)
    *(.text*._RNvMCs*_10clj_readerNtB*_6Reader8set_opts*)
    *(.text*._RNvNtCs*_9clj_value3seq7seq_vec*)
    *(.text*._RNvMCs*_10clj_readerNtB*_6Reader10read_inner*)
    *(.text*._RNvNtCs*_10clj_reader6symbol10read_token*)
    *(.text*._RNvMNtCs*_10clj_reader8metaformNtB*_6Reader11meta_reader*)
    *(.text*._RNvXNtNtCs*_5alloc3vec21spec_from_iter_nestedINtB*_3VecRNtNtCs*_9clj_value5value5ValueEINtB*_18SpecFromIterNestedB*_INtNtNtNtCs*_4core4iter8adapters3map3MapINtNtCs*_4rpds4list7IterPtrB*_NtNtNtNtCs*_7archery14shared_pointer4kind4arct5ArcTKEFG_RL0_INtB*_13SharedPointerB*_B*_EERL0_B*_EE9from_iterCs*_8clj_eval*)
    *(.text*._RNvMs*_NtCs*_8clj_eval4exprNtB*_8Analyzer12analyze_list*)
    *(.text*._RNvNtCs*_8clj_eval4expr19is_shadowable_macro*)
    *(.text*._RNvMs*_NtCs*_8clj_eval2vmNtB*_8Compiler7compile*)
    *(.text*._RNvYNCNvNvMs*_NtCs*_8clj_eval4evalNtB*_9Evaluator12def_var_metas*_2KW0INtNtNtCs*_4core3ops8function6FnOnceuE9call_onceB*_*)
    *(.text*._RINvNtCs*_4core3ptr9drop_glueNCNvMs*_NtCs*_8clj_eval2vmNtB*_8Compiler11compile_map0EB*_*)
    *(.text*._RNvXNtCs*_4core3anyNtNtCs*_8clj_eval3ext8NativeFnNtB*_3Any7type_idB*_*)
    *(.text*._RNvMs*_NtCs*_8clj_eval2vmNtB*_8Compiler20compile_direct_plain*)
    *(.text*._RNvMs*_NtCs*_9hashbrown3mapINtB*_7HashMapyNtNtCs*_9clj_value5value5ValueINtNtCs*_4core4hash18BuildHasherDefaultNtCs*_10rustc_hash8FxHasherEE6insertCs*_8clj_eval*)
    *(.text*._RNvYFG0_QL1_NtNtCs*_8clj_eval4eval9EvaluatorRL0_SNtNtCs*_9clj_value5value5ValueEINtNtCs*_4core6result6ResultB*_NtNtB*_5error11NativeErrorEINtNtNtB*_3ops8function2FnTQB*_RB*_EE4callB*_*)
    *(.text*._RNvNtCs*_8clj_eval4coll16native_vec_owned*)
    *(.text*._RNvNtCs*_8clj_eval10aot_subset11display_sym*)
    *(.text*._RNvMs*_NtCs*_9hashbrown3mapINtB*_7HashMapINtNtCs*_5alloc4sync3ArceETNtNtCs*_9clj_value6symbol6SymbolyEINtNtCs*_4core4hash18BuildHasherDefaultNtCs*_10rustc_hash8FxHasherEE6insertCs*_8clj_eval*)
    *(.text*._RINvMs*_NtCs*_9hashbrown3mapINtB*_7HashMapINtNtCs*_5alloc4sync3ArceETNtNtCs*_9clj_value6symbol6SymbolyEINtNtCs*_4core4hash18BuildHasherDefaultNtCs*_10rustc_hash8FxHasherEE3geteECs*_8clj_eval*)
    *(.text*._RNvNtCs*_9clj_value5print10print_into*)
    *(.text*._RNvNtCs*_8clj_eval8fx4_form5ucall*)
    *(.text*._RNvNtCs*_8clj_eval6macros6tag_of*)
    *(.text*._RINvNtCs*_4core3ptr9drop_glueINtNtCs*_5alloc3vec3VecNtNtCs*_9clj_value5value5ValueEECs*_8clj_eval*)
    *(.text*._RNvXs*_NtCs*_4core3fmtRINtNtCs*_5alloc4sync3ArceENtB*_7Display3fmtCs*_9clj_value*)
    *(.text*._RNvMs*_NtCs*_8clj_eval4exprNtB*_8Analyzer15parse_try_items*)
    *(.text*._RNCNvNtCs*_8clj_eval2vm6global0B*_*)
    *(.text*._RNvNtCs*_8clj_eval2ns9load_libs*)
    *(.text*._RNvNtCs*_8clj_eval2ns7name_of*)
    *(.text*._RNvXs*_NtCs*_8clj_eval4exprNtB*_4ExprNtNtCs*_4core5clone5Clone5clone*)
    *(.text*._RINvNtCs*_4core3ptr9drop_glueINtNtCs*_5alloc3vec3VecTyNtNtCs*_9clj_value5value5ValueIB*_B*_EEEECs*_8clj_eval*)
    *(.text*._RNvNtCs*_8clj_eval3stm15dispatch_outbox*)
    *(.text*._RNvMs*_NtCs*_8triomphe3arcINtB*_3ArcINtNtNtCs*_4rpds3map13hash_trie_map4NodeNtNtCs*_9clj_value5value5ValueuNtNtNtNtCs*_7archery14shared_pointer4kind4arct5ArcTKEE9drop_slowB*_*)
    *(.text*._RINvNtCs*_4core3ptr9drop_glueINtNtNtNtCs*_4rpds3map13hash_trie_map18sparse_array_usize16SparseArrayUsizeINtNtCs*_7archery14shared_pointer13SharedPointerINtB*_4NodeNtNtCs*_9clj_value5value5ValueuNtNtNtB*_4kind4arct5ArcTKEB*_EEEB*_*)
    *(.text*._RINvNvNtNtCs*_5alloc2io4read19default_read_to_end16small_probe_readNtNtCs*_3std2fs4FileEB*_*)
    *(.text*._RNvMNtNtNtNtCs*_3std3sys12thread_local3key4racyNtB*_7LazyKey9lazy_init*)
    *(.text*._RNvNtCs*_8clj_eval4core10print_opts*)
    *(.text*._RNvNtCs*_9clj_value6hasheq20seq_hash_unsupported*)
    *(.text*._RNvNtCs*_8clj_eval8printsys12pr_on_method*)
    *(.text*._RNvNtCs*_8clj_eval8printsys21class_method_override*)
    *(.text*._RNvNtCs*_9clj_value3jvm12jvm_class_of*)
    *(.text*._RINvNtCs*_4core3ptr9drop_glueINtNtCs*_5alloc3vec3VecTNtNtB*_6string6StringjINtNtB*_5boxed3BoxDG1_INtNtNtB*_3ops8function2FnTQL2_NtNtCs*_8clj_eval4eval9EvaluatorQL1_INtNtB*_2vm5FrameL0_EEEp6OutputINtNtB*_6result6ResultNtNtCs*_9clj_value5value5ValueNtNtB*_5error6SignalENtNtB*_6marker4SendNtB*_4SyncEL_EEEEB*_*)
    *(.text*._RNvMNtCs*_8clj_eval11concurrencyNtB*_11AgentSystem14latch_and_park*)
    *(.text*._RNvMs*_NtCs*_8clj_eval3envNtB*_14SharedRegistry10resolve_in*)
    *(.text*._RNvNtNtNtNtNtCs*_3std3sys3pal4unix14stack_overflow3imp12make_handler*)
    *(.text*._RNvMs*_NtNtCs*_12clap_builder6parser6parserNtB*_6Parser16get_matches_with*)
    *(.text*._RNvMs*_NtNtCs*_12clap_builder6parser6parserNtB*_6Parser19possible_subcommand*)
    *(.text*._RNvNtCs*_4core3fmt5write*)
    *(.text*._RNvMs*_NtCs*_5alloc7raw_vecNtB*_11RawVecInner11finish_growB*_*)
    *(.text*._RNvMs*_NtCs*_5alloc7raw_vecINtB*_6RawVecINtNtB*_3vec3VecNtNtNtCs*_3std3ffi6os_str8OsStringEE8grow_oneCs*_12clap_builder*)
    *(.text*._RNvMs*_NtNtCs*_12clap_builder6parser6parserNtB*_6Parser15push_arg_values*)
    *(.text*._RINvNtCs*_4core3ptr9drop_glueNtNtNtCs*_12clap_builder7builder7command7CommandECs*_10clojure_rs*)
    *(.text*._RINvNtCs*_4core3ptr9drop_glueNtNtNtNtCs*_12clap_builder6parser7matches11matched_arg10MatchedArgECs*_10clojure_rs*)
    *(.text*._RNvMs*_NtNtNtCs*_3std3sys2fs4unixNtB*_4File6open_c*)
    *(.text*._RINvMs*_NtCs*_9hashbrown3mapINtB*_7HashMapNtNtCs*_5alloc6string6StringNtNtCs*_8clj_eval3env9NamespaceINtNtCs*_4core4hash18BuildHasherDefaultNtCs*_10rustc_hash8FxHasherEE12contains_keyeEB*_*)
    *(.text*._RNvMs*_NtCs*_9hashbrown3mapINtB*_7HashMapNtNtCs*_5alloc6string6StringNtNtCs*_8clj_eval3env9NamespaceINtNtCs*_4core4hash18BuildHasherDefaultNtCs*_10rustc_hash8FxHasherEE6insertB*_*)
    *(.text*._RNvXs*_NtNtNtCs*_4core4iter8adapters5chainINtB*_5ChainIB*_IB*_IB*_IB*_IB*_IB*_IB*_IB*_IB*_IB*_IB*_IB*_IB*_IB*_IB*_IB*_INtNtNtB*_5slice4iter4IterTReFG0_QL1_NtNtCs*_8clj_eval4eval9EvaluatorRL0_SNtNtCs*_9clj_value5value5ValueEINtNtB*_6result6ResultB*_NtNtB*_5error11NativeErrorEEEB*_EB*_EB*_EB*_EB*_EB*_EB*_EB*_EB*_EB*_EB*_EB*_EB*_EB*_EB*_EB*_EB*_ENtNtNtB*_6traits8iterator8Iterator9size_hintB*_*)
    *(.text*._RNvXs*_NtNtNtCs*_4core4iter8adapters5chainINtB*_5ChainIB*_IB*_IB*_IB*_IB*_IB*_IB*_IB*_IB*_IB*_IB*_IB*_INtNtNtB*_5slice4iter4IterTReFG0_QL1_NtNtCs*_8clj_eval4eval9EvaluatorRL0_SNtNtCs*_9clj_value5value5ValueEINtNtB*_6result6ResultB*_NtNtB*_5error11NativeErrorEEEB*_EB*_EB*_EB*_EB*_EB*_EB*_EB*_EB*_EB*_EB*_EB*_EB*_ENtNtNtB*_6traits8iterator8Iterator9size_hintB*_*)
    *(.text*._RNvYNCNvNtCs*_9clj_value7keyword13KEYWORD_TABLE0INtNtNtCs*_4core3ops8function6FnOnceuE9call_onceB*_*)
    *(.text*._RINvMs*_NtCs*_9hashbrown3rawINtB*_8RawTableTNtNtCs*_9clj_value6symbol6SymbolyEE4findNCINvNtB*_3map14equivalent_keyB*_B*_yE0ECs*_8clj_eval*)
    *(.text*._RNvMs*_NtCs*_5alloc4syncINtB*_3ArcNtNtCs*_9clj_value5value7MapDataE9drop_slowB*_*)
    *(.text*._RNvMs*_NtCs*_9clj_value5valueNtB*_3Set9with_sort*)
    *(.text*._RNvMs*_NtCs*_9clj_value5valueNtB*_6Vector8from_vec*)
    *(.text*._RNvMCs*_10clj_readerNtB*_6Reader3new*)
    *(.text*._RNvMNtCs*_10clj_reader6streamNtB*_10CharStream6extend*)
    *(.text*._RNvMs*_NtCs*_5alloc7raw_vecINtB*_6RawVecINtNtB*_4sync3ArcINtNtCs*_9clj_value4trie4NodeNtNtB*_5value5ValueEEE8grow_oneB*_*)
    *(.text*._RNvNtCs*_8clj_eval8printsys18install_plain_root*)
    *(.text*._RNvMs*_NtCs*_8clj_eval3envNtB*_9Namespace6lookup*)
    *(.text*._RNvNtCs*_8clj_eval9core_lazy5token*)
    *(.text*._RNvMs*_NtCs*_5alloc4syncINtB*_3ArcINtNtNtNtCs*_3std11collections4hash3map7HashMapNtNtB*_6string6StringB*_EE9drop_slowCs*_10clj_reader*)
    *(.text*._RNvMs*_NtCs*_9clj_value5valueNtB*_3Map3get*)
    *(.text*._RNvXs*_NtCs*_9clj_value5valueNtB*_5ValueNtNtCs*_4core5clone5Clone5clone.721*)
    *(.text*._RINvNtCs*_4core3ptr9drop_glueSNtCs*_10clj_reader8FiredTagECs*_8clj_eval*)
    *(.text*._RNvMs*_NtCs*_8clj_eval4exprNtB*_8Analyzer15analyze_special*)
    *(.text*._RNvMs*_NtCs*_8clj_eval3envNtB*_17NamespaceRegistry9intern_in*)
    *(.text*._RINvNtCs*_4core3ptr9drop_glueINtNtNtCs*_5alloc11collections9vec_deque8VecDequeNtNtCs*_9clj_value5value5ValueEECs*_8clj_eval*)
    *(.text*._RNvNtCs*_8clj_eval6macros12lookup_macro*)
    *(.text*._RNvXs*_NtCs*_8clj_eval3extNtB*_8NativeFnNtNtCs*_9clj_value9extension14ExtensionValue6as_any*)
    *(.text*._RNvMs*_NtCs*_8clj_eval2vmNtB*_8Compiler14try_assoc_conj*)
    *(.text*._RINvNtCs*_4core3ptr9drop_glueNtNtCs*_8clj_eval4expr10DirectCallEB*_*)
    *(.text*._RNvNtCs*_8clj_eval6macros12is_fence_sym*)
    *(.text*._RNvXs*_NtCs*_5alloc4syncINtB*_3ArceENtNtCs*_4core3fmt7Display3fmtCs*_9clj_value*)
    *(.text*._RNvXs*_NtCs*_5alloc6stringNtB*_6StringNtNtCs*_4core3fmt5Write9write_str.897*)
    *(.text*._RNvNtCs*_8clj_eval8fx4_form12vector_items*)
    *(.text*._RNvNtCs*_8clj_eval14builtin_expand13qualified_let*)
    *(.text*._RNvNtCs*_8clj_eval18destructure_expand11destructure*)
    *(.text*._RNvNtCs*_8clj_eval14builtin_expand9star_form*)
    *(.text*._RNvMs*_NtCs*_8clj_eval4exprNtB*_8Analyzer22validate_star_bindings*)
    *(.text*._RNvMs*_NtCs*_8clj_eval4exprNtB*_8Analyzer11resolve_var*)
    *(.text*._RNvNtCs*_9clj_value5value22intern_literal_strings*)
    *(.text*._RNCINvMs*_NtNtCs*_3std4sync4onceNtB*_4Once15call_once_forceNCNvMNtB*_9lazy_lockINtB*_8LazyLockINtNtNtB*_6poison5mutex5MutexINtNtNtNtB*_11collections4hash3map7HashMapINtNtCs*_5alloc4sync3ArceEB*_EEE5force0E0Cs*_9clj_value*)
    *(.text*._RNCNvMs*_NtCs*_8clj_eval2vmNtB*_8Compiler11compile_let0B*_*)
    *(.text*._RNvNtCs*_8clj_eval3stm8tx_deref*)
    *(.text*._RNvNtCs*_8clj_eval2ns10load_paths*)
    *(.text*._RNvNtCs*_10clj_reader4coll7pair_up*)
    *(.text*._RNvYNCNvNtCs*_8clj_eval3env11EMPTY_FRAME0INtNtNtCs*_4core3ops8function6FnOnceuE9call_onceB*_*)
    *(.text*._RNvNtCs*_8clj_eval8classemu14class_for_name*)
    *(.text*._RNvNtCs*_8clj_eval3stm14check_alter_fn*)
    *(.text*._RNvNtCs*_8clj_eval3stm8check_tx*)
    *(.text*._RNvMs*_NtNtNtNtCs*_5alloc11collections5btree3map5entryINtB*_11VacantEntryyNtNtCs*_9clj_value8ref_kind3RefE12insert_entryCs*_8clj_eval*)
    *(.text*._RNvXNtNtCs*_5alloc3vec21spec_from_iter_nestedINtB*_3VecNtNtCs*_9clj_value5value5ValueEINtB*_18SpecFromIterNestedB*_INtNtNtNtCs*_4core4iter8adapters6cloned6ClonedNtNtB*_4trie4IterEE9from_iterB*_*)
    *(.text*._RNvMs*_NtCs*_9clj_value4trieNtB*_4PVec13push_back_mutB*_*)
    *(.text*._RNvMs*_NtCs*_5alloc4syncINtB*_3ArcINtNtB*_3vec3VecNtNtCs*_9clj_value5value5ValueEE8make_mutB*_*)
    *(.text*._RNCINvXs*_NtNtNtCs*_7archery14shared_pointer4kind4arctNtB*_5ArcTKNtB*_17SharedPointerKind8make_mutINtNtNtCs*_4rpds3map13hash_trie_map4NodeNtNtCs*_9clj_value5value5ValueuB*_EE0B*_*)
    *(.text*._RNvNtCs*_8clj_eval3stm9write_ids*)
    *(.text*._RINvNtCs*_4core3ptr9drop_glueNtNtCs*_9clj_value5value7SetDataEB*_*)
    *(.text*._RNvMs*_NtCs*_8clj_eval4evalNtB*_9Evaluator11load_source*)
    *(.text*._RNvNtCs*_8clj_eval2io10print_impl*)
    *(.text*._RINvMNtNtCs*_4rpds3map13hash_trie_mapINtB*_4NodeNtNtCs*_9clj_value5value5ValueB*_NtNtNtNtCs*_7archery14shared_pointer4kind4arct5ArcTKE3getB*_EB*_*)
    *(.text*._RNvNtCs*_8clj_eval8printsys15dispatch_method*)
    *(.text*._RNvNtCs*_8clj_eval9hierarchy11read_global*)
    *(.text*._RNvNtCs*_8clj_eval8printsys17write_meta_prefix*)
    *(.text*._RNvNtCs*_8clj_eval2io15write_to_writer*)
    *(.text*._RNvNtCs*_8clj_eval4vars26native_pop_thread_bindings*)
    *(.text*._RINvYINtNtCs*_4core4hash18BuildHasherDefaultNtCs*_10rustc_hash8FxHasherENtB*_11BuildHasher8hash_oneRDNtNtCs*_9clj_value6symbol6SymKeyEL_ECs*_8clj_eval*)
    *(.text*.main)
    *(.text*._RNvMs*_NtCs*_5alloc7raw_vecINtB*_6RawVecNtNtNtCs*_12clap_builder7builder9arg_group8ArgGroupE8grow_oneB*_*)
    *(.text*._RNvMs*_NtCs*_3std4pathNtB*_10Components25parse_next_component_back*)
    *(.text*._RNvMs*_NtNtCs*_12clap_builder7builder7commandNtB*_7Command9__do_parse*)
    *(.text*._RINvMs*_NtNtCs*_12clap_builder7builder7commandNtB*_7Command5aboutReEB*_*)
    *(.text*._RNvXs*_NtCs*_5alloc6stringNtB*_6StringNtNtCs*_4core3fmt7Display3fmt*)
    *(.text*._RNvXs*_NtNtCs*_12clap_builder7builder12value_parserNtB*_18PathBufValueParserNtB*_14AnyValueParser10parse_ref_B*_*)
    *(.text*._RINvMs*_NtNtNtCs*_12clap_builder6parser7matches11arg_matchesNtB*_10ArgMatches14try_remove_oneNtNtCs*_3std4path7PathBufECs*_10clojure_rs*)
    *(.text*._RNvXs*_NtNtCs*_4core3str5lossyNtB*_10Utf8ChunksNtNtNtNtB*_4iter6traits8iterator8Iterator4next*)
    *(.text*._RNvMs*_NtCs*_8clj_eval3envNtB*_14SharedRegistry9ensure_ns*)
    *(.text*._RNvNtCs*_8clj_eval3env12ensure_ns_in*)
    *(.text*._RNvMs*_NtCs*_8clj_eval3envNtB*_14SharedRegistry11set_current*)
    *(.text*._RNvYNCNvNCNvNvMs*_NtCs*_8clj_eval3envNtB*_9Namespace6intern4KEYS02KW0INtNtNtCs*_4core3ops8function6FnOnceuE9call_onceB*_*)
    *(.text*._RNCINvMs*_NtNtCs*_3std4sync4onceNtB*_4Once15call_once_forceNCNvMNtB*_9lazy_lockINtB*_8LazyLockINtNtNtB*_6poison5mutex5MutexNtNtCs*_9clj_value7keyword12KeywordTableEE5force0E0B*_*)
    *(.text*._RNvMs*_NtCs*_8clj_eval3envNtB*_17NamespaceRegistry9state_mut*)
    *(.text*._RNvNtCs*_9clj_value5value7new_set*)
    *(.text*._RNvMs*_NtCs*_9hashbrown3mapINtB*_7HashMapNtNtCs*_9clj_value7keyword7KeyworduNtNtNtCs*_3std4hash6random11RandomStateE6insertCs*_10clj_reader*)
    *(.text*._RINvYNtNtNtCs*_3std4hash6random11RandomStateNtNtCs*_4core4hash11BuildHasher8hash_oneRNtNtCs*_9clj_value6symbol6SymbolECs*_10clj_reader*)
    *(.text*._RNvXNtCs*_9hashbrown3mapINtB*_7HashMapNtNtCs*_9clj_value6symbol6SymboluNtNtNtCs*_3std4hash6random11RandomStateENtNtCs*_4core5clone5Clone5cloneCs*_8clj_eval*)
    *(.text*._RNvNtCs*_8clj_eval2ns16def_dynamic_root*)
    *(.text*._RNvMs*_NtCs*_9clj_value5valueNtB*_3Map10from_parts*)
    *(.text*._RNvMs*_NtNtCs*_4rpds3map13hash_trie_mapINtB*_11HashTrieMapNtNtCs*_9clj_value5value5ValueB*_NtNtNtNtCs*_7archery14shared_pointer4kind4arct5ArcTKINtNtCs*_4core4hash18BuildHasherDefaultNtCs*_10rustc_hash8FxHasherEE10insert_mutB*_*)
    *(.text*._RNvNtCs*_8clj_eval2ns18set_arglists_multi*)
    *(.text*._RNvMs*_NtCs*_5alloc4syncINtB*_3ArcNtNtCs*_9clj_value5value8ListDataE9drop_slowB*_*)
    *(.text*._RINvMNtCs*_4core3stre18trim_start_matchesNvMNtNtB*_4char7methodsc13is_whitespaceECs*_8clj_eval*)
    *(.text*._RINvMs*_NtCs*_5alloc3vecINtB*_3VeccE16extend_desugaredNtNtNtCs*_4core3str4iter5CharsECs*_10clj_reader*)
    *(.text*._RNvNtCs*_8clj_eval6reader14check_resolver*)
    *(.text*._RINvMs*_NtCs*_9hashbrown3rawINtB*_8RawTableTNtNtCs*_5alloc6string6StringB*_EE14reserve_rehashNCINvNtB*_3map11make_hasherB*_B*_NtNtNtCs*_3std4hash6random11RandomStateE0ECs*_8clj_eval*)
    *(.text*._RINvNtCs*_4core3ptr9drop_glueNtNtCs*_10clj_reader4opts10ReaderOptsEB*_*)
    *(.text*._RINvNtCs*_4core3ptr9drop_glueINtNtCs*_5alloc3vec3VecTNtNtCs*_9clj_value6symbol6SymbolNtNtB*_5value5ValueEEECs*_8clj_eval*)
    *(.text*._RNvMs*_NtCs*_5alloc7raw_vecNtB*_11RawVecInner11finish_growCs*_10clj_reader*)
    *(.text*._RNvMs*_NtCs*_9clj_value6symbolNtB*_6Symbol6intern*)
    *(.text*._RNvMs*_NtCs*_9clj_value6symbolNtB*_6Symbol9with_meta*)
    *(.text*._RNvYNCNvNvMNtCs*_10clj_reader4collNtB*_6Reader11list_readers*_2KW0INtNtNtCs*_4core3ops8function6FnOnceuE9call_onceB*_*)
    *(.text*._RNvMs*_NtCs*_8clj_eval4evalNtB*_9Evaluator13eval_top_form*)
    *(.text*._RNvNtCs*_8clj_eval4lazy7as_keys*)
    *(.text*._RNvMs*_NtCs*_8clj_eval7vm_liveNtB*_4Walk4walk*)
    *(.text*._RNvMs*_NtCs*_5alloc4syncINtB*_3ArcSTmmEE9drop_slowCs*_9clj_value*)
    *(.text*._RNCNvMs*_NtCs*_8clj_eval2vmNtB*_8Compiler11compile_map0B*_*)
    *(.text*._RINvNtCs*_4core3ptr9drop_glueINtNtNtB*_5array4iter8IntoIterTNtNtCs*_9clj_value5value5ValueB*_EKj5_EECs*_8clj_eval*)
    *(.text*._RNvNtCs*_8clj_eval2vm13eval_operands*)
    *(.text*._RNvXNtCs*_4core3anyNtNtCs*_9clj_value3seq11RepeatValueNtB*_3Any7type_idB*_*)
    *(.text*._RINvNtCs*_4core3ptr9drop_glueNCNvNtCs*_8clj_eval2vm14direct_general0EB*_*)
    *(.text*._RNvMs*_NtCs*_5alloc4syncINtB*_3ArcNtNtCs*_8clj_eval4expr10DirectCallE9drop_slowB*_*)
    *(.text*._RINvMs*_NtCs*_5alloc3vecINtB*_3VecNtNtCs*_9clj_value5value5ValueE16extend_desugaredNtB*_10VectorIterECs*_8clj_eval*)
    *(.text*._RNvNtCs*_8clj_eval6macros15maybe_wrap_hint*)
    *(.text*._RINvMs*_NtCs*_9hashbrown3mapINtB*_7HashMapNtNtCs*_5alloc6string6StringTB*_yEINtNtCs*_4core4hash18BuildHasherDefaultNtCs*_10rustc_hash8FxHasherEE3geteECs*_8clj_eval*)
    *(.text*._RNvNtCs*_8clj_eval6vm_ops11effect_ctor*)
    *(.text*._RNvMs*_NtCs*_8clj_eval4evalNtB*_9Evaluator16site_global_miss*)
    *(.text*._RNvMs*_Cs*_8smallvecINtB*_8SmallVecANtNtCs*_9clj_value5value5Valuej4_E21reserve_one_uncheckedCs*_8clj_eval*)
    *(.text*._RNvNtCs*_8clj_eval4vars27native_push_thread_bindings*)
    *(.text*._RNCNvMs*_NtCs*_8clj_eval2vmNtB*_8Compiler11compile_trys*_0B*_*)
    *(.text*._RNvNtCs*_8clj_eval2ns8load_lib*)
    *(.text*._RNvNtCs*_8clj_eval2ns8load_one*)
    *(.text*._RNvNtCs*_8clj_eval2ns13root_resource*)
    *(.text*._RNvMs*_NtCs*_8clj_eval3envNtB*_14SharedRegistry7current*)
    *(.text*._RINvMs*_NtCs*_5alloc3vecINtB*_3VecNtNtCs*_9clj_value5value5ValueE16extend_desugaredINtNtNtNtCs*_4core4iter8adapters6cloned6ClonedINtNtB*_3map3MapINtNtCs*_4rpds4list7IterPtrB*_NtNtNtNtCs*_7archery14shared_pointer4kind4arct5ArcTKEFG_RL0_INtB*_13SharedPointerB*_B*_EERL0_B*_EEECs*_8clj_eval*)
    *(.text*._RNCNvMs*_NtCs*_8clj_eval2vmNtB*_8Compiler6escape0B*_*)
    *(.text*._RNvNtCs*_8clj_eval2ns12native_in_ns*)
    *(.text*._RNvXNtNtCs*_5alloc3vec21spec_from_iter_nestedINtB*_3VecNtNtCs*_9clj_value5value5ValueEINtB*_18SpecFromIterNestedB*_INtNtNtNtCs*_4core4iter8adapters6cloned6ClonedINtNtB*_3map3MapINtNtCs*_4rpds4list7IterPtrB*_NtNtNtNtCs*_7archery14shared_pointer4kind4arct5ArcTKEFG_RL0_INtB*_13SharedPointerB*_B*_EERL0_B*_EEE9from_iterB*_*)
    *(.text*._RINvMs*_NtCs*_9hashbrown3mapINtB*_7HashMapINtNtCs*_5alloc4sync3ArceETNtNtCs*_9clj_value6symbol6SymbolyEINtNtCs*_4core4hash18BuildHasherDefaultNtCs*_10rustc_hash8FxHasherEE6removeeECs*_8clj_eval*)
    *(.text*._RNvNtCs*_8clj_eval2ns11mark_loaded*)
    *(.text*._RNvMNtNtCs*_4rpds3map13hash_trie_mapINtB*_4NodeNtNtCs*_9clj_value5value5ValueuNtNtNtNtCs*_7archery14shared_pointer4kind4arct5ArcTKE6insertB*_*)
    *(.text*._RNvMs*_NtNtNtNtCs*_5alloc11collections5btree3map5entryINtB*_11VacantEntryyNtNtCs*_9clj_value5value5ValueE12insert_entryCs*_8clj_eval*)
    *(.text*._RINvNtCs*_4core3ptr9drop_glueINtNtNtNtCs*_5alloc11collections5btree3set8BTreeSetyEECs*_10clojure_rs*)
    *(.text*._RNvMs*_NtCs*_5alloc4syncINtB*_3ArcNtNtCs*_9clj_value5value7SetDataE9drop_slowB*_*)
    *(.text*._RINvNtCs*_4core3ptr9drop_glueINtNtNtCs*_4rpds3map13hash_trie_map6BucketNtNtCs*_9clj_value5value5ValueuNtNtNtNtCs*_7archery14shared_pointer4kind4arct5ArcTKEEB*_*)
    *(.text*._RINvNtCs*_4core3ptr9drop_glueSTNtNtCs*_9clj_value9extension3VarNtNtB*_5value5ValueEECs*_8clj_eval*)
    *(.text*._RNvMs*_NtCs*_4core3fmtNtB*_9Formatter12pad_integral*)
    *(.text*._RNvXNtCs*_4core3anyNtNtCs*_8clj_eval2io6WriterNtB*_3Any7type_idB*_*)
    *(.text*._RNvNtCs*_8clj_eval8printsys11token_value*)
    *(.text*._RNvNtCs*_9clj_value7multifn10method_for*)
    *(.text*._RNvXs*_NtCs*_4core3fmtRxNtB*_7Display3fmtCs*_9clj_value*)
    *(.text*._RNvMs*_NtNtNtCs*_5alloc2io8buffered9bufwriterINtB*_9BufWriterNtNtNtCs*_3std2io5stdio9StdoutRawE9flush_bufB*_*)
    *(.text*._RINvNtNtNtNtCs*_3std3sys12thread_local6native4lazy7destroyINtNtCs*_4core4cell7RefCellNtNtCs*_9clj_value5value13ShapeRegistryEEB*_*)
    *(.text*._RNvMs*_NtCs*_8clj_eval3envNtB*_14SharedRegistry21resolve_target_and_id*)
    *(.text*._RNvMs*_NtCs*_5alloc7raw_vecNtB*_11RawVecInner11finish_growCs*_12clap_builder*)
    *(.text*._RNvMs*_NtNtCs*_12clap_builder7builder7commandNtB*_7Command17__build_subcommand*)
    *(.text*._RNvMs*_NtCs*_4core3fmtNtB*_9Formatter3pad*)
    *(.text*._RNvXs*_NtCs*_4core3fmtReNtB*_7Display3fmtCs*_12regex_syntax*)
    *(.text*._RNvMs*_NtNtCs*_12clap_builder6parser6parserNtB*_6Parser15resolve_pending*)
    *(.text*._RNvMs*_NtCs*_5alloc7raw_vecINtB*_6RawVecNtNtB*_6string6StringE8grow_oneCs*_3std*)
    *(.text*._RNvMNtNtCs*_12clap_builder6parser11arg_matcherNtB*_10ArgMatcher6remove*)
    *(.text*._RNvMs*_NtCs*_5alloc7raw_vecINtB*_6RawVecRNtNtNtCs*_12clap_builder4util2id2IdE8grow_oneB*_*)
    *(.text*._RNvMs*_NtNtCs*_12clap_builder6parser9validatorNtB*_9Conflicts16gather_conflicts*)
    *(.text*._RINvNtCs*_4core3ptr9drop_glueNtNtNtNtCs*_12clap_builder6parser7matches11arg_matches10ArgMatchesECs*_10clojure_rs*)
    *(.text*._RNvMs*_NtCs*_5alloc4syncINtB*_3ArcDNtNtCs*_4core3any3AnyNtNtB*_6marker4SendNtB*_4SyncEL_E9drop_slowCs*_12clap_builder*)
    *(.text*._RNvNtCs*_8clj_eval2ns4boot*)
    *(.text*._RINvXs*_NtNtNtCs*_3std11collections4hash3mapINtB*_7HashMapNtNtCs*_5alloc6string6StringINtNtB*_4sync3ArcNtNtCs*_9clj_value5class8ClassValEINtNtCs*_4core4hash18BuildHasherDefaultNtCs*_10rustc_hash8FxHasherEEINtNtNtNtB*_4iter6traits7collect12FromIteratorTB*_B*_EE9from_iterINtNtNtB*_8adapters3map3MapINtNtNtB*_5slice4iter4IterReENCNvNtCs*_8clj_eval8classemu15default_imports0EEB*_*)
    *(.text*._RNvXs*_NtNtNtCs*_4core4iter8adapters5chainINtB*_5ChainIB*_IB*_IB*_IB*_IB*_IB*_IB*_IB*_IB*_IB*_IB*_IB*_IB*_IB*_IB*_IB*_IB*_IB*_IB*_IB*_IB*_IB*_INtNtNtB*_5slice4iter4IterTReFG0_QL1_NtNtCs*_8clj_eval4eval9EvaluatorRL0_SNtNtCs*_9clj_value5value5ValueEINtNtB*_6result6ResultB*_NtNtB*_5error11NativeErrorEEEB*_EB*_EB*_EB*_EB*_EB*_EB*_EB*_EB*_EB*_EB*_EB*_EB*_EB*_EB*_EB*_EB*_EB*_EB*_EB*_EB*_EB*_EB*_ENtNtNtB*_6traits8iterator8Iterator9size_hintB*_*)
    *(.text*._RNvXs*_NtNtNtCs*_4core4iter8adapters5chainINtB*_5ChainIB*_IB*_IB*_IB*_IB*_IB*_IB*_IB*_IB*_IB*_IB*_IB*_IB*_IB*_IB*_IB*_IB*_IB*_IB*_IB*_INtNtNtB*_5slice4iter4IterTReFG0_QL1_NtNtCs*_8clj_eval4eval9EvaluatorRL0_SNtNtCs*_9clj_value5value5ValueEINtNtB*_6result6ResultB*_NtNtB*_5error11NativeErrorEEEB*_EB*_EB*_EB*_EB*_EB*_EB*_EB*_EB*_EB*_EB*_EB*_EB*_EB*_EB*_EB*_EB*_EB*_EB*_EB*_EB*_ENtNtNtB*_6traits8iterator8Iterator9size_hintB*_*)
    *(.text*._RNvXs*_NtNtNtCs*_4core4iter8adapters5chainINtB*_5ChainIB*_IB*_IB*_IB*_IB*_IB*_IB*_IB*_IB*_IB*_IB*_IB*_IB*_IB*_INtNtNtB*_5slice4iter4IterTReFG0_QL1_NtNtCs*_8clj_eval4eval9EvaluatorRL0_SNtNtCs*_9clj_value5value5ValueEINtNtB*_6result6ResultB*_NtNtB*_5error11NativeErrorEEEB*_EB*_EB*_EB*_EB*_EB*_EB*_EB*_EB*_EB*_EB*_EB*_EB*_EB*_EB*_ENtNtNtB*_6traits8iterator8Iterator9size_hintB*_*)
    *(.text*._RNvXs*_NtNtNtCs*_4core4iter8adapters5chainINtB*_5ChainIB*_IB*_IB*_IB*_IB*_IB*_IB*_IB*_INtNtNtB*_5slice4iter4IterTReFG0_QL1_NtNtCs*_8clj_eval4eval9EvaluatorRL0_SNtNtCs*_9clj_value5value5ValueEINtNtB*_6result6ResultB*_NtNtB*_5error11NativeErrorEEEB*_EB*_EB*_EB*_EB*_EB*_EB*_EB*_EB*_ENtNtNtB*_6traits8iterator8Iterator9size_hintB*_*)
    *(.text*._RINvMs*_NtCs*_9hashbrown3rawINtB*_8RawTableTNtNtCs*_9clj_value6symbol6SymbolyEE14reserve_rehashNCINvNtB*_3map11make_hasherB*_yINtNtCs*_4core4hash18BuildHasherDefaultNtCs*_10rustc_hash8FxHasherEE0ECs*_8clj_eval*)
    *(.text*._RNvMs*_NtCs*_8clj_eval3envNtB*_9Namespace6intern*)
    *(.text*._RINvMs*_NtCs*_9hashbrown3rawINtB*_8RawTableTINtNtCs*_5alloc4sync3ArceEIB*_NtNtCs*_9clj_value7keyword11KeywordDataEEE14reserve_rehashNCINvNtB*_3map11make_hasherB*_B*_INtNtCs*_4core4hash18BuildHasherDefaultNtCs*_10rustc_hash8FxHasherEE0EB*_*)
    *(.text*._RNvYNCNvNCNvNvMs*_NtCs*_8clj_eval3envNtB*_9Namespace6intern4KEYS0s*_2KW0INtNtNtCs*_4core3ops8function6FnOnceuE9call_onceB*_*)
    *(.text*._RINvMs*_NtNtNtNtCs*_3std3sys12thread_local6native4lazyINtB*_7StorageINtNtCs*_4core4cell7RefCellNtNtCs*_9clj_value5value13ShapeRegistryEuE16get_or_init_slowNvNvB*_14SHAPE_REGISTRY27___rust_std_internal_init_fnEB*_*)
    *(.text*._RNvXs*_NtCs*_9clj_value5valueNtB*_5ValueNtNtCs*_4core5clone5Clone5clone.903*)
    *(.text*._RINvMs*_NtCs*_9hashbrown3mapINtB*_7HashMapINtNtCs*_5alloc4sync3ArceETNtNtCs*_9clj_value6symbol6SymbolyEINtNtCs*_4core4hash18BuildHasherDefaultNtCs*_10rustc_hash8FxHasherEE12contains_keyeECs*_8clj_eval*)
    *(.text*._RNvMs*_NtCs*_8clj_eval3envNtB*_14SharedRegistry6intern*)
    *(.text*._RINvMs*_NtCs*_9hashbrown3rawINtB*_8RawTableTNtNtCs*_9clj_value7keyword7KeyworduEE14reserve_rehashNCINvNtB*_3map11make_hasherB*_uNtNtNtCs*_3std4hash6random11RandomStateE0ECs*_10clj_reader*)
    *(.text*._RNvMs*_NtCs*_9clj_value5valueNtB*_3Map18from_kvs_last_wins*)
    *(.text*._RNvMNtNtCs*_4rpds3map13hash_trie_mapINtB*_4NodeNtNtCs*_9clj_value5value5ValueB*_NtNtNtNtCs*_7archery14shared_pointer4kind4arct5ArcTKE6insertB*_*)
    *(.text*._RNvXs*_NtNtCs*_4core3str7patternReNtB*_7Pattern15is_contained_in*)
    *(.text*._RNvMs*_NtCs*_8clj_eval3envNtB*_14SharedRegistry15root_or_unbound*)
    *(.text*._RNvYNCNvNvMs*_NtCs*_8clj_eval4evalNtB*_9Evaluator11star_ns_var7STAR_NS0INtNtNtCs*_4core3ops8function6FnOnceuE9call_onceB*_*)
    *(.text*._RNvMs*_NtCs*_8clj_eval4evalNtB*_9Evaluator13bound_ns_name*)
    *(.text*._RINvNtCs*_4core3ptr9drop_glueINtNtNtNtCs*_3std11collections4hash3map7HashMapNtNtCs*_5alloc6string6StringTB*_B*_EEECs*_10clj_reader*)
    *(.text*._RINvNtCs*_4core3ptr9drop_glueSNtCs*_10clj_reader8FiredTagEB*_*)
    *(.text*._RNvXs*_NtCs*_5alloc3vecINtB*_3VecNtNtB*_6string6StringENtNtCs*_4core5clone5Clone5cloneCs*_8clj_eval*)
    *(.text*._RNvNtCs*_8clj_eval4core11symbol_keys*)
    *(.text*._RNvNtCs*_10clj_reader6symbol10name_valid*)
    *(.text*._RNvMCs*_10clj_readerNtB*_6Reader17read_number_value*)
    *(.text*._RNvMs*_NtCs*_8clj_eval3envNtB*_14SharedRegistry10qualify_in*)
    *(.text*._RNvNtCs*_8clj_eval4lazy7as_vals*)
    *(.text*._RNvMs*_NtCs*_8clj_eval2vmNtB*_8Compiler17compile_data_form*)
    *(.text*._RNvMs*_NtCs*_8clj_eval3envNtB*_14SharedRegistry7is_lazy*)
    *(.text*._RNvNtCs*_8clj_eval13typeinternals15native_vec_node*)
    *(.text*._RNvNtCs*_8clj_eval13typeinternals10handle_def*)
    *(.text*._RNvYNCNvNvMs*_NtCs*_8clj_eval3envNtB*_17NamespaceRegistry13publics_table2KW0INtNtNtCs*_4core3ops8function6FnOnceuE9call_onceB*_*)
    *(.text*._RINvMs*_NtCs*_9hashbrown3rawINtB*_8RawTableTINtNtCs*_5alloc4sync3ArceEB*_EE14reserve_rehashNCINvNtB*_3map11make_hasherB*_B*_NtNtNtCs*_3std4hash6random11RandomStateE0ECs*_9clj_value*)
    *(.text*._RNvMs*_NtCs*_5alloc4syncINtB*_3ArcINtNtB*_3vec3VecNtNtCs*_9clj_value5value5ValueEE9drop_slowB*_*)
    *(.text*._RNvMs*_NtCs*_5alloc7raw_vecINtB*_6RawVecINtNtB*_4sync3ArcNtNtCs*_9clj_value4host7HostDefEE8grow_oneCs*_8clj_eval*)
    *(.text*._RNvMs*_NtNtCs*_4core3str4iterINtB*_13SplitInternalAcj2_E9next_backCs*_8clj_eval*)
    *(.text*._RNvNtCs*_8clj_eval2ns13push_ns_frame*)
    *(.text*._RNvXNtNtCs*_5alloc3vec21spec_from_iter_nestedINtB*_3VecNtNtCs*_9clj_value5value5ValueEINtB*_18SpecFromIterNestedB*_INtNtNtNtCs*_4core4iter8adapters6cloned6ClonedINtNtB*_3map3MapINtNtCs*_4rpds4list7IterPtrB*_NtNtNtNtCs*_7archery14shared_pointer4kind4arct5ArcTKEFG_RL0_INtB*_13SharedPointerB*_B*_EERL0_B*_EEE9from_iterCs*_8clj_eval*)
    *(.text*._RNvNtCs*_8clj_eval3stm14apply_alter_fn*)
    *(.text*._RNvNtCs*_8clj_eval4coll11native_conj*)
    *(.text*._RNvMs*_NtNtCs*_4rpds3map13hash_trie_mapINtB*_11HashTrieMapNtNtCs*_9clj_value5value5ValueuNtNtNtNtCs*_7archery14shared_pointer4kind4arct5ArcTKINtNtCs*_4core4hash18BuildHasherDefaultNtCs*_10rustc_hash8FxHasherEE10insert_mutB*_*)
    *(.text*._RNvNtCs*_8clj_eval3stm13remove_reader*)
    *(.text*._RINvNtCs*_4core3ptr9drop_glueINtNtCs*_5alloc3vec3VecTyNtNtCs*_9clj_value8ref_kind3RefEEECs*_8clj_eval*)
    *(.text*._RNvNtNtCs*_3std6thread7current12init_current*)
    *(.text*._RNvNtCs*_8clj_eval8printsys10value_meta*)
    *(.text*._RINvNtCs*_4core3ptr9drop_glueNCNvMs*_NtCs*_8clj_eval2vmNtB*_8Compiler12compile_bodys*_0EB*_*)
    *(.text*._RINvNtCs*_4core3ptr9drop_glueNCNvMs*_NtCs*_8clj_eval2vmNtB*_8Compiler11compile_trys*_0EB*_*)
    *(.text*._RINvNtCs*_4core3ptr9drop_glueINtNtNtCs*_5alloc3vec9into_iter8IntoIterINtNtNtCs*_3std6thread11join_handle10JoinHandleuEEECs*_8clj_eval*)
    *(.text*._RNvMs*_NtCs*_8clj_eval6vm_opsINtB*_4CtorNtNtCs*_9clj_value5value5ValueE4codeB*_*)
    *(.text*._RNvXs*_NtNtCs*_5alloc3vec21spec_from_iter_nestedINtB*_3VecNtNtCs*_8clj_eval2vm7OperandEINtB*_18SpecFromIterNestedB*_INtNtNtNtCs*_4core4iter8adapters3map3MapINtNtNtB*_5slice4iter4IterNtNtB*_4expr4ExprENCNvMs*_B*_NtB*_8Compiler17in_place_operands0EE9from_iterB*_*)
    *(.text*._RNvNtCs*_8clj_eval4expr13pattern_names*)
    *(.text*._RNvMs*_NtCs*_5alloc7raw_vecINtB*_6RawVecINtNtCs*_4core6option6OptionINtNtNtB*_3num7nonzero7NonZerojEEE8grow_oneCs*_12regex_syntax*)
    *(.text*._RNvMs*_NtCs*_8clj_eval4exprNtB*_8Analyzer13build_pattern*)
    *(.text*._RNvMs*_NtCs*_8clj_eval2vmNtB*_8Compiler10resolve_at*)
    *(.text*._RNvMs*_NtCs*_5alloc7raw_vecNtB*_11RawVecInner11finish_growCs*_12regex_syntax*)
    *(.text*._RNvMs*_NtCs*_5alloc4syncINtB*_3ArcSNtNtCs*_9clj_value5value5ValueE9drop_slowB*_*)
    *(.text*._RINvYNtNtNtCs*_3std4hash6random11RandomStateNtNtCs*_4core4hash11BuildHasher8hash_oneRPNtNtCs*_8clj_eval4expr4ExprEB*_*)
    *(.text*._RINvMs*_NtCs*_9hashbrown3rawINtB*_8RawTableTPNtNtCs*_8clj_eval4expr4ExpruEE14reserve_rehashNCINvNtB*_3map11make_hasherB*_uNtNtNtCs*_3std4hash6random11RandomStateE0EB*_*)
    *(.text*._RNvNtCs*_8clj_eval4lazy9step_unit*)
    *(.text*._RNvNtCs*_8clj_eval4expr12walk_binding*)
    *(.text*._RNvNtCs*_8clj_eval4seqs10long_range*)
    *(.text*._RNvMs*_NtCs*_8clj_eval4exprNtB*_8Analyzer9finish_fn*)
    *(.text*._RNvXNtCs*_4core3anyNtNtCs*_8clj_eval3ext7ClosureNtB*_3Any7type_idB*_*)
    *(.text*._RINvNtCs*_4core3ptr9drop_glueNCNvMs*_NtCs*_8clj_eval2vmNtB*_8Compiler10compile_fn0EB*_*)
    *(.text*._RNvXNtCs*_8clj_eval3extNtB*_7ClosureNtNtCs*_9clj_value9extension14ExtensionValue6as_any*)
    *(.text*._RNvMs*_NtCs*_8clj_eval2vmNtB*_8Compiler10compile_fn*)
    *(.text*._RNvMs*_NtCs*_8clj_eval2vmNtB*_8Compiler11compile_fun*)
    *(.text*._RNvMs*_NtCs*_5alloc7raw_vecINtB*_6RawVecNtNtCs*_8clj_eval2vm5ScopeE8grow_oneB*_*)
    *(.text*._RNCNvMs*_NtCs*_8clj_eval2vmNtB*_8Compiler10compile_fn0B*_*)
    *(.text*._RNvNtCs*_8clj_eval2vm7capture*)
    *(.text*._RNvMs*_NtCs*_8clj_eval4exprNtB*_8Analyzer9build_fun*)
    *(.text*._RNvMs*_NtCs*_8clj_eval4exprNtB*_8Analyzer10fn_display*)
    *(.text*._RNvNtCs*_8clj_eval2vm13closure_value*)
    *(.text*._RNvNtCs*_8clj_eval2vm9run_arity*)
    *(.text*._RINvNtCs*_4core3ptr9drop_glueNtNtCs*_8clj_eval4expr9RawClauseEB*_*)
    *(.text*._RNvMs*_NtCs*_8clj_eval2vmNtB*_8Prepared5call1*)
    *(.text*._RNvMs*_NtCs*_8clj_eval4exprNtB*_8Analyzer15analyze_arities*)
    *(.text*._RNvNtCs*_8clj_eval4lazy13force_pending*)
    *(.text*._RNvNtCs*_8clj_eval4seqs12native_range*)
    *(.text*._RNvMs*_NtCs*_8clj_eval4lazyNtB*_10PendingSeq12pending_kind*)
    *(.text*._RNvXNtCs*_4core3anyNtNtCs*_8clj_eval4lazy10PendingSeqNtB*_3Any7type_idB*_*)
    *(.text*._RNvXs*_NtCs*_8clj_eval4lazyNtB*_10PendingSeqNtNtCs*_9clj_value9extension14ExtensionValue6as_any*)
    *(.text*._RNvXs*_NtCs*_9clj_value3seqNtB*_8RangeNumNtNtCs*_4core5clone5Clone5clone*)
    *(.text*._RINvNtCs*_4core3ptr9drop_glueNtNtCs*_8clj_eval4lazy5ThunkEB*_*)
    *(.text*._RINvNtCs*_4core3ptr9drop_glueNtNtCs*_8clj_eval4lazy10PendingSeqEB*_*)
    *(.text*._RNvNtCs*_8clj_eval4lazy10long_range*)
    *(.text*._RNvXNtCs*_4core3anyNtNtCs*_9clj_value3seq10RangeValueNtB*_3Any7type_idB*_*)
    *(.text*._RINvNtCs*_4core3ptr9drop_glueNtNtCs*_9clj_value3seq10RangeValueECs*_8clj_eval*)
    *(.text*._RINvNtCs*_4core3ptr9drop_glueNtNtCs*_8clj_eval4lazy8SeqStateEB*_*)
    *(.text*._RINvNtCs*_4core3ptr9drop_glueTNtNtCs*_9clj_value3seq8RangeNumB*_INtNtB*_6option6OptionxEEECs*_8clj_eval*)
    *(.text*._RNvNtCs*_8clj_eval4core9check_ifn*)
    *(.text*._RNvNtCs*_8clj_eval4lazy8step_map*)
    *(.text*._RNvXs*_NtCs*_9clj_value3seqNtB*_10RangeValueNtNtB*_9extension14ExtensionValue6as_any*)
    *(.text*._RINvNtCs*_4core3ptr9drop_glueNtNtCs*_9clj_value3seq3SeqECs*_8clj_eval*)
    *(.text*._RINvNtCs*_4core3ptr9drop_glueNtNtCs*_9clj_value3seq11RealizedSeqECs*_8clj_eval*)
    *(.text*._RNvNtCs*_8clj_eval4lazy9seq_value*)
    *(.text*._RINvNtCs*_8clj_eval6vm_ops6shape1NtB*_5CountNtB*_7AsValueEB*_*)
    *(.text*._RNvXs*_NtCs*_9clj_value3seqNtB*_11RealizedSeqNtNtB*_9extension14ExtensionValue6as_any*)
    *(.text*._RNvXNtCs*_4core3anyNtNtCs*_9clj_value3seq11RealizedSeqNtB*_3Any7type_idB*_*)
    *(.text*._RNvNtCs*_8clj_eval4seqs10native_map*)
    *(.text*._RNvXs*_NtNtNtCs*_4core3fmt3num3impyNtB*_7Display3fmt*)
    *(.text*._RNvMs*_NtCs*_8clj_eval4exprNtB*_8Analyzer18collect_fn_clauses*)
    *(.text*._RNvNtCs*_8clj_eval13vm_intrinsics8count_of*)
    *(.text*._RNvNtCs*_8clj_eval4lazy11collect_all*)
    *(.text*._RNvMs*_NtCs*_8clj_eval4exprNtB*_8Analyzer19parse_clause_slices*)
    *(.text*._RINvNtCs*_4core3ptr9drop_glueINtNtB*_6option6OptionNtNtCs*_8clj_eval2vm6VmCodeEEB*_*)
    *(.text*._RNvNtCs*_8clj_eval7vm_live12has_defaults*)
    *(.text*._RNvNtCs*_8clj_eval4core6as_num*)
    *(.text*._RNvMs*_NtCs*_9clj_value3seqNtB*_3Seq4next*)
    *(.text*._RNvNtCs*_8clj_eval4expr18spec_valid_binding*)
    *(.text*._RNvMs*_NtCs*_8clj_eval4exprNtB*_8Analyzer14parse_fn_front*)
    *(.text*._RNvNtCs*_8clj_eval4expr13pattern_count*)
    *(.text*._RINvNtCs*_4core3ptr9drop_glueNtNtCs*_8clj_eval3ext7ClosureEB*_*)
    *(.text*._RNvMs*_NtCs*_9clj_value3seqNtB*_3Seq5eager*)
    *(.text*._RINvNtCs*_4core3ptr9drop_glueTNtNtCs*_8clj_eval4expr7PatternNtB*_4ExprEEB*_*)
    *(.text*._RINvNtCs*_4core3ptr9drop_glueNtNtCs*_8clj_eval2vm7LetStepEB*_*)
    *(.text*._RNvMs*_NtCs*_5alloc4syncINtB*_3ArcSNtNtCs*_8clj_eval4expr5ArityE9drop_slowB*_*)
    *(.text*._RINvNtCs*_4core3ptr9drop_glueNtNtCs*_8clj_eval4expr7PatternEB*_*)
    *(.text*._RNvNtCs*_8clj_eval4lazy8step_seq*)
    *(.text*._RNvMs*_NtCs*_9clj_value3seqNtB*_3Seq10chunk_next*)
    *(.text*._RNvNtCs*_8clj_eval4lazy13step_realized*)
    *(.text*._RINvNtCs*_4core3ptr9drop_glueNtNtCs*_8clj_eval2vm11CompiledFunEB*_*)
    *(.text*._RNvMs*_NtCs*_5alloc4syncINtB*_3ArcNtNtCs*_8clj_eval2vm11CompiledFunE9drop_slowB*_*)
    *(.text*._RINvNtCs*_4core3ptr9drop_glueNtNtCs*_8clj_eval4expr5ArityEB*_*)
    *(.text*._RINvNtCs*_4core3ptr9drop_glueNtNtCs*_8clj_eval2vm13CompiledArityEB*_*)
    *(.text*._RNCNvNtCs*_8clj_eval4seqs19native_reduce_owned0B*_*)
    *(.text*._RNvNtCs*_8clj_eval4seqs19native_reduce_owned*)
    *(.text*._RNCNvNtCs*_8clj_eval2vm10take_local0B*_*)
    *(.text*._RNvNtCs*_8clj_eval6vm_ops6native*)
    *(.text*._RINvNtCs*_4core3ptr9drop_glueNCINvNtCs*_8clj_eval6vm_ops2x1NtB*_10DoubleCastNtB*_7AsValueE0EB*_*)
    *(.text*._RNvMs*_NtCs*_8clj_eval4exprNtB*_8Analyzer15analyze_vec_lit*)
    *(.text*._RNvMs*_NtCs*_5alloc4syncINtB*_3ArcNtNtCs*_9clj_value5value10VectorDataE8make_mutB*_*)
    *(.text*._RNvNtCs*_8clj_eval2vm11call_native*)
    *(.text*._RNvNtCs*_8clj_eval4lazy16step_range_value*)
    *(.text*._RNvNtCs*_8clj_eval8printsys11seq_default*)
    *(.text*._RNvNtCs*_8clj_eval8printsys15write_seq_items*)
    *(.text*._RNvMs*_NtCs*_8clj_eval2vmNtB*_8Compiler12compile_test*)
    *(.text*._RNvNtCs*_8clj_eval4lazy14realized_value*)
    *(.text*._RNvXs*_NtCs*_8clj_eval4lazyNtB*_10PendingSeqNtNtCs*_9clj_value9extension14ExtensionValue10as_any_mut*)
    *(.text*._RNvNtCs*_8clj_eval6macros12native_apply*)
    *(.text*._RNvNtCs*_8clj_eval8printsys14write_seq_body*)
    *(.text*._RNCNvMs*_NtCs*_8clj_eval2vmNtB*_8Compiler11compile_vecs*_0B*_*)
    *(.text*._RINvNtCs*_4core3ptr9drop_glueNCNvMs*_NtCs*_8clj_eval2vmNtB*_8Compiler11compile_sets*_0EB*_*)
    *(.text*._RINvNtCs*_4core3ptr9drop_glueNCINvNtCs*_8clj_eval6vm_ops2ssNtB*_2UpNtB*_3KstNtB*_10ConjBangFxNtB*_7AsValueE0EB*_*)
    *(.text*._RINvNtCs*_4core3ptr9drop_glueNCINvNtCs*_8clj_eval6vm_ops2s1NtB*_2UpNtB*_10DoubleCastNtB*_7AsValueE0EB*_*)
    *(.text*._RNCINvNtCs*_8clj_eval6vm_ops2x1NtB*_5CountNtB*_7AsValueE0B*_*)
    *(.text*._RNvNtCs*_8clj_eval4core8str_push*)
    *(.text*._RNvMNtCs*_10clj_reader8metaformNtB*_6Reader9fn_reader*)
    *(.text*._RNvXs*_NtNtNtCs*_4core3fmt3num3implNtB*_7Display3fmt*)
    *(.text*._RNvNtCs*_9clj_value6hasheq14realized_items*)
    *(.text*._RNvMs*_NtNtNtCs*_5alloc11collections5btree3mapINtB*_8IntoIterlNtNtCs*_9clj_value6symbol6SymbolE10dying_nextCs*_10clojure_rs*)
    *(.text*._RNvMs*_NtCs*_9clj_value5valueNtB*_3Map9with_meta*)
    *(.text*._RNvNtCs*_10clj_reader8metaform4garg*)
    *(.text*._RNvMs*_NtCs*_8clj_eval4exprNtB*_8Analyzer16check_star_param*)
    *(.text*._RNvXs*_NtCs*_5alloc5boxedINtB*_3BoxSNtNtCs*_9clj_value5value5ValueENtNtCs*_4core5clone5Clone5cloneB*_*)
    *(.text*._RNvMs*_NtCs*_9clj_value5valueNtB*_6Vector9with_meta*)
    *(.text*._RNvXs*_NtCs*_8clj_eval3envNtB*_13VarAlterGuardNtNtNtCs*_4core3ops4drop4Drop4drop*)
    *(.text*._RNvNtCs*_8clj_eval4core16native_str_owned*)
    *(.text*._RNvNtCs*_8clj_eval4coll6assoc3*)
    *(.text*._RNvXs*_NtCs*_9clj_value3seqNtB*_11RealizedSeqNtNtB*_9extension14ExtensionValue10class_name*)
    *(.text*._RNvNtCs*_8clj_eval8printsys13seq_ext_token*)
    *(.text*._RNvNtCs*_8clj_eval4coll18native_assoc_owned*)
    *(.text*._RINvNtCs*_4core3ptr9drop_glueNtNtCs*_9clj_value3seq3SeqEB*_*)
    *(.text*._RINvNtCs*_4core3ptr9drop_glueNCNvMs*_NtCs*_8clj_eval2vmNtB*_8Compiler14compile_invokes*_0EB*_*)
    *(.text*._RNvNtCs*_8clj_eval4coll8count_of*)
    *(.text*._RINvNtCs*_8clj_eval6vm_ops6shape1NtB*_5FirstNtB*_7AsValueEB*_*)
    *(.text*._RNvNtCs*_8clj_eval4coll10into_inner*)
    *(.text*._RNvMs*_NtCs*_9clj_value3seqNtB*_11RealizedSeq5items*)
    *(.text*._RNvXs*_NtCs*_9clj_value3seqNtB*_3SeqNtNtCs*_4core5clone5Clone5clone.939*)
    *(.text*._RNCNvMs*_NtCs*_8clj_eval2vmNtB*_8Compiler14compile_invokes*_0B*_*)
    *(.text*._RNvNtCs*_8clj_eval4coll18native_count_owned*)
    *(.text*._RNvMs*_NtCs*_8clj_eval4exprNtB*_8Analyzer17analyze_map_pairs*)
    *(.text*._RNvMs*_NtCs*_8clj_eval3envNtB*_12VarAlterLock7acquire*)
    *(.text*._RNvNtCs*_8clj_eval6vm_ops7native1*)
    *(.text*._RNvMs*_NtCs*_9clj_value5valueNtB*_6Vector3get.944*)
    *(.text*._RINvNtCs*_8clj_eval6vm_ops6shape2NtB*_3MulNtB*_7AsValueEB*_*)
    *(.text*._RNvMs*_NtCs*_8clj_eval3envNtB*_14SharedRegistry21ns_live_or_removed_id*)
    *(.text*._RNvNtCs*_8clj_eval9core_lazy10force_meta*)
    *(.text*._RNvNtCs*_8clj_eval11core_macros14seq_form_items*)
    *(.text*._RNvNtCs*_8clj_eval4lazy9step_head*)
    *(.text*._RNvMs*_NtCs*_9clj_value5valueNtB*_4List10drop_first*)
    *(.text*._RNvNtCs*_8clj_eval4vars17native_alter_meta*)
    *(.text*._RNvMs*_NtCs*_8clj_eval3envNtB*_14SharedRegistry11meta_cloned*)
    *(.text*._RNvNtCs*_8clj_eval4vars16install_ref_meta*)
    *(.text*._RNvNtCs*_8clj_eval11core_macros11expand_defn*)
    *(.text*._RNvNtCs*_9clj_value5value9map_entry*)
    *(.text*._RNvNtCs*_9clj_value5print12print_string*)
    *(.text*._RNvNtCs*_8clj_eval4vars13as_ref_target*)
    *(.text*._RNvNtCs*_8clj_eval4coll12native_assoc*)
    *(.text*._RNvNtCs*_8clj_eval7emucoll13list_snapshot*)
    *(.text*._RNvNtCs*_8clj_eval4lazy18is_collectable_seq*)
    *(.text*._RINvNtCs*_4core3ptr9drop_glueNtNtCs*_8clj_eval4vars9RefTargetEB*_*)
    *(.text*._RNvNtCs*_8clj_eval4core4fold*)
    *(.text*._RNCNvMs*_NtCs*_8clj_eval2vmNtB*_8Compiler10compile_if0B*_*)
    *(.text*._RNvXs*_NtCs*_4core3fmtRNtNtCs*_9clj_value7keyword7KeywordNtB*_7Display3fmtB*_*)
    *(.text*._RNvMs*_NtCs*_9clj_value5valueNtB*_6Vector3get*)
    *(.text*._RNvNtCs*_8clj_eval4lazy9as_repeat*)
    *(.text*._RINvNtCs*_4core3ptr9drop_glueNtNtCs*_8clj_eval6vm_ops4CollEB*_*)
    *(.text*._RINvNtCs*_4core3ptr9drop_glueNtNtCs*_8clj_eval3env8BindingsEB*_*)
    *(.text*._RNvNtCs*_8clj_eval2vm10eval_pairs*)
    *(.text*._RNvNtCs*_8clj_eval4lazy7seq_map*)
    *(.text*._RNvNtCs*_8clj_eval4lazy10next_value*)
    *(.text*._RNvNtCs*_8clj_eval2vm10call_value*)
    *(.text*._RNvNtCs*_8clj_eval6vm_ops11int_test_op*)
    *(.text*._RNvNtCs*_8clj_eval4lazy11first_value*)
    *(.text*._RNvNtCs*_8clj_eval4lazy12as_subvector*)
    *(.text*._RNvNtCs*_8clj_eval9core_lazy5force*)
    *(.text*._RNvMs*_NtCs*_8clj_eval2vmNtB*_8Compiler12compile_loop*)
    *(.text*._RNvNtCs*_8clj_eval9core_lazy10eval_group*)
    *(.text*._RNvNtCs*_8clj_eval6vm_ops12int_value_op*)
    *(.text*._RNvXs*_NtNtCs*_5alloc3vec21spec_from_iter_nestedINtB*_3VecTINtNtB*_5boxed3BoxDG1_INtNtNtCs*_4core3ops8function2FnTQL2_NtNtCs*_8clj_eval4eval9EvaluatorQL1_INtNtB*_2vm5FrameL0_EEEp6OutputINtNtB*_6result6ResultNtNtCs*_9clj_value5value5ValueNtNtB*_5error6SignalENtNtB*_6marker4SendNtB*_4SyncEL_EB*_EEINtB*_18SpecFromIterNestedB*_INtNtNtNtB*_4iter8adapters3map3MapINtNtNtB*_5slice4iter4IterTNtNtB*_4expr4ExprB*_EENCNvMs*_B*_NtB*_8Compiler13compile_pairs0EE9from_iterB*_*)
    *(.text*._RINvNtCs*_4core3ptr9drop_glueINtNtCs*_5alloc3vec3VecTNtNtCs*_9clj_value5value5ValueB*_EEECs*_8clj_eval*)
    *(.text*._RINvNtCs*_8clj_eval6vm_ops6shape2NtB*_2LtNtB*_6AsTestEB*_*)
    *(.text*._RNvNtCs*_8clj_eval4core9num_value*)
    *(.text*._RNvNtCs*_8clj_eval4lazy10as_iterate*)
    *(.text*._RINvNtCs*_8clj_eval6vm_ops3updNtB*_5AssocEB*_*)
    *(.text*._RNvNtCs*_8clj_eval4lazy8as_cycle*)
    *(.text*._RINvNtCs*_8clj_eval6vm_ops6shape2NtB*_3ModNtB*_7AsValueEB*_*)
    *(.text*._RNvMs*_NtCs*_8clj_eval4evalNtB*_9Evaluator19call_direct_general*)
    *(.text*._RINvNtCs*_4core3ptr9drop_glueINtNtCs*_5alloc3vec3VecNtNtCs*_8clj_eval6vm_ops4SiteEEB*_*)
    *(.text*._RNvMs*_NtCs*_8clj_eval9vm_scalarNtB*_7Builder4node*)
    *(.text*._RNvMs*_NtCs*_5alloc3vecINtB*_3VecNtNtCs*_8clj_eval9vm_scalar6EffectE16into_boxed_sliceB*_*)
    *(.text*._RINvNtCs*_4core3ptr9drop_glueNtNtCs*_8clj_eval9vm_scalar4NodeEB*_*)
    *(.text*._RINvNtCs*_4core3ptr9drop_glueTINtNtCs*_5alloc5boxed3BoxDG1_INtNtNtB*_3ops8function2FnTQL2_NtNtCs*_8clj_eval4eval9EvaluatorQL1_INtNtB*_2vm5FrameL0_EEEp6OutputINtNtB*_6result6ResultNtNtCs*_9clj_value5value5ValueNtNtB*_5error6SignalENtNtB*_6marker4SendNtB*_4SyncEL_EB*_EEB*_*)
    *(.text*._RNvMs*_NtCs*_9clj_value5valueNtB*_3Map20with_ordered_entries*)
    *(.text*._RINvNtCs*_4core3ptr9drop_glueNtNtCs*_8clj_eval9vm_scalar5IExprEB*_*)
    *(.text*._RNvNtCs*_8clj_eval6macros11native_list*)
    *(.text*._RNvMs*_NtCs*_8clj_eval4evalNtB*_9Evaluator13invoke_direct*)
    *(.text*._RNvNtCs*_8clj_eval4seqs13native_concat*)
    *(.text*._RNvNtCs*_8clj_eval9vm_scalar10productive*)
    *(.text*._RNvNtCs*_8clj_eval4lazy12native_first*)
    *(.text*._RNvMs*_NtCs*_8clj_eval9vm_scalarNtB*_7Builder4cond*)
    *(.text*._RNvNtCs*_8clj_eval9vm_scalar11cond_misses*)
    *(.text*._RINvNtCs*_4core3ptr9drop_glueINtNtNtCs*_5alloc3vec9into_iter8IntoIterTNtNtCs*_9clj_value5value5ValueB*_EEECs*_8clj_eval*)
    *(.text*._RNvNtCs*_8clj_eval6macros13native_vector*)
    *(.text*._RNvMs*_NtCs*_8clj_eval9vm_scalarNtB*_7Builder4body*)
    *(.text*._RNvMs*_NtCs*_8clj_eval9vm_scalarNtB*_7Builder6effect*)
    *(.text*._RNvNtNtCs*_4core5slice6memchr14memchr_aligned*)
    *(.text*._RINvNtCs*_4core3ptr9drop_glueINtNtCs*_5alloc3vec3VecTNtNtCs*_9clj_value5value5ValueB*_EEEB*_*)
    *(.text*._RNvMs*_NtCs*_8clj_eval9vm_scalarNtB*_7Builder4leaf*)
    *(.text*._RNvMs*_NtCs*_8clj_eval9vm_scalarNtB*_7Builder9test_call*)
    *(.text*._RNvMs*_NtCs*_8clj_eval3envNtB*_14SharedRegistry6lookup*)
    *(.text*._RINvNtCs*_4core3ptr9drop_glueNtNtCs*_8clj_eval9vm_scalar4CondEB*_*)
    *(.text*._RINvNtCs*_4core3ptr9drop_glueINtNtCs*_5alloc5boxed3BoxSNtNtCs*_8clj_eval9vm_scalar6EffectEEB*_*)
    *(.text*._RNvNtCs*_8clj_eval4coll13map_conj_plan*)
    *(.text*._RNvMs*_NtCs*_8clj_eval9vm_scalarNtB*_7Builder4expr*)
    *(.text*._RNvNtCs*_8clj_eval4coll13conj_map_into*)
    *(.text*._RINvNtCs*_4core3ptr9drop_glueINtNtNtNtB*_4iter8adapters3map3MapNtNtCs*_9clj_value5value7MapIterNCNCNvMs*_NtCs*_8clj_eval4evalNtB*_9Evaluator12def_var_meta00EEB*_*)
    *(.text*._RNvMs*_NtCs*_9clj_value5valueNtB*_3Map9with_sort*)
    *(.text*._RNCNvMs*_NtCs*_8clj_eval2vmNtB*_8Compiler11compile_maps*_0B*_*)
    *(.text*._RNvNtCs*_8clj_eval8fx4_form2gs*)
    *(.text*._RNvNtCs*_8clj_eval4coll17native_into_owned*)
    *(.text*._RNvMNtCs*_10clj_reader4collNtB*_6Reader10set_reader*)
    *(.text*._RNvNtCs*_8clj_eval4core10native_inc*)
    *(.text*._RNvNtCs*_8clj_eval4lazy13as_cons_value*)
    *(.text*._RNvNtCs*_8clj_eval4core7inc_one*)
    *(.text*._RINvNtCs*_4core3ptr9drop_glueNCINvNtCs*_8clj_eval6vm_ops2ssNtB*_2UpB*_NtB*_10ConjBangFxNtB*_7AsValueE0EB*_*)
    *(.text*._RNvXs*_NtCs*_9clj_value5valueNtB*_10VectorDataNtNtCs*_4core5clone5Clone5clone*)
    *(.text*._RNvNtCs*_8clj_eval4lazy10first_fast*)
    *(.text*._RNvMs*_NtCs*_8clj_eval4evalNtB*_9Evaluator13eval_defmacro*)
    *(.text*._RNvNtCs*_8clj_eval4eval9rest_list*)
    *(.text*._RNvMs*_NtCs*_8clj_eval4evalNtB*_9Evaluator9eval_body*)
    *(.text*._RINvNtCs*_4core3ptr9drop_glueINtNtCs*_5alloc3vec3VecNtNtCs*_8clj_eval9vm_scalar6EffectEEB*_*)
    *(.text*._RNvXs*_NtNtCs*_5alloc3vec21spec_from_iter_nestedINtB*_3VecRSRNtNtCs*_9clj_value5value5ValueEINtB*_18SpecFromIterNestedB*_INtNtNtNtCs*_4core4iter8adapters3map3MapINtNtNtB*_5slice4iter4IterIB*_B*_EENvMs*_B*_B*_8as_sliceEE9from_iterCs*_8clj_eval*)
    *(.text*._RNvMs*_NtCs*_8clj_eval4evalNtB*_9Evaluator19apply_closure_frame*)
    *(.text*._RNvMs*_NtCs*_8clj_eval4evalNtB*_9Evaluator12bind_pattern*)
    *(.text*._RNvNtCs*_8clj_eval4coll6merge2*)
    *(.text*._RNvNtCs*_8clj_eval4lazy20realize_pending_deep*)
    *(.text*._RNvMs*_NtCs*_9clj_value5valueNtB*_3Map10with_hashy*)
    *(.text*._RNvMs*_NtCs*_8clj_eval4evalNtB*_9Evaluator11apply_arity*)
    *(.text*._RNvXs*_NtCs*_8clj_eval2vmNtB*_8CompilerNtNtB*_9vm_scalar4Host13resolve_local*)
    *(.text*._RINvNtCs*_4core3ptr9drop_glueINtNtCs*_5alloc3vec3VecNtNtCs*_8clj_eval4expr9RawClauseEEB*_*)
    *(.text*._RNvMs*_NtCs*_5alloc4syncINtB*_3ArcNtNtCs*_8clj_eval3env5FrameE9drop_slowB*_*)
    *(.text*._RNvMs*_NtCs*_8clj_eval4evalNtB*_9Evaluator11bind_values*)
    *(.text*._RNvNtCs*_8clj_eval4lazy11step_filter*)
    *(.text*._RNvNtCs*_8clj_eval4core15is_lazy_seq_str*)
    *(.text*._RNvYNCNvNvMs*_NtCs*_8clj_eval4evalNtB*_9Evaluator12def_var_meta2KW0INtNtNtCs*_4core3ops8function6FnOnceuE9call_onceB*_*)
    *(.text*._RNvNtCs*_8clj_eval4coll12native_merge*)
    *(.text*._RNvMs*_NtCs*_8clj_eval4evalNtB*_9Evaluator13apply_closure*)
    *(.text*._RNvMs*_NtCs*_8clj_eval4evalNtB*_9Evaluator19apply_closure_inner*)
    *(.text*._RNvNtCs*_8clj_eval4core10str_of_one*)
    *(.text*._RNvNtCs*_9clj_value5print7lift_ns*)
    *(.text*._RNvMs*_NtCs*_8clj_eval3envNtB*_3Env6extend*)
    *(.text*._RNvNtCs*_8clj_eval8printsys15write_map_items*)
    *(.text*._RINvNtCs*_4core3ptr9drop_glueINtNtCs*_5alloc3vec3VecIB*_NtNtCs*_12regex_syntax3ast4SpanEEEB*_*)
    *(.text*._RNvXs*_NtCs*_5alloc6stringNtB*_6StringNtNtCs*_4core3fmt5Write10write_char.898*)
    *(.text*._RNvNtCs*_8clj_eval4core9nth_index*)
    *(.text*._RINvNtCs*_4core3ptr9drop_glueNCINvNtCs*_8clj_eval6vm_ops2sxNtB*_3KstNtB*_10ConjBangFxNtB*_7AsValueE0EB*_*)
    *(.text*._RNvNtCs*_8clj_eval6vm_ops7native2*)
    *(.text*._RINvNtCs*_8clj_eval6vm_ops6shape2NtB*_3AddNtB*_7AsValueEB*_*)
    *(.text*._RNvNtCs*_8clj_eval4core3add*)
    *(.text*._RINvNtCs*_4core3ptr9drop_glueNCNvMs*_NtCs*_8clj_eval2vmNtB*_8Compiler11compile_maps*_0EB*_*)
    *(.text*._RNvNtCs*_8clj_eval4lazy15step_entry_unit*)
    *(.text*._RNvXNtNtCs*_5alloc3vec21spec_from_iter_nestedINtB*_3VecNtNtCs*_9clj_value5value5ValueEINtB*_18SpecFromIterNestedB*_INtCs*_8smallvec5DrainAB*_j4_EE9from_iterCs*_8clj_eval*)
    *(.text*._RINvMs*_NtCs*_5alloc4syncINtB*_3ArcSNtNtCs*_9clj_value5value5ValueE15from_iter_exactINtNtNtNtCs*_4core4iter8adapters6cloned6ClonedINtNtNtB*_5slice4iter4IterB*_EEECs*_8clj_eval*)
    *(.text*._RNvNtCs*_8clj_eval11core_macros7do_body*)
    *(.text*._RNvNtCs*_8clj_eval4core10native_add*)
    *(.text*._RNvNtCs*_8clj_eval4lazy10rest_value*)
    *(.text*._RNvNtCs*_8clj_eval4core14native_vectorp*)
    *(.text*._RNvMs*_NtCs*_9clj_value5valueNtB*_6Vector14from_flat_ints*)
    *(.text*._RNvMs*_NtCs*_9clj_value9transientNtB*_15TransientVector10persistent*)
    *(.text*._RNvMs*_NtCs*_9clj_value9transientNtB*_14TransientItems3put*)
    *(.text*._RNCINvNtCs*_8clj_eval6vm_ops2s1NtB*_3RegNtB*_5CountNtB*_7AsValueE0B*_*)
    *(.text*._RNvMs*_NtCs*_5alloc4syncINtB*_3ArcINtNtB*_3vec3VecxEE8make_mutCs*_9clj_value*)
    *(.text*._RNCNvNtCs*_9clj_value6hasheq26extension_hash_unsupported0B*_*)
    *(.text*._RNvNtCs*_8clj_eval4lazy10seq_vector*)
    *(.text*._RNvMs*_NtCs*_9clj_value5valueNtB*_6Vector9push_back*)
    *(.text*._RNvNtCs*_8clj_eval4lazy21realize_realized_deep*)
    *(.text*._RINvNtCs*_8clj_eval6vm_ops6shape1NtB*_3IncNtB*_7AsValueEB*_*)
    *(.text*._RNCINvNtCs*_8clj_eval6vm_ops4upd3NtB*_5AssocE0B*_*)
    *(.text*._RINvNtCs*_4core3ptr9drop_glueNCINvNtCs*_8clj_eval6vm_ops4upd3NtB*_3PopE0EB*_*)
    *(.text*._RNvXs*_NtCs*_5alloc3vecINtB*_3VecNtNtCs*_9clj_value5value5ValueENtNtCs*_4core5clone5Clone5cloneB*_*)
    *(.text*._RNvMs*_NtCs*_9clj_value5valueNtB*_3Set6insert*)
    *(.text*._RNvMs*_NtCs*_5alloc4syncINtB*_3ArcNtNtCs*_9clj_value4trie4PVecE8make_mutB*_*)
    *(.text*._RINvNtCs*_4core3ptr9drop_glueINtNtCs*_5alloc3vec3VecINtNtB*_6option6OptionNtNtCs*_8clj_eval9vm_scalar5IExprEEEB*_*)
    *(.text*._RNvNtCs*_10clj_reader8metaform10quote_list*)
    *(.text*._RNvNtCs*_8clj_eval2re8cut_kind*)
    *(.text*._RINvMs*_NtNtNtNtCs*_3std3sys12thread_local6native4lazyINtB*_7StorageINtNtCs*_4core4cell7RefCellINtNtNtNtB*_11collections4hash3map7HashMapNtNtCs*_5alloc6string6StringINtNtB*_4sync3ArcNtNtNtCs*_5regex5regex6string5RegexEINtNtB*_4hash18BuildHasherDefaultNtCs*_10rustc_hash8FxHasherEEEuE16get_or_init_slowNvNvNvNtCs*_8clj_eval2re14compile_source8COMPILED27___rust_std_internal_init_fnEB*_*)
    *(.text*._RINvNtCs*_4core3ptr9drop_glueNtNtNtCs*_12regex_syntax3ast5parse6ParserECs*_14regex_automata*)
    *(.text*._RNvXs*_NtNtCs*_12regex_syntax3hir9translateNtB*_11TranslatorINtNtNtB*_3ast7visitor7Visitor10visit_post*)
    *(.text*._RNvMs*_NtNtCs*_12regex_syntax3hir7literalNtB*_3Seq5union*)
    *(.text*._RNvMs*_NtCs*_3std4pathNtB*_7PathBuf3pop*)
    *(.text*._RINvNtCs*_4core3ptr9drop_glueSNtNtCs*_12regex_syntax3hir3HirECs*_14regex_automata*)
    *(.text*._RNvXs*_NtCs*_12regex_syntax3hirNtB*_3HirNtNtNtCs*_4core3ops4drop4Drop4drop*)
    *(.text*._RINvNtCs*_4core3ptr9drop_glueNtNtCs*_12regex_syntax3ast3AstECs*_14regex_automata*)
    *(.text*._RNvXs*_NtCs*_12regex_syntax3astNtB*_3AstNtNtNtCs*_4core3ops4drop4Drop4drop*)
    *(.text*._RNvXNtNtCs*_5alloc3vec21spec_from_iter_nestedINtB*_3VecTRNtNtCs*_9clj_value5value5ValueB*_EEINtB*_18SpecFromIterNestedB*_NtB*_7MapIterE9from_iterCs*_8clj_eval*)
    *(.text*._RINvNtCs*_4core3ptr9drop_glueNCINvMs*_NtNtCs*_14regex_automata4meta5regexNtB*_7Builder19build_many_from_hirNtNtCs*_12regex_syntax3hir3HirEs*_0EB*_*)
    *(.text*._RNvMNtCs*_10clj_reader8metaformNtB*_6Reader12syntax_quote*)
    *(.text*._RNvMs*_NtNtCs*_12regex_syntax3ast5parseINtB*_7ParserIQNtB*_6ParserE4charB*_*)
    *(.text*._RNvMs*_NtCs*_3std4pathNtB*_10Components7as_path*)
    *(.text*._RNvXs*_NtCs*_3std4pathNtB*_10ComponentsNtNtNtNtCs*_4core4iter6traits8iterator8Iterator4next*)
    *(.text*._RNvXs*_NtCs*_3std4pathNtB*_9ComponentNtNtCs*_4core3cmp9PartialEq2eq*)
    *(.text*._RNvXs*_NtCs*_3std2fsRNtB*_4FileNtNtNtCs*_5alloc2io4read4Read14read_to_string*)
    *(.text*._RNvNtNtNtNtCs*_3std3sys2io5error4unix14is_interrupted.2528*)
    *(.text*._RNvMs*_NtNtNtCs*_14regex_automata4util4pool5innerINtB*_4PoolNtNtNtB*_4meta5regex5CacheINtNtCs*_5alloc5boxed3BoxDINtNtNtCs*_4core3ops8function2FnuEp6OutputB*_NtNtNtB*_5panic11unwind_safe13RefUnwindSafeNtNtB*_6marker4SendNtB*_4SyncNtB*_10UnwindSafeEL_EE8get_slowCs*_8clj_eval*)
    *(.text*._RNvNtCs*_8clj_eval4lazy10chain_tail*)
    *(.text*._RNvNtCs*_8clj_eval4core11native_seqp*)
    *(.text*._RNvMs*_NtCs*_8clj_eval4exprNtB*_8Analyzer9synth_var*)
    *(.text*._RNvMs*_NtNtCs*_12regex_syntax3ast5parseINtB*_7ParserIQNtB*_6ParserE4bumpB*_*)
    *(.text*._RNvMs*_NtCs*_12regex_syntax3astNtB*_6Concat8into_ast*)
    *(.text*._RNvMs*_NtNtCs*_12regex_syntax3ast5parseINtB*_11NestLimiterQNtB*_6ParserE5checkB*_*)
    *(.text*._RNvMs*_NtCs*_5alloc7raw_vecINtB*_6RawVecNtNtCs*_12regex_syntax3hir10PropertiesE8grow_oneCs*_14regex_automata*)
    *(.text*._RINvNvMs*_NtCs*_5alloc7raw_vecINtB*_11RawVecInnerpE7reserve21do_reserve_and_handleNtNtB*_5alloc6GlobalECs*_14regex_automata*)
    *(.text*._RNvMs*_NtCs*_5alloc7raw_vecINtB*_6RawVecNtNtNtNtCs*_14regex_automata3nfa8thompson10range_trie10TransitionE8grow_oneB*_*)
    *(.text*._RNvNtCs*_3std2fs24buffer_capacity_required*)
    *(.text*._RNvNtNtCs*_3std3sys2fs6exists*)
    *(.text*._RNvNtCs*_8clj_eval5types11lookup_root*)
    *(.text*._RINvNtCs*_4core3ptr9drop_glueNtNtNtCs*_5regex5regex6string5RegexECs*_8clj_eval*)
    *(.text*._RNvMs*_NtCs*_5alloc4syncINtB*_3ArcNtNtNtCs*_14regex_automata4meta5regex10RegexInfoIE9drop_slowB*_*)
    *(.text*._RINvNtCs*_4core3ptr9drop_glueNtNtNtCs*_14regex_automata4meta5regex10RegexInfoIEB*_*)
    *(.text*._RINvNtCs*_4core3ptr9drop_glueINtNtNtCs*_14regex_automata4util4pool4PoolNtNtNtB*_4meta5regex5CacheINtNtCs*_5alloc5boxed3BoxDINtNtNtB*_3ops8function2FnuEp6OutputB*_NtNtNtB*_5panic11unwind_safe13RefUnwindSafeNtNtB*_6marker4SendNtB*_4SyncNtB*_10UnwindSafeEL_EEECs*_8clj_eval*)
    *(.text*._RNvXNtNtCs*_5alloc3vec21spec_from_iter_nestedINtB*_3VecNtNtCs*_9clj_value5value5ValueEINtB*_18SpecFromIterNestedB*_INtNtNtNtCs*_4core4iter8adapters6cloned6ClonedINtNtB*_3map3MapINtNtCs*_4rpds4list7IterPtrB*_NtNtNtNtCs*_7archery14shared_pointer4kind4arct5ArcTKEFG_RL0_INtB*_13SharedPointerB*_B*_EERL0_B*_EEE9from_iterCs*_10clj_reader*)
    *(.text*._RNvMNtCs*_10clj_reader8metaformNtB*_6Reader14sq_expand_list*)
    *(.text*._RNvMNtNtCs*_12regex_syntax3hir7literalNtB*_9Extractor7extract*)
    *(.text*._RNvYNCNvNCNvMs*_NtNtCs*_14regex_automata4meta5regexNtB*_6Config17get_pool_capacity021AVAILABLE_PARALLELISM0INtNtNtCs*_4core3ops8function6FnOnceuE9call_onceB*_*)
    *(.text*._RINvNvNtNtCs*_5alloc2io4read19default_read_to_end16small_probe_readRNtNtCs*_3std2fs4FileEB*_*)
    *(.text*._RINvNtCs*_4core3ptr9drop_glueNtNtCs*_12regex_syntax3hir7HirKindECs*_14regex_automata*)
    *(.text*._RNvNtCs*_8clj_eval5types10native_new*)
    *(.text*._RNvMs*_NtCs*_5alloc4syncINtB*_3ArcSIB*_eEE9drop_slowCs*_9clj_value*)
    *(.text*._RNvMs*_NtCs*_5alloc4syncINtB*_3ArcDG_INtNtNtCs*_4core3ops8function2FnTQL0_NtNtCs*_8clj_eval4eval9EvaluatorINtCs*_8smallvec8SmallVecANtNtCs*_9clj_value5value5Valuej4_EEEp6OutputINtNtB*_6result6ResultB*_NtNtB*_5error11NativeErrorENtNtB*_6marker4SendNtB*_4SyncEL_E9drop_slowB*_*)
    *(.text*._RNvMs*_NtCs*_5alloc4syncINtB*_3ArcNtNtNtCs*_14regex_automata4util8captures14GroupInfoInnerE9drop_slowB*_*)
    *(.text*._RNvNtCs*_5alloc5boxed14box_new_uninit.717*)
    *(.text*._RINvNtCs*_4core3ptr9drop_glueINtNtB*_6option6OptionINtNtNtNtCs*_3std11collections4hash3map7HashMapNtNtCs*_9clj_value6symbol6SymbolB*_EEECs*_10clojure_rs*)
    *(.text*._RNvNtCs*_8clj_eval2re14compile_source*)
    *(.text*._RNvMs*_NtNtCs*_12regex_syntax3hir9translateNtB*_11TranslatorI9push_char*)
    *(.text*._RNvNtNtCs*_14regex_automata4meta8strategy3new*)
    *(.text*._RNvMs*_NtNtCs*_12regex_syntax3hir7literalNtB*_14PreferenceTrie8minimize*)
    *(.text*._RINvMs*_NtNtCs*_14regex_automata4util9prefilterNtB*_6Choice3newNtNtNtCs*_12regex_syntax3hir7literal7LiteralEB*_*)
    *(.text*._RNvMs*_NtCs*_5alloc4syncINtB*_3ArcNtNtCs*_9clj_value5class8ClassValE9drop_slowB*_*)
    *(.text*._RNvNtCs*_8clj_eval2vm13call_borrowed*)
    *(.text*._RNvXNtNtCs*_5alloc3vec21spec_from_iter_nestedINtB*_3VecNtNtCs*_9clj_value5value5ValueEINtB*_18SpecFromIterNestedB*_NtB*_10VectorIterE9from_iterCs*_10clj_reader*)
    *(.text*._RNvNtCs*_8clj_eval4lazy10native_seq*)
    *(.text*._RNvMs*_NtCs*_5alloc7raw_vecNtB*_11RawVecInner11finish_growCs*_8clj_repl*)
    *(.text*._RNvMs*_NtCs*_5alloc7raw_vecINtB*_6RawVecNtNtCs*_12regex_syntax3ast3AstE8grow_oneB*_*)
    *(.text*._RNvMs*_NtNtCs*_14regex_automata4util8capturesNtB*_14GroupInfoInner15add_first_group*)
    *(.text*._RNvMs*_NtCs*_5alloc7raw_vecINtB*_6RawVecINtNtNtNtCs*_3std11collections4hash3map7HashMapINtNtB*_4sync3ArceENtNtNtCs*_14regex_automata4util10primitives10SmallIndexEE8grow_oneB*_*)
    *(.text*._RNvNtNtCs*_3std6thread9functions21available_parallelism*)
    *(.text*._RNvMs*_NtCs*_3std4pathNtB*_4Path12__starts_with*)
    *(.text*._RINvMs*_NtCs*_9hashbrown3rawINtB*_8RawTableTNtNtCs*_5alloc6string6StringINtNtB*_4sync3ArcNtNtNtCs*_5regex5regex6string5RegexEEE14reserve_rehashNCINvNtB*_3map11make_hasherB*_B*_INtNtCs*_4core4hash18BuildHasherDefaultNtCs*_10rustc_hash8FxHasherEE0ECs*_8clj_eval*)
    *(.text*._RNvNtCs*_8clj_eval8printsys11map_default*)
    *(.text*._RINvNtNtNtNtCs*_3std3sys12thread_local6native4lazy7destroyINtNtCs*_4core4cell7RefCellINtNtNtNtB*_11collections4hash3map7HashMapNtNtCs*_5alloc6string6StringINtNtB*_4sync3ArcNtNtNtCs*_5regex5regex6string5RegexEINtNtB*_4hash18BuildHasherDefaultNtCs*_10rustc_hash8FxHasherEEEECs*_8clj_eval*)
    *(.text*._RNvMs*_NtCs*_5alloc4syncINtB*_3ArcNtNtNtCs*_5regex5regex6string5RegexE9drop_slowCs*_8clj_eval*)
    *(.text*._RNvMs*_NtCs*_5alloc4syncINtB*_3ArcNtNtNtCs*_14regex_automata4meta5regex6RegexIE9drop_slowB*_*)
    *(.text*._RINvMs*_NtCs*_9hashbrown3mapINtB*_7HashMapNtNtCs*_5alloc6string6StringB*_NtNtNtCs*_3std4hash6random11RandomStateE3getB*_ECs*_10clj_reader*)
    *(.text*._RNvXs*_NtCs*_10clj_reader4optsINtNtNtNtCs*_3std11collections4hash3map7HashMapINtNtCs*_5alloc4sync3ArceETNtNtCs*_9clj_value6symbol6SymbolyEINtNtCs*_4core4hash18BuildHasherDefaultNtCs*_10rustc_hash8FxHasherEENtB*_6Refers6targetCs*_8clj_eval*)
    *(.text*._RNvNtCs*_10clj_reader8metaform11apply_shape*)
    *(.text*._RINvNtCs*_4core3ptr9drop_glueINtNtCs*_5alloc3vec3VecTNtNtCs*_9clj_value5value5ValueB*_EEECs*_10clj_reader*)
    *(.text*._RNvNtCs*_8clj_eval8classemu13native_static*)
    *(.text*._RNvMs*_NtNtCs*_14regex_automata4meta5regexNtB*_7Builder5build*)
    *(.text*._RNvMs*_NtCs*_5alloc7raw_vecINtB*_6RawVecNtNtCs*_12regex_syntax3ast4SpanE8grow_oneB*_*)
    *(.text*._RINvMs*_NtCs*_12regex_syntax3hirNtB*_3Hir7literalINtNtCs*_5alloc3vec3VechEEB*_*)
    *(.text*._RINvMs*_NtCs*_5alloc3vecINtB*_3VecNtNtNtCs*_12regex_syntax3hir7literal7LiteralE8dedup_byNCNvMs*_B*_NtB*_3Seq5dedup0ECs*_14regex_automata*)
    *(.text*._RNvMs*_NtNtCs*_12regex_syntax3hir7literalNtB*_3Seq22optimize_by_preference*)
    *(.text*._RNCNvMs*_NtNtCs*_12regex_syntax3hir7literalNtB*_14PreferenceTrie8minimize0B*_*)
    *(.text*._RNvMs*_NtCs*_5alloc7raw_vecINtB*_6RawVecINtNtB*_3vec3VecINtNtCs*_4core6option6OptionINtNtB*_4sync3ArceEEEE8grow_oneCs*_14regex_automata*)
    *(.text*._RNvNtNtCs*_10std_detect6detect5cache21detect_and_initialize*)
    *(.text*._RNvNtNtNtCs*_4core9core_arch3x865xsave7__xgetbv*)
    *(.text*._RNvNtCs*_9clj_value3seq11piece_value*)
    *(.text*._RNvNtCs*_9clj_value5print12str_of_value*)
    *(.text*._RNvNtCs*_8clj_eval4core10native_str*)
    *(.text*._RNvNtCs*_8clj_eval4core10take_count*)
    *(.text*._RNvMs*_NtNtCs*_5regex5regex6stringNtB*_5Regex3new*)
    *(.text*._RINvMs*_NtCs*_5regex8buildersNtB*_7Builder3newARej1_B*_EB*_*)
    *(.text*._RINvNvMs*_NtCs*_5alloc7raw_vecINtB*_11RawVecInnerpE7reserve21do_reserve_and_handleNtNtB*_5alloc6GlobalECs*_10clojure_rs*)
    *(.text*._RNvMs*_NtCs*_5alloc7raw_vecNtB*_11RawVecInner11finish_growCs*_14regex_automata*)
    *(.text*._RNCINvMs*_NtNtCs*_14regex_automata4meta5regexNtB*_7Builder19build_many_from_hirNtNtCs*_12regex_syntax3hir3HirEs*_0B*_*)
    *(.text*._RINvNtCs*_4core3ptr9drop_glueNCINvNtCs*_8clj_eval6vm_ops2s1NtB*_3KstNtB*_10DoubleCastNtB*_7AsValueE0EB*_*)
    *(.text*._RINvNtCs*_4core3ptr9drop_glueINtNtNtNtCs*_14regex_automata4util4pool5inner9CacheLineINtNtNtNtCs*_3std4sync6poison5mutex5MutexINtNtCs*_5alloc3vec3VecINtNtB*_5boxed3BoxNtNtNtB*_4meta5regex5CacheEEEEECs*_8clj_eval*)
    *(.text*._RINvNtCs*_4core3ptr9drop_glueNtNtNtCs*_14regex_automata4meta5regex5CacheECs*_8clj_eval*)
    *(.text*._RINvNtCs*_4core3ptr9drop_glueNtNtNtCs*_14regex_automata4util8captures14GroupInfoInnerEB*_*)
    *(.text*._RNvMNtCs*_10clj_reader8metaformNtB*_6Reader12with_sq_meta*)
    *(.text*._RNvNtCs*_8clj_eval4expr10special_op*)
    *(.text*._RNvNtCs*_8clj_eval4seqs13native_filter*)
    *(.text*._RNvMs*_NtNtCs*_12regex_syntax3ast5parseINtB*_7ParserIQNtB*_6ParserE10bump_spaceB*_*)
    *(.text*._RNvMs*_NtNtCs*_12regex_syntax3ast5parseINtB*_7ParserIQNtB*_6ParserE13pop_group_endB*_*)
    *(.text*._RNvMs*_NtCs*_5alloc7raw_vecINtB*_6RawVecNtNtNtCs*_12regex_syntax3hir7literal5StateE8grow_oneB*_*)
    *(.text*._RINvNtNtCs*_5alloc2io4read19default_read_to_endRNtNtCs*_3std2fs4FileEB*_*)
    *(.text*._RNvNvNtNtNtCs*_6memchr4arch6x86_646memchr10memchr_raw6detect*)
    *(.text*._RNvNvNtNtNtCs*_6memchr4arch6x86_646memchr10memchr_raw9find_avx2*)
    *(.text*._RINvNtCs*_8clj_eval6vm_ops6shape2NtB*_3NthNtB*_7AsValueEB*_*)
    *(.text*._RNCINvNtCs*_8clj_eval6vm_ops2ssNtB*_3RegNtB*_3KstNtB*_2LtNtB*_6AsTestE0B*_*)
    *(.text*._RNvNtCs*_8clj_eval4core6minmax*)
    *(.text*._RNvNtCs*_8clj_eval11core_macros11expand_cond*)
    *(.text*._RINvNtCs*_8clj_eval6vm_ops6shape1NtB*_5SeqOpNtB*_7AsValueEB*_*)
    *(.text*._RNvNtCs*_8clj_eval4lazy10equiv_vals*)
    *(.text*._RNvNtCs*_8clj_eval4lazy17step_value_forced*)
    *(.text*._RNvNtCs*_8clj_eval11core_macros11expand_when*)
    *(.text*._RNvNtCs*_8clj_eval4core9native_eq*)
    *(.text*._RNvNtCs*_8clj_eval4lazy13is_sequential*)
    *(.text*._RNvNtCs*_8clj_eval4core10native_max*)
    *(.text*._RNCNvNtCs*_8clj_eval2vm5locals*_0B*_*)
    *(.text*._RNvNtCs*_8clj_eval4lazy10keys_thunk*)
    *(.text*._RNvNtCs*_8clj_eval11core_macros15expand_when_not*)
    *(.text*._RNvMs*_NtCs*_9clj_value5valueNtB*_3Map8trie_mut*)
    *(.text*._RNvNtCs*_8clj_eval4lazy14step_thunk_mid*)
    *(.text*._RNvNtCs*_8clj_eval11core_macros19expand_defn_private*)
    *(.text*._RNvNtCs*_8clj_eval4core10native_odd*)
    *(.text*._RINvNtCs*_4core3ptr9drop_glueINtNtNtCs*_3std4sync6poison11PoisonErrorINtNtB*_5mutex10MutexGuardINtNtB*_6option6OptionINtNtB*_4mpsc6SenderINtNtCs*_5alloc5boxed3BoxDINtNtNtB*_3ops8function6FnOnceuEp6OutputuNtNtB*_6marker4SendEL_EEEEEECs*_9clj_value*)
    *(.text*._RNvNtCs*_8clj_eval4lazy10keys_empty*)
    *(.text*._RNvNtCs*_8clj_eval4lazy14step_keys_unit*)
    *(.text*._RNvNtCs*_8clj_eval4coll13native_second*)
    *(.text*._RNCNvNtCs*_8clj_eval2vm5local0B*_*)
    *(.text*._RNCNvMs*_NtCs*_8clj_eval2vmNtB*_8Compiler12compile_test0B*_*)
    *(.text*._RINvNtCs*_4core3ptr9drop_glueNtNtCs*_9clj_value3seq11KeySeqValueECs*_8clj_eval*)
    *(.text*._RNvNtCs*_8clj_eval11core_macros6tmp_fn*)
    *(.text*._RINvNtCs*_9clj_value9transient6put_atNtNtB*_5value5ValueECs*_8clj_eval*)
    *(.text*._RNvNtCs*_8clj_eval11core_macros13comprehension*)
    *(.text*._RNCNvMNtCs*_8clj_eval11core_macrosNtB*_5Stage7chained0B*_*)
    *(.text*._RNvMNtCs*_8clj_eval11core_macrosNtB*_5Stage6mapper*)
    *(.text*._RNCINvNtCs*_8clj_eval6vm_ops2xsNtB*_3KstNtB*_3ModNtB*_7AsValueE0B*_*)
    *(.text*._RINvNtCs*_8clj_eval6vm_ops3updNtB*_4ConjEB*_*)
    *(.text*._RNCINvNtCs*_8clj_eval6vm_ops4upd2NtB*_4ConjE0B*_*)
    *(.text*._RINvNtCs*_8clj_eval6vm_ops3updNtB*_4RestEB*_*)
    *(.text*._RNCINvNtCs*_8clj_eval6vm_ops2s1NtB*_3RegNtB*_5FirstNtB*_7AsValueE0B*_*)
    *(.text*._RNCNvMs*_NtCs*_8clj_eval2vmNtB*_8Compiler12compile_loops*_0B*_*)
    *(.text*._RNvNtCs*_9clj_value5print9ryu_parts*)
    *(.text*._RNvNtCs*_8clj_eval4core12num_rational*)
    *(.text*._RNvNtCs*_9clj_value5print18java_finite_digits*)
    *(.text*._RNvXs*_NtNtCs*_4core3num11float_parsedNtNtNtB*_3str6traits7FromStr8from_str*)
    *(.text*._RNvNtCs*_9clj_value5print18java_double_string*)
    *(.text*._RNvNtNtCs*_3ryu6pretty8mantissa19write_mantissa_long*)
    *(.text*._RNvMs*_NtCs*_8clj_eval2vmNtB*_8Compiler14flat_body_tail*)
    *(.text*._RNvNtCs*_8clj_eval13vm_intrinsics6get_of*)
    *(.text*._RNvMs*_NtCs*_8clj_eval2vmNtB*_8Compiler9flat_tail*)
    *(.text*._RNvNtCs*_8clj_eval2ns11the_ns_name*)
    *(.text*._RINvNtCs*_8clj_eval6vm_ops3updNtB*_4NextEB*_*)
    *(.text*._RNvMs*_NtCs*_8clj_eval4exprNtB*_8Analyzer15ctor_baked_head*)
    *(.text*._RNvNtCs*_8clj_eval8classemu13surface_gated*)
    *(.text*._RNvNtCs*_8clj_eval2re21boundary_alternatives*)
    *(.text*._RNvNtCs*_8clj_eval4seqs24native_frequencies_owned*)
    *(.text*._RNvNtCs*_8clj_eval14stdlib_natives11native_join*)
    *(.text*._RNvXs*_NtCs*_5alloc3vecINtB*_3VecNtNtNtCs*_12regex_syntax3hir7literal7LiteralENtNtCs*_4core5clone5Clone5cloneB*_*)
    *(.text*._RNvNtCs*_8clj_eval5types18new_via_class_core*)
    *(.text*._RNvNtCs*_9clj_value3jvm17jvm_class_of_host*)
    *(.text*._RNvNtCs*_8clj_eval8classemu13dynamic_class*)
    *(.text*._RNvMs*_NtCs*_8clj_eval4exprNtB*_8Analyzer12dot_call_str*)
    *(.text*._RNvXs*_NtNtCs*_5regex5regex6stringNtB*_7MatchesNtNtNtNtCs*_4core4iter6traits8iterator8Iterator4next*)
    *(.text*._RNvNtCs*_9clj_value5print18print_port_or_rest*)
    *(.text*._RNvMNtNtCs*_14regex_automata4meta8strategyINtB*_3PreNtNtNtNtB*_4util9prefilter6memchr6MemchrE3newB*_*)
    *(.text*._RNvXs*_NtNtCs*_14regex_automata4meta8strategyINtB*_3PreNtNtNtNtB*_4util9prefilter6memchr6MemchrENtB*_8Strategy6searchB*_*)
    *(.text*._RNCINvMs*_NtNtCs*_3std4sync4onceNtB*_4Once15call_once_forceNCINvMNtB*_9once_lockINtB*_8OnceLockINtNtCs*_5alloc3vec3VecINtNtB*_4sync3ArceEEE10initializeNCINvB*_11get_or_initNCNvNtCs*_9clj_value3seq11piece_value0E0zE0E0B*_*)
    *(.text*._RNvMs*_NtCs*_8clj_eval4exprNtB*_8Analyzer16check_ctor_arity*)
    *(.text*._RNvNtCs*_8clj_eval4seqs20native_reverse_owned*)
    *(.text*._RINvMNtNtCs*_3std4sync9once_lockINtB*_8OnceLockINtNtCs*_5alloc3vec3VecINtNtB*_4sync3ArceEEE10initializeNCINvB*_11get_or_initNCNvNtCs*_9clj_value3seq11piece_value0E0zEB*_*)
    *(.text*._RINvNtCs*_4core3ptr9drop_glueINtNtNtCs*_14regex_automata4meta8strategy3PreNtNtNtNtB*_4util9prefilter6memchr6MemchrEEB*_*)
    *(.text*._RNvNtCs*_8clj_eval4vars13with_meta_val*)
    *(.text*._RNvMs*_NtCs*_8clj_eval4exprNtB*_8Analyzer13ctor_head_fqn*)
    *(.text*._RNvNtCs*_8clj_eval5types11native_meth*)
    *(.text*._RNvNtCs*_8clj_eval5types13new_via_class*)
    *(.text*._RNCNvNtCs*_8clj_eval4seqs24native_frequencies_owned0B*_*)
    *(.text*._RNvNtCs*_8clj_eval4vars16native_with_meta*)
    *(.text*._RINvMs*_NtNtCs*_14regex_automata4util8capturesNtB*_9GroupInfo3newAAINtNtCs*_4core6option6OptionReEj1_B*_B*_B*_EB*_*)
    *(.text*._RNvNtCs*_8clj_eval6macros13native_gensym*)
    *(.text*._RNvNtCs*_8clj_eval4ctor12ctor_arities*)
    *(.text*._RNCINvNtCs*_8clj_eval6vm_ops2s1NtB*_3KstNtB*_7IntCastNtB*_7AsValueE0B*_*)
    *(.text*._RNvXs*_NtNtCs*_14regex_automata4meta8strategyINtB*_3PreNtNtNtNtB*_4util9prefilter6memchr6MemchrENtB*_8Strategy12create_cacheB*_*)
    *(.text*._RNvXs*_NtNtCs*_4core3fmt3numjNtB*_8LowerHex3fmt*)
    *(.text*._RNvNtCs*_8clj_eval4seqs11native_take*)
    *(.text*._RINvNtCs*_4core3ptr9drop_glueINtNtCs*_5alloc3vec3VecTNtNtCs*_8clj_eval4expr4ExprB*_EEEB*_*)
    *(.text*._RNvMs*_NtCs*_8clj_eval4exprNtB*_8Analyzer8dot_call*)
    *(.text*._RINvNtCs*_8clj_eval6vm_ops6shape1NtB*_7IntCastNtB*_7AsValueEB*_*)
    *(.text*._RNvNtCs*_9clj_value5print10print_char*)
    *(.text*._RNvNtCs*_8clj_eval4core3div*)
    *(.text*._RNvNtCs*_8clj_eval4core14parse_long_str*)
    *(.text*._RNvNtCs*_8clj_eval4core10native_div*)
    *(.text*._RNvNtCs*_8clj_eval4coll16native_nth_owned*)
    *(.text*._RNvMs*_NtCs*_5alloc7raw_vecINtB*_6RawVecNtNtCs*_8clj_eval10aot_subset10SubsetExprE8grow_oneB*_*)
    *(.text*._RNCINvNtCs*_8clj_eval6vm_ops2xxNtB*_3AddNtB*_7AsValueE0B*_*)
    *(.text*._RINvNtCs*_8clj_eval6vm_ops6shape2NtB*_3SubNtB*_7AsValueEB*_*)
    *(.text*._RNvXs*_NtCs*_8clj_eval4exprNtB*_7PatternNtNtCs*_4core5clone5Clone5clone*)
    *(.text*._RNCNvMs*_NtCs*_8clj_eval2vmNtB*_8Compiler16destructure_steps*_0B*_*)
    *(.text*._RINvNtCs*_4core3ptr9drop_glueNCINvNtCs*_8clj_eval6vm_ops2ssNtB*_3KstB*_NtB*_10ConjBangFxNtB*_7AsValueE0EB*_*)
    *(.text*._RNvMs*_NtCs*_8clj_eval2vmNtB*_8Compiler9bind_step*)
    *(.text*._RNvNtCs*_8clj_eval4seqs11native_keys*)
    *(.text*._RNvNtCs*_8clj_eval4seqs11native_vals*)
    *(.text*._RNvNtCs*_8clj_eval4seqs20native_every_p_owned*)
    *(.text*._RNvXs*_NtCs*_9clj_value3seqNtB*_11KeySeqValueNtNtB*_9extension14ExtensionValue6as_any*)
    *(.text*._RNvNtCs*_8clj_eval4seqs10call_pred1*)
    *(.text*._RNvXs*_NtCs*_9clj_value3seqNtB*_11ValSeqValueNtNtB*_9extension14ExtensionValue6as_any*)
    *(.text*._RNvXNtCs*_4core3anyNtNtCs*_9clj_value3seq11ValSeqValueNtB*_3Any7type_idB*_*)
    *(.text*._RNvNtCs*_8clj_eval6vm_ops10upd_native*)
    *(.text*._RINvNtCs*_4core3ptr9drop_glueNCNvMs*_NtCs*_8clj_eval2vmNtB*_8Compiler10compile_if0EB*_*)
    *(.text*._RNvMs*_NtCs*_5alloc7raw_vecINtB*_6RawVecNtNtCs*_8clj_eval4expr7PatternE8grow_oneB*_*)
    *(.text*._RNvMs*_NtCs*_8clj_eval2vmNtB*_8Compiler16destructure_step*)
    *(.text*._RINvMs*_NtCs*_9hashbrown3rawINtB*_8RawTableTNtNtCs*_9clj_value6symbol6SymbolB*_EE14reserve_rehashNCINvNtB*_3map11make_hasherB*_B*_NtNtNtCs*_3std4hash6random11RandomStateE0ECs*_10clj_reader*)
    *(.text*._RNvNtCs*_8clj_eval11core_macros13expand_and_or*)
    *(.text*._RNvNtCs*_8clj_eval2vm11apply_moved*)
    *(.text*._RNvXNtCs*_4core3anyNtNtCs*_9clj_value3seq11KeySeqValueNtB*_3Any7type_idB*_*)
    *(.text*._RNvNtCs*_8clj_eval11core_macros10expand_and*)
    *(.text*._RNvNtCs*_8clj_eval7vm_live8may_read*)
    *(.text*._RNvNtCs*_8clj_eval4lazy8seq_fast*)
    *(.text*._RNvNtCs*_8clj_eval4coll12native_nnext*)
    *(.text*._RNvNtCs*_8clj_eval4coll17native_last_owned*)
    *(.text*._RNvXs*_NtCs*_5alloc4syncINtB*_3ArcSNtNtCs*_9clj_value5value5ValueEINtNtCs*_4core7convert4FromINtNtB*_3vec3VecB*_EE4fromCs*_8clj_eval*)
    *(.text*._RNvNtCs*_8clj_eval4coll13native_zipmap*)
    *(.text*._RNvMs*_NtCs*_9clj_value5valueNtB*_6Vector4iter*)
    *(.text*._RINvNtCs*_8clj_eval6vm_ops6shape1NtB*_3OddNtB*_6AsTestEB*_*)
    *(.text*._RNvNtCs*_8clj_eval4seqs13native_mapcat*)
    *(.text*._RNCINvNtCs*_8clj_eval6vm_ops2ssNtB*_3RegNtB*_3KstNtB*_3MulNtB*_7AsValueE0B*_*)
    *(.text*._RNvNtCs*_8clj_eval4seqs17native_mapv_owned*)
    *(.text*._RNCNvNtCs*_8clj_eval4seqs17native_mapv_owneds*_0B*_*)
    *(.text*._RNvNtCs*_8clj_eval8classemu18static_field_value*)
    *(.text*._RNCINvNtCs*_8clj_eval6vm_ops4upd1NtB*_4RestE0B*_*)
    *(.text*._RNvNtCs*_8clj_eval4lazy10next_owned*)
    *(.text*._RNvNtCs*_8clj_eval4lazy23realize_strict_seq_deep*)
    *(.text*._RINvNtCs*_4core3ptr9drop_glueNCINvNtCs*_8clj_eval6vm_ops4upd2NtB*_3PopE0EB*_*)
    *(.text*._RNvNtCs*_8clj_eval4core13compare_exact*)
    *(.text*._RINvNtCs*_4core3ptr9drop_glueNtNtCs*_8clj_eval4core3NumEB*_*)
    *(.text*._RNCINvNtCs*_8clj_eval6vm_ops2ssNtB*_3RegB*_NtB*_3MulNtB*_7AsValueE0B*_*)
    *(.text*._RNvNtCs*_8clj_eval4core14native_compare*)
    *(.text*._RNvXs*_Cs*_12num_rationalINtB*_5RatioNtNtCs*_10num_bigint6bigint6BigIntENtNtCs*_4core3cmp3Ord3cmpCs*_9clj_value*)
    *(.text*._RNCNvMs*_NtCs*_8clj_eval2vmNtB*_8Compiler11compile_sets*_0B*_*)
    *(.text*._RNvXNtNtCs*_5alloc3vec21spec_from_iter_nestedINtB*_3VecNtNtCs*_9clj_value5value5ValueEINtB*_18SpecFromIterNestedB*_INtNtNtNtCs*_4core4iter8adapters6cloned6ClonedNtNtB*_4trie4IterEE9from_iterCs*_8clj_eval*)
    *(.text*._RNvMs*_NtCs*_9clj_value5valueNtB*_3Set9with_meta*)
    *(.text*._RNvMs*_NtCs*_8clj_eval9vm_scalarNtB*_7Builder8bindings*)
    *(.text*._RNvMs*_NtCs*_8clj_eval2vmNtB*_8Compiler9flat_stmt*)
    *(.text*._RNvMs*_NtCs*_5alloc3vecINtB*_3VecTjNtNtCs*_8clj_eval9vm_scalar5IExprEE16into_boxed_sliceB*_*)
    *(.text*._RINvNtCs*_8clj_eval6vm_ops6shape2NtB*_8ContainsNtB*_7AsValueEB*_*)
    *(.text*._RNvNtCs*_8clj_eval2vm15write_recur_ops*)
    *(.text*._RNvNtCs*_8clj_eval13vm_intrinsics13contains_test*)
    *(.text*._RNCINvNtCs*_8clj_eval6vm_ops2x1NtB*_5FirstNtB*_7AsValueE0B*_*)
    *(.text*._RNvMs*_NtCs*_8clj_eval2vmNtB*_8Compiler8flat_let*)
    *(.text*._RNvNtCs*_8clj_eval4lazy13step_map_unit*)
    *(.text*._RNvMs*_NtCs*_5alloc7raw_vecINtB*_6RawVecTmmEE8grow_oneCs*_8clj_eval*)
    *(.text*._RNvNtCs*_8clj_eval14stdlib_natives12native_split*)
    *(.text*._RNvNtCs*_8clj_eval2re13pattern_split*)
    *(.text*._RNvMNtCs*_10clj_reader4textNtB*_6Reader12regex_reader*)
    *(.text*._RNvMs*_NtCs*_9clj_value3seqNtB*_10RangeValue4done*)
    *(.text*._RNvXs*_NtCs*_8clj_eval2vmNtB*_8CompilerNtNtB*_9vm_scalar4Host4site*)
    *(.text*._RINvMs*_NtCs*_9hashbrown3rawINtB*_8RawTableTNtNtCs*_5alloc6string6StringTB*_yEEE14reserve_rehashNCINvNtB*_3map11make_hasherB*_B*_INtNtCs*_4core4hash18BuildHasherDefaultNtCs*_10rustc_hash8FxHasherEE0ECs*_8clj_eval*)
    *(.text*._RNvMs*_NtCs*_5alloc4syncINtB*_3ArcINtNtCs*_9clj_value4trie4NodeNtNtB*_5value5ValueEE8make_mutB*_*)
    *(.text*._RNvMs*_NtCs*_5alloc4syncINtB*_3ArcINtNtCs*_9clj_value4trie4NodeNtNtB*_5value5ValueEE9drop_slowB*_*)
    *(.text*._RNvNtCs*_8clj_eval2ns12native_alias*)
    *(.text*._RNvMs*_NtCs*_5alloc7raw_vecINtB*_6RawVecINtNtCs*_4core6option6OptionINtNtB*_4sync3ArceEEE8grow_oneCs*_14regex_automata*)
    *(.text*._RNvXs*_NtCs*_9clj_value3seqNtB*_11RealizedSeqNtNtB*_9extension14ExtensionValue10as_any_mut*)
    *(.text*._RNvXs*_NtCs*_8clj_eval8classemuNtB*_13StringBuilderNtNtCs*_9clj_value9extension14ExtensionValue8java_str*)
    *(.text*._RNvNtCs*_8clj_eval8classemu21static_call_character*)
    *(.text*._RNvNtCs*_8clj_eval8classemu11str_int_arg*)
    *(.text*._RNvXNtCs*_4core3anyNtNtCs*_8clj_eval8classemu13StringBuilderNtB*_3Any7type_idB*_*)
    *(.text*._RNvNtCs*_8clj_eval11core_macros6thread*)
    *(.text*._RNvNtCs*_8clj_eval8classemu10str_needle*)
    *(.text*._RNvXs*_NtCs*_8clj_eval8classemuNtB*_13StringBuilderNtNtCs*_9clj_value9extension14ExtensionValue6as_any*)
    *(.text*._RINvNtCs*_4core3ptr9drop_glueNtNtCs*_8clj_eval8classemu13StringBuilderEB*_*)
    *(.text*._RNvNtCs*_8clj_eval4core10native_int*)
    *(.text*._RNvNtCs*_8clj_eval4core14int_cast_value*)
    *(.text*._RNvXNtNtCs*_5alloc3vec21spec_from_iter_nestedINtB*_3VectEINtB*_18SpecFromIterNestedtNtNtNtCs*_4core3str4iter11EncodeUtf16E9from_iterCs*_8clj_eval*)
    *(.text*._RNvNtCs*_8clj_eval8classemu16str_index_search*)
    *(.text*._RNvNtCs*_8clj_eval2io12native_print*)
    *(.text*._RNvNtCs*_8clj_eval8classemu16static_call_long*)
    *(.text*._RINvNtCs*_4core3ptr9drop_glueNCNvMs*_NtCs*_8clj_eval2vmNtB*_8Compiler12compile_test0EB*_*)
    *(.text*._RNvMs*_NtCs*_5alloc3vecINtB*_3VecNtNtB*_6string6StringE8push_mutCs*_8clj_eval*)
    *(.text*._RNCINvNtCs*_8clj_eval6vm_ops2ssNtB*_3RegNtB*_3KstNtB*_3SubNtB*_7AsValueE0B*_*)
    *(.text*.rust_psm_stack_pointer)
    *(.text*._RNvCs*_7stacker15remaining_stack*)
    *(.text*._RINvMs*_NtNtNtNtCs*_3std3sys12thread_local6native4lazyINtB*_7StorageINtNtCs*_4core4cell4CellINtNtB*_6option6OptionjEEzE16get_or_init_slowNvNvCs*_7stacker11STACK_LIMIT27___rust_std_internal_init_fnEB*_*)
    *(.text*._RNvXNtNtCs*_7stacker8backends4unixNtB*_11PthreadAttrNtNtNtCs*_4core3ops4drop4Drop4drop*)
    *(.text*._RNvNtCs*_8clj_eval4expr10seq_values*)
    *(.text*._RNvMs*_NtCs*_9hashbrown3mapINtB*_7HashMapNtNtCs*_5alloc6string6StringNtNtCs*_9clj_value5value5ValueNtNtNtCs*_3std4hash6random11RandomStateE6insertCs*_8clj_eval*)
    *(.text*._RNCINvNtCs*_8clj_eval6vm_ops2s1NtB*_3RegNtB*_4ZeroNtB*_6AsTestE0B*_*)
    *(.text*._RNvMs*_NtCs*_8clj_eval4exprNtB*_8Analyzer14build_map_pair*)
    *(.text*._RNCNvMs*_NtCs*_8clj_eval2vmNtB*_8Compiler9bind_step0B*_*)
    *(.text*._RNvNtCs*_8clj_eval4eval6lookup*)
    *(.text*._RNvNtCs*_8clj_eval4lazy11as_splitvec*)
    *(.text*._RNvNtCs*_8clj_eval4seqs16native_partition*)
    *(.text*._RINvXs*_NtCs*_9clj_value5valueNtB*_4ListNtNtCs*_4core4hash4Hash4hashNtCs*_10rustc_hash8FxHasherEB*_*)
    *(.text*._RNvMs*_NtCs*_8clj_eval2vmNtB*_8Compiler13compile_letfn*)
    *(.text*._RNvNtCs*_8clj_eval4coll10find_entry*)
    *(.text*._RNvNtCs*_8clj_eval4coll10native_val*)
    *(.text*._RINvNtCs*_4core3ptr9drop_glueNCNvMs*_NtCs*_8clj_eval2vmNtB*_8Compiler13compile_letfns*_0EB*_*)
    *(.text*._RNCINvNtCs*_8clj_eval6vm_ops2ssNtB*_3KstNtB*_3RegNtB*_3MulNtB*_7AsValueE0B*_*)
    *(.text*._RNvMs*_NtCs*_8clj_eval4evalNtB*_9Evaluator12bind_outlets*)
    *(.text*._RNvMs*_NtCs*_9hashbrown3mapINtB*_7HashMapReRNtNtCs*_9clj_value5value5ValueNtNtNtCs*_3std4hash6random11RandomStateE6insertCs*_8clj_eval*)
    *(.text*._RINvNtCs*_8clj_eval6vm_ops6shape2NtB*_2LtNtB*_7AsValueEB*_*)
    *(.text*._RNvNtCs*_8clj_eval11concurrency13check_swap_fn*)
    *(.text*._RNvNtCs*_8clj_eval11concurrency9swap_loop*)
    *(.text*._RNvNtCs*_8clj_eval4core10native_nil*)
    *(.text*._RNvNtCs*_8clj_eval4expr13check_or_pair*)
    *(.text*._RNCNvMs*_NtCs*_8clj_eval2vmNtB*_8Compiler13compile_letfns*_0B*_*)
    *(.text*._RNCINvMs*_NtNtCs*_3std4sync4onceNtB*_4Once15call_once_forceNCINvMNtB*_9once_lockINtB*_8OnceLockINtNtCs*_5alloc5boxed3BoxSNtNtCs*_9clj_value5value5ValueEE10initializeNCINvB*_11get_or_initNCNvB*_10try_insert0E0zE0E0Cs*_8clj_eval*)
    *(.text*._RNvNtCs*_8clj_eval11concurrency12native_deref*)
    *(.text*._RNvNtCs*_8clj_eval4lazy8is_idrop*)
    *(.text*._RNvYNCNvNtCs*_8clj_eval4core9native_gts*_0INtNtNtCs*_4core3ops8function6FnOnceTxxEE9call_onceB*_*)
    *(.text*._RNvMs*_NtCs*_9clj_value5valueNtB*_3Map12contains_key*)
    *(.text*._RNvNtCs*_8clj_eval11concurrency12fire_watches*)
    *(.text*._RINvNtCs*_4core3ptr9drop_glueNtNtCs*_8clj_eval4eval10OutletValsEB*_*)
    *(.text*._RNCINvNtCs*_8clj_eval6vm_ops2s1NtB*_3RegNtB*_5SeqOpNtB*_7AsValueE0B*_*)
    *(.text*._RINvMs*_NtCs*_9hashbrown3rawINtB*_8RawTableTReRNtNtCs*_9clj_value5value5ValueEE14reserve_rehashNCINvNtB*_3map11make_hasherB*_B*_NtNtNtCs*_3std4hash6random11RandomStateE0ECs*_8clj_eval*)
    *(.text*._RINvNtCs*_4core3ptr9drop_glueNtNtCs*_8clj_eval4eval7SubMapsEB*_*)
    *(.text*._RNvNtCs*_8clj_eval4seqs15native_split_at*)
    *(.text*._RNvMs*_NtCs*_9clj_value5valueNtB*_4List8new_sync*)
    *(.text*._RNvNtCs*_8clj_eval4core9native_gt*)
    *(.text*._RNvMs*_NtCs*_8clj_eval4evalNtB*_9Evaluator14eval_map_pairs*)
    *(.text*._RNvNtCs*_8clj_eval4lazy11window_full*)
    *(.text*._RNvNtCs*_8clj_eval4lazy14partition_next*)
    *(.text*._RNvNtCs*_8clj_eval4coll15native_contains*)
    *(.text*._RNvNtCs*_8clj_eval11concurrency11native_swap*)
    *(.text*._RNvNtCs*_8clj_eval4expr16as_key_directive*)
    *(.text*._RNvNtCs*_8clj_eval4coll11native_find*)
    *(.text*._RNvNtCs*_8clj_eval4coll14find_entry_map*)
    *(.text*._RNvNtCs*_8clj_eval4core9chain_cmp*)
    *(.text*._RINvMs*_NtCs*_9hashbrown3rawINtB*_8RawTableTNtNtCs*_5alloc6string6StringNtNtCs*_9clj_value5value5ValueEE14reserve_rehashNCINvNtB*_3map11make_hasherB*_B*_NtNtNtCs*_3std4hash6random11RandomStateE0ECs*_8clj_eval*)
    *(.text*._RNvNtCs*_8clj_eval11concurrency12atom_options*)
    *(.text*._RINvMNtNtCs*_3std4sync9once_lockINtB*_8OnceLockINtNtCs*_5alloc5boxed3BoxSNtNtCs*_9clj_value5value5ValueEE10initializeNCINvB*_11get_or_initNCNvB*_10try_insert0E0zECs*_8clj_eval*)
    *(.text*._RNvMs*_NtCs*_8clj_eval4evalNtB*_9Evaluator11destructure*)
    *(.text*._RNvMs*_NtCs*_8clj_eval4evalNtB*_9Evaluator11map_binding*)
    *(.text*._RINvNtCs*_4core3ptr9drop_glueNCNvMs*_NtCs*_8clj_eval2vmNtB*_8Compiler16destructure_steps*_0EB*_*)
    *(.text*._RNvNtCs*_8clj_eval4expr19is_outlet_directive*)
    *(.text*._RNvMNtCs*_9clj_value4atomNtB*_4Atom3new*)
    *(.text*._RINvNtCs*_8clj_eval6vm_ops6shape1NtB*_4ZeroNtB*_6AsTestEB*_*)
    *(.text*._RNvMs*_NtCs*_8clj_eval4evalNtB*_9Evaluator10seq_to_map*)
    *(.text*._RNvNtCs*_8clj_eval4lazy10drop_value*)
    *(.text*._RNvNtCs*_8clj_eval4expr8walk_map*)
    *(.text*._RNvNtCs*_8clj_eval4expr7key_for*)
    *(.text*._RNvNtCs*_8clj_eval11concurrency11native_atom*)
    *(.text*._RINvNtCs*_4core3ptr9drop_glueINtNtCs*_5alloc3vec3VecTINtNtB*_4sync3ArcNtNtCs*_8clj_eval2vm11CompiledFunEIB*_NtB*_3LocEEEEB*_*)
    *(.text*._RNvMs*_NtCs*_8clj_eval9vm_scalarNtB*_7Builder3var*)
    *(.text*._RNvNtCs*_8clj_eval4lazy11lazy_window*)
    *(.text*._RINvNtCs*_4core3ptr9drop_glueINtNtNtNtB*_4iter8adapters3rev3RevINtNtNtCs*_5alloc3vec9into_iter8IntoIterTINtNtB*_4sync3ArcINtB*_3VecNtNtCs*_9clj_value5value5ValueEEjEEEECs*_8clj_eval*)
    *(.text*._RNvMNtCs*_8clj_eval4collNtB*_7KeyStep8from_val*)
    *(.text*._RNvNtCs*_8clj_eval4lazy10step_items*)
    *(.text*._RINvNtNtNtCs*_4core4iter8adapters7flatten17and_then_or_clearINtB*_7FlatMapINtNtNtB*_5slice4iter4IterTNtNtCs*_9clj_value5value5ValueB*_EEAB*_j2_NCNCNvNtCs*_8clj_eval11core_macros18comprehension_core00EB*_NvYB*_NtNtNtB*_6traits8iterator8Iterator4nextEB*_*)
    *(.text*._RNCINvNtCs*_8clj_eval6vm_ops2x1NtB*_3OddNtB*_6AsTestE0B*_*)
    *(.text*._RNvNtCs*_8clj_eval4coll13native_get_in*)
    *(.text*._RNvNtCs*_8clj_eval4coll14lookup_present*)
    *(.text*._RNvNtCs*_8clj_eval11core_macros10expand_for*)
    *(.text*._RINvNtCs*_4core3ptr9drop_glueINtNtB*_6option6OptionINtNtNtNtB*_4iter8adapters7flatten7FlatMapINtNtNtB*_5slice4iter4IterTNtNtCs*_9clj_value5value5ValueB*_EEAB*_j2_NCNCNvNtCs*_8clj_eval11core_macros18comprehension_core00EEEB*_*)
    *(.text*._RNvNtCs*_8clj_eval4lazy15native_for_keep*)
    *(.text*._RNvMNtCs*_8clj_eval4collNtB*_7KeyStep4next*)
    *(.text*._RNvMs*_NtNtCs*_4rpds3map13hash_trie_mapINtB*_6BucketNtNtCs*_9clj_value5value5ValueB*_NtNtNtNtCs*_7archery14shared_pointer4kind4arct5ArcTKE6insertB*_*)
    *(.text*._RINvNtCs*_8clj_eval6vm_ops6shape1NtB*_4PeekNtB*_7AsValueEB*_*)
    *(.text*._RNvXNtNtCs*_5alloc3vec21spec_from_iter_nestedINtB*_3VecNtNtCs*_9clj_value5value5ValueEINtB*_18SpecFromIterNestedB*_INtNtNtNtCs*_4core4iter8adapters4skip4SkipNtB*_10VectorIterEE9from_iterCs*_8clj_eval*)
    *(.text*._RINvNtCs*_8clj_eval6vm_ops3updNtB*_3PopEB*_*)
    *(.text*._RNCINvNtCs*_8clj_eval6vm_ops4upd1NtB*_3PopE0B*_*)
    *(.text*._RINvNtCs*_4core3ptr9drop_glueNtNtCs*_9clj_value3seq10CycleValueECs*_8clj_eval*)
    *(.text*._RNvYNtNtCs*_9clj_value5value10VectorIterNtNtNtNtCs*_4core4iter6traits8iterator8Iterator3nthCs*_8clj_eval*)
    *(.text*._RINvNtCs*_4core3ptr9drop_glueNCINvNtCs*_8clj_eval6vm_ops4upd1NtB*_3PopE0EB*_*)
    *(.text*._RNCINvNtCs*_8clj_eval6vm_ops2s1NtB*_3RegNtB*_4PeekNtB*_7AsValueE0B*_*)
    *(.text*._RINvNtCs*_4core3ptr9drop_glueINtNtCs*_5alloc5boxed3BoxSNtNtCs*_8clj_eval6vm_ops4SiteEEB*_*)
    *(.text*._RNvNtCs*_8clj_eval2vm9run_fused*)
    *(.text*._RINvNtCs*_4core3ptr9drop_glueNCNvMs*_NtCs*_8clj_eval2vmNtB*_8Compiler12compile_loops*_0EB*_*)
    *(.text*._RINvNtCs*_4core3ptr9drop_glueINtNtB*_6option6OptionNtNtCs*_8clj_eval2vm9FusedLoopEEB*_*)
    *(.text*._RINvNtCs*_4core3ptr9drop_glueINtNtB*_6option6OptionNtNtCs*_8clj_eval9vm_scalar10ScalarLoopEEB*_*)
    *(.text*._RNvMs*_NtCs*_5alloc3vecINtB*_3VecNtNtCs*_8clj_eval6vm_ops4SiteE16into_boxed_sliceB*_*)
    *(.text*._RINvNtCs*_4core3ptr9drop_glueTjINtNtCs*_5alloc5boxed3BoxDG1_INtNtNtB*_3ops8function2FnTQL2_NtNtCs*_8clj_eval4eval9EvaluatorQL1_INtNtB*_2vm5FrameL0_EEEp6OutputINtNtB*_6result6ResultNtNtCs*_9clj_value5value5ValueNtNtB*_5error6SignalENtNtB*_6marker4SendNtB*_4SyncEL_EINtNtB*_6option6OptionB*_EEEB*_*)
    *(.text*._RNvXs*_NtCs*_10num_bigint7biguintNtB*_7BigUintNtCs*_11num_integer7Integer3gcd*)
    *(.text*._RNvXs*_NtNtCs*_10num_bigint7biguint5shiftNtB*_7BigUintINtNtNtCs*_4core3ops3bit9ShrAssignyE10shr_assign*)
    *(.text*._RNvNtNtCs*_10num_bigint7biguint14multiplication10scalar_mul*)
    *(.text*.ceil)
    *(.text*._RNvXs*_Cs*_12num_rationalINtB*_5RatioNtNtCs*_10num_bigint6bigint6BigIntENtNtNtCs*_4core3ops5arith3Div3divCs*_9clj_value*)
    *(.text*._RNvXs*_NtCs*_10num_bigint6bigintNtB*_6BigIntNtNtCs*_4core3fmt7Display3fmt*)
    *(.text*._RNvXs*_NtNtCs*_10num_bigint7biguint7convertNtB*_7BigUintNtCs*_10num_traits3Num14from_str_radix*)
    *(.text*._RNvXs*_NtNtCs*_10num_bigint6bigint14multiplicationNtB*_6BigIntNtNtNtCs*_4core3ops5arith3Mul3mul*)
    *(.text*._RNCINvNtCs*_8clj_eval6vm_ops2s1NtB*_3KstNtB*_10DoubleCastNtB*_7AsValueE0B*_*)
    *(.text*._RINvNtCs*_8clj_eval6vm_ops6shape1NtB*_4EvenNtB*_7AsValueEB*_*)
    *(.text*._RNvNtNtCs*_10num_bigint7biguint5shift12biguint_shl2*)
    *(.text*._RNvNtNtCs*_10num_bigint7biguint5shift12biguint_shr2*)
    *(.text*._RNvNtCs*_8clj_eval4core9num_ratio*)
    *(.text*._RNvNtCs*_8clj_eval4core6to_f64*)
    *(.text*._RINvNtCs*_8clj_eval6vm_ops6shape1NtB*_10DoubleCastNtB*_7AsValueEB*_*)
    *(.text*._RNvMNtCs*_10num_bigint9big_digitNtB*_9BigDigits9normalize.1970*)
    *(.text*._RNvNtNtCs*_10num_bigint7biguint8division11div_rem_cow*)
    *(.text*._RNvNtCs*_8clj_eval4core11native_long*)
    *(.text*._RNvNtNtCs*_10num_bigint7biguint7convert11to_radix_le*)
    *(.text*._RNvXs*_NtCs*_4core3fmtRNtNtCs*_10num_bigint6bigint6BigIntNtB*_7Display3fmtCs*_9clj_value*)
    *(.text*._RNvXs*_NtCs*_10num_bigint6bigintNtB*_6BigIntNtCs*_11num_integer7Integer7div_rem*)
    *(.text*._RNvMs*_NtCs*_5alloc4syncINtB*_3ArcINtCs*_12num_rational5RatioNtNtCs*_10num_bigint6bigint6BigIntEE9drop_slowCs*_9clj_value*)
    *(.text*._RNvMs*_Cs*_12num_rationalINtB*_5RatioNtNtCs*_10num_bigint6bigint6BigIntE3newCs*_9clj_value*)
    *(.text*._RNvMs*_NtNtNtCs*_4core3fmt3num3impy4__fmt*)
    *(.text*._RNvNtCs*_8clj_eval3fmt14check_mismatch*)
    *(.text*._RNvMs*_NtCs*_4core3fmtNtB*_9Formatter19pad_formatted_parts*)
    *(.text*._RNvNtNtNtNtNtCs*_4core3num3imp7flt2dec8strategy5grisu19format_shortest_opt*)
    *(.text*._RNvNtCs*_8clj_eval3fmt19pad_zero_sign_aware*)
    *(.text*._RNvNtCs*_8clj_eval3fmt10apply_spec*)
    *(.text*._RNvNtCs*_8clj_eval3fmt15check_sign_pair*)
    *(.text*._RNvNtCs*_8clj_eval3fmt13round_half_up*)
    *(.text*._RNvNtCs*_8clj_eval3fmt8render_f*)
    *(.text*._RNvNtCs*_8clj_eval3fmt13native_format*)
    *(.text*._RNvXs*_NtNtCs*_4core3fmt5floatdNtB*_7Display3fmt*)
    *(.text*._RINvNtNtCs*_4core3fmt5float32float_to_decimal_common_shortestdEB*_*)
    *(.text*._RNvNtCs*_8clj_eval4seqs16native_interpose*)
    *(.text*._RNvNtNtNtCs*_4core3num3imp7flt2dec17digits_to_dec_str*)
    *(.text*._RNvNtCs*_8clj_eval3fmt16apply_float_sign*)
    *(.text*._RNvNtCs*_8clj_eval3fmt10check_spec*)
    *(.text*._RNvMs*_NtCs*_4core3fmtNtB*_9Formatter21write_formatted_parts*)
    *(.text*._RNvNtCs*_8clj_eval3fmt3pad*)
    *(.text*._RNvNtCs*_8clj_eval3fmt20check_width_required*)
    *(.text*._RINvNtCs*_8clj_eval6vm_ops6shape1NtB*_5IsNilNtB*_6AsTestEB*_*)
    *(.text*._RNvNtCs*_8clj_eval8classemu14is_instance_of*)
    *(.text*._RNCNvMs*_NtCs*_8clj_eval2vmNtB*_8Compiler13compile_arity0B*_*)
    *(.text*._RNvNtCs*_9clj_value5value12plain_equals*)
    *(.text*._RNvXs*_NtNtCs*_5alloc3vec14spec_from_iterINtB*_3VecNtNtCs*_8clj_eval2vm7OperandEINtB*_12SpecFromIterB*_INtNtB*_9into_iter8IntoIterB*_EE9from_iterB*_*)
    *(.text*._RNvNtCs*_8clj_eval11core_macros12expand_doseq*)
    *(.text*._RNvNtCs*_8clj_eval4lazy10empty_fast*)
    *(.text*._RNvNtCs*_8clj_eval4seqs17native_drop_while*)
    *(.text*._RINvNtCs*_8clj_eval6vm_ops6shape2NtB*_2EqNtB*_6AsTestEB*_*)
    *(.text*._RINvNtCs*_8clj_eval6vm_ops6shape2NtB*_3GteNtB*_7AsValueEB*_*)
    *(.text*._RNCINvNtCs*_8clj_eval6vm_ops2ssNtB*_3RegNtB*_3KstNtB*_2EqNtB*_6AsTestE0B*_*)
    *(.text*._RNvNtCs*_8clj_eval4coll16native_set_owned*)
    *(.text*._RNCINvNtCs*_8clj_eval6vm_ops2ssNtB*_2UpNtB*_3RegNtB*_8ContainsNtB*_6AsTestE0B*_*)
    *(.text*._RNvMs*_NtCs*_9clj_value5valueNtB*_3Set8contains*)
    *(.text*._RNvNtCs*_8clj_eval8classemu14class_position*)
    *(.text*._RNvNtCs*_8clj_eval4seqs17native_some_owned*)
    *(.text*._RNvNtCs*_8clj_eval4seqs18native_dorun_owned*)
    *(.text*._RNvNtCs*_9clj_value5value9jvm_equiv*)
    *(.text*._RNCINvNtCs*_8clj_eval6vm_ops4naryNtB*_7AsValueE0B*_*)
    *(.text*._RNvNtCs*_8clj_eval6vm_ops8computed*)
    *(.text*._RNvNtCs*_8clj_eval4seqs21native_group_by_owned*)
    *(.text*._RNCNvNtCs*_8clj_eval4seqs21native_group_by_owned0B*_*)
    *(.text*._RNvNtCs*_8clj_eval6vm_ops12operand_refs*)
    *(.text*._RINvNtCs*_8clj_eval6vm_ops6shape1NtB*_5SeqOpNtB*_6AsTestEB*_*)
    *(.text*._RINvNtCs*_8clj_eval6vm_ops6shape2NtB*_8ContainsNtB*_6AsTestEB*_*)
    *(.text*._RNvNtCs*_8clj_eval4lazy17rest_realized_seq*)
    *(.text*._RNvNtCs*_8clj_eval4seqs17native_take_while*)
    *(.text*._RNCINvNtCs*_8clj_eval6vm_ops2s1NtB*_3RegNtB*_5IsNilNtB*_6AsTestE0B*_*)
    *(.text*._RNvNtCs*_8clj_eval13vm_intrinsics9scalar_eq*)
    *(.text*._RNvNtCs*_8clj_eval8classemu15native_instance*)
    *(.text*._RNCNvMs*_NtCs*_8clj_eval2vmNtB*_8Compiler18short_circuit_test0B*_*)
    *(.text*._RNvMs*_NtCs*_9clj_value4trieINtB*_6PackedNtNtB*_5value5ValueE8from_vecB*_*)
    *(.text*._RNvMs*_NtNtCs*_12regex_syntax3hir8intervalINtB*_11IntervalSetNtB*_17ClassUnicodeRangeE12canonicalizeB*_*)
    *(.text*._RNvMs*_NtCs*_12regex_syntax3hirNtB*_3Hir5class.2229*)
    *(.text*._RNvMs*_NtCs*_12regex_syntax3hirNtB*_10Properties10repetition*)
    *(.text*._RNvMs*_NtNtCs*_12regex_syntax3ast5parseINtB*_7ParserIQNtB*_6ParserE15parse_set_classB*_*)
    *(.text*._RNvMs*_NtCs*_12regex_syntax3astNtB*_13ClassSetUnion4push*)
    *(.text*._RNvXs*_NtCs*_12regex_syntax3astNtB*_8ClassSetNtNtNtCs*_4core3ops4drop4Drop4drop*)
    *(.text*._RNvXs*_NtNtCs*_5alloc3vec5drainINtB*_5DrainNtNtCs*_12regex_syntax3hir3HirENtNtNtCs*_4core3ops4drop4Drop4dropB*_*)
    *(.text*._RINvNtCs*_4core3ptr9drop_glueSNtNtCs*_12regex_syntax3hir3HirEB*_*)
    *(.text*._RNvMs*_NtNtCs*_12regex_syntax3hir9translateNtB*_11TranslatorI4push*)
    *(.text*._RINvNtCs*_4core3ptr9drop_glueNtNtCs*_12regex_syntax3ast3AstEB*_*)
    *(.text*._RNvXs*_NtNtCs*_12regex_syntax3hir9translateNtB*_11TranslatorINtNtNtB*_3ast7visitor7Visitor25visit_class_set_item_post*)
    *(.text*._RINvMs*_NtCs*_5alloc3vecINtB*_3VecNtNtCs*_12regex_syntax3hir3HirE14extend_trustedINtNtB*_5drain5DrainB*_EEB*_*)
    *(.text*._RNvMs*_NtNtCs*_12regex_syntax3ast5parseINtB*_7ParserIQNtB*_6ParserE21parse_set_class_rangeB*_*)
    *(.text*._RNvMs*_NtCs*_5alloc7raw_vecINtB*_6RawVecNtNtCs*_12regex_syntax3ast12ClassSetItemE8grow_oneB*_*)
    *(.text*._RNvXs*_NtCs*_5alloc3vecINtB*_3VecNtNtCs*_12regex_syntax3ast12ClassSetItemENtNtNtCs*_4core3ops4drop4Drop4dropB*_*)
    *(.text*._RNvMs*_NtCs*_12regex_syntax3hirNtB*_3Hir6concat*)
    *(.text*._RINvMs*_NtCs*_5alloc3vecINtB*_3VecNtNtCs*_12regex_syntax3ast3AstE14extend_trustedINtNtB*_5drain5DrainB*_EEB*_*)
    *(.text*._RNvMs*_NtCs*_5alloc7raw_vecINtB*_6RawVecNtNtNtCs*_12aho_corasick4util10primitives10SmallIndexE8grow_oneCs*_14regex_automata*)
    *(.text*._RNvMs*_NtNtCs*_12regex_syntax3ast5parseINtB*_7ParserIQNtB*_6ParserE15push_class_openB*_*)
    *(.text*._RNvMs*_NtNtCs*_12regex_syntax3ast5parseINtB*_7ParserIQNtB*_6ParserE12pop_class_opB*_*)
    *(.text*._RNvXs*_NtNtCs*_5alloc3vec5drainINtB*_5DrainNtNtCs*_12regex_syntax3ast3AstENtNtNtCs*_4core3ops4drop4Drop4dropB*_*)
    *(.text*._RNvMs*_NtNtCs*_12regex_syntax3ast5parseINtB*_7ParserIQNtB*_6ParserE26parse_uncounted_repetitionB*_*)
    *(.text*._RNvMs*_NtCs*_12regex_syntax3hirNtB*_12ClassUnicode7literal*)
    *(.text*._RNvMs*_NtNtCs*_12regex_syntax3ast5parseINtB*_7ParserIQNtB*_6ParserE20parse_set_class_openB*_*)
    *(.text*._RNvMs*_NtCs*_5alloc7raw_vecINtB*_6RawVecNtNtNtCs*_12regex_syntax3ast5parse10ClassStateE8grow_oneB*_*)
    *(.text*._RINvNtCs*_4core3ptr9drop_glueNtNtCs*_12regex_syntax3ast8ClassSetEB*_*)
    *(.text*._RNvMs*_NtCs*_5alloc7raw_vecNtB*_11RawVecInner6shrinkCs*_14regex_automata*)
    *(.text*._RINvNtCs*_4core3ptr9drop_glueINtNtCs*_5alloc5boxed3BoxNtNtCs*_12regex_syntax3hir3HirEEB*_*)
    *(.text*._RNvMs*_NtNtCs*_12regex_syntax3ast5parseINtB*_11NestLimiterQNtB*_6ParserE15increment_depthB*_*)
    *(.text*._RNvMs*_NtNtCs*_12regex_syntax3ast5parseINtB*_7ParserIQNtB*_6ParserE9pop_classB*_*)
    *(.text*._RINvNvMs*_NtCs*_5alloc7raw_vecINtB*_11RawVecInnerpE7reserve21do_reserve_and_handleNtNtB*_5alloc6GlobalECs*_12regex_syntax*)
    *(.text*._RNvMNtNtCs*_12regex_syntax3hir7literalNtB*_9Extractor5cross*)
    *(.text*._RNvMs*_NtNtCs*_12regex_syntax3ast5parseINtB*_7ParserIQNtB*_6ParserE20parse_set_class_itemB*_*)
    *(.text*._RNvMs*_NtCs*_12regex_syntax3hirNtB*_12ClassUnicode4push*)
    *(.text*._RNvMs*_NtCs*_5alloc7raw_vecINtB*_6RawVecTRNtNtCs*_12regex_syntax3ast3AstNtNtB*_7visitor5FrameEE8grow_oneB*_*)
    *(.text*._RINvNtCs*_4core3ptr9drop_glueNtNtNtCs*_12regex_syntax3hir9translate8HirFrameEB*_*)
    *(.text*._RNvMs*_NtNtCs*_12regex_syntax3hir7literalNtB*_3Seq14cross_preamble*)
    *(.text*._RINvNtCs*_4core3ptr9drop_glueNtNtCs*_12regex_syntax3ast13ClassSetUnionEB*_*)
    *(.text*._RNvMs*_NtCs*_12regex_syntax3hirNtB*_3Hir10into_parts*)
    *(.text*._RINvNtCs*_4core3ptr9drop_glueNtNtCs*_12regex_syntax3hir7HirKindEB*_*)
    *(.text*._RINvMs*_NtCs*_5alloc3vecINtB*_3VecNtNtNtCs*_12regex_syntax3hir7literal7LiteralE8dedup_byNCNvMs*_B*_NtB*_3Seq5dedup0EB*_*)
    *(.text*._RNvMs*_NtCs*_9clj_value3seqNtB*_10RangeValue12step_inexact*)
    *(.text*._RNCINvNtCs*_8clj_eval6vm_ops2ssNtB*_3RegNtB*_3KstNtB*_3NthNtB*_7AsValueE0B*_*)
    *(.text*._RNvMs*_NtCs*_9clj_value3seqNtB*_10RangeValue7advance*)
    *(.text*._RNvMs*_NtCs*_9clj_value3seqNtB*_8RangeNum5value*)
    *(.text*._RNvMs*_NtCs*_9clj_value5valueNtB*_3Set7without*)
    *(.text*._RNvMNtNtNtCs*_4rpds3map13hash_trie_map18sparse_array_usizeINtB*_16SparseArrayUsizeINtNtCs*_7archery14shared_pointer13SharedPointerINtB*_4NodeNtNtCs*_9clj_value5value5ValueB*_NtNtNtB*_4kind4arct5ArcTKEB*_EE6removeB*_*)
    *(.text*._RINvNtCs*_8clj_eval6vm_ops6shape3NtB*_4Get3EB*_*)
    *(.text*._RNvMNtNtNtCs*_4rpds3map13hash_trie_map18sparse_array_usizeINtB*_16SparseArrayUsizeINtNtCs*_7archery14shared_pointer13SharedPointerINtB*_4NodeNtNtCs*_9clj_value5value5ValueuNtNtNtB*_4kind4arct5ArcTKEB*_EE6removeB*_*)
    *(.text*._RINvNtCs*_8clj_eval6vm_ops6shape3NtB*_9AssocBangEB*_*)
    *(.text*._RNvXs*_NtCs*_9clj_value4trieINtB*_4NodeNtNtB*_5value5ValueENtNtCs*_4core5clone5Clone5cloneB*_*)
    *(.text*._RNvNtCs*_8clj_eval4coll11native_disj*)
    *(.text*._RNCINvNtCs*_8clj_eval6vm_ops3sssNtB*_3RegNtB*_3KstB*_NtB*_4Get3E0B*_*)
    *(.text*._RNvMNtNtCs*_4rpds3map13hash_trie_mapINtB*_4NodeNtNtCs*_9clj_value5value5ValueB*_NtNtNtNtCs*_7archery14shared_pointer4kind4arct5ArcTKE8compressB*_*)
    *(.text*._RNCINvMNtCs*_5alloc5sliceSNtNtCs*_9clj_value5value5Value7sort_byNCINvNtCs*_8clj_eval4seqs15sort_by_checkedNCNvB*_20native_sort_by_owned0E0E0B*_*)
    *(.text*._RNvMNtNtCs*_4rpds3map13hash_trie_mapINtB*_4NodeNtNtCs*_9clj_value5value5ValueuNtNtNtNtCs*_7archery14shared_pointer4kind4arct5ArcTKE8compressB*_*)
    *(.text*._RNCNvNtCs*_8clj_eval6vm_ops10upd_native0B*_*)
    *(.text*._RNvNtCs*_8clj_eval4seqs20native_sort_by_owned*)
    *(.text*._RINvNtNtNtNtCs*_4core5slice4sort6shared9smallsort25insertion_sort_shift_leftNtNtCs*_9clj_value5value5ValueNCINvMNtCs*_5alloc5sliceSB*_7sort_byNCINvNtCs*_8clj_eval4seqs15sort_by_checkedNCNvB*_20native_sort_by_owned0E0E0EB*_*)
    *(.text*._RNvNtCs*_8clj_eval4coll13native_dissoc*)
    *(.text*._RINvMNtNtCs*_4rpds3map13hash_trie_mapINtB*_4NodeNtNtCs*_9clj_value5value5ValueB*_NtNtNtNtCs*_7archery14shared_pointer4kind4arct5ArcTKE6removeB*_EB*_*)
    *(.text*._RINvMNtNtCs*_4rpds3map13hash_trie_mapINtB*_4NodeNtNtCs*_9clj_value5value5ValueuNtNtNtNtCs*_7archery14shared_pointer4kind4arct5ArcTKE6removeB*_EB*_*)
    *(.text*._RNCINvNtCs*_8clj_eval6vm_ops2ssNtB*_3RegNtB*_3KstNtB*_8ContainsNtB*_7AsValueE0B*_*)
    *(.text*._RNvMs*_NtCs*_9clj_value5valueNtB*_3Map7without*)
    *(.text*._RINvNtCs*_4core3ptr9drop_glueNCINvNtCs*_8clj_eval6vm_ops3sssNtB*_3RegNtB*_3KstB*_NtB*_11AssocBangFxE0EB*_*)
    *(.text*._RINvNtCs*_4core3ptr9drop_glueNCNvNtCs*_8clj_eval6vm_ops10upd_native0EB*_*)
    *(.text*._RNvNtCs*_8clj_eval4seqs17native_sort_owned*)
    *(.text*._RNvMs*_NtCs*_9clj_value3seqNtB*_14SubVectorValue5items*)
    *(.text*._RNCINvNtCs*_8clj_eval6vm_ops2s1NtB*_3RegNtB*_3IncNtB*_7AsValueE0B*_*)
    *(.text*._RNCINvNtCs*_8clj_eval6vm_ops2ssNtB*_3RegNtB*_3KstNtB*_3ModNtB*_7AsValueE0B*_*)
    *(.text*._RNvNtCs*_8clj_eval4coll13str_utf16_len*)
    *(.text*._RNvMs*_NtCs*_9clj_value5valueNtB*_6Vector13set_nth_owned*)
    *(.text*._RNvNtCs*_8clj_eval4vars11native_meta*)
    *(.text*._RNvNtCs*_8clj_eval2re18materialize_ranges*)
    *(.text*._RNvNtCs*_8clj_eval2re14pattern_ranges*)
    *(.text*._RNvMs*_NtCs*_5alloc4syncINtB*_3ArcNtNtCs*_9clj_value5array9ArrayDataE9drop_slowB*_*)
    *(.text*._RNvNtCs*_8clj_eval4vars7meta_of*)
    *(.text*._RNvNtCs*_8clj_eval4core11native_char*)
    *(.text*._RNvMs*_NtCs*_9clj_value5arrayNtB*_9ArrayDesc10descriptor*)
    *(.text*._RNvNtCs*_8clj_eval4lazy11native_next*)
    *(.text*._RNvNtCs*_8clj_eval2re19pattern_split_array*)
    *(.text*._RNvMs*_NtCs*_8clj_eval3envNtB*_14SharedRegistry25lookup_in_live_or_removed*)
    *(.text*._RNvNtCs*_8clj_eval8classemu30static_character_to_lower_case*)
    *(.text*._RNvMs*_NtCs*_9clj_value5arrayNtB*_5Array3new*)
    *(.text*._RNvMs*_NtCs*_5alloc4syncINtB*_3ArcINtNtNtNtCs*_3std4sync6poison5mutex5MutexNtNtCs*_9clj_value5array10ArrayStoreEE9drop_slowB*_*)
    *(.text*._RNvNtCs*_8clj_eval11core_macros19expand_thread_first*)
    *(.text*._RNvNtCs*_8clj_eval14stdlib_natives8upstream*)
    *(.text*._RNvMs*_NtCs*_8clj_eval3envNtB*_14SharedRegistry8fallback*)
    *(.text*._RNvMs*_NtCs*_8clj_eval3envNtB*_14SharedRegistry12set_fallback*)
    *(.text*._RINvNtCs*_4core3ptr9drop_glueINtNtB*_4cell10UnsafeCellNtNtCs*_9clj_value5array10ArrayStoreEEB*_*)
    *(.text*._RNvNtCs*_9clj_value5print17print_map_entries*)
    *(.text*._RNvMs*_NtCs*_8clj_eval4evalNtB*_9Evaluator9throwable*)
    *(.text*._RNCINvNtCs*_8clj_eval6vm_ops2s1NtB*_3RegNtB*_3NegNtB*_6AsTestE0B*_*)
    *(.text*._RNvNtCs*_8clj_eval4core14native_ex_data*)
    *(.text*._RNvMs*_NtCs*_8clj_eval4exprNtB*_8Analyzer14resolve_dotted*)
    *(.text*._RNvNtCs*_8clj_eval4core17native_ex_message*)
    *(.text*._RNvNtCs*_9clj_value5print14print_map_body*)
    *(.text*._RNvMNtCs*_9clj_value9extensionNtB*_10ThrowClass7matches*)
    *(.text*._RNvMs*_NtCs*_5alloc4syncINtB*_3ArcNtNtCs*_9clj_value9extension9ThrowableE9drop_slowB*_*)
    *(.text*._RNvXNtNtCs*_5alloc3vec21spec_from_iter_nestedINtB*_3VecTRNtNtCs*_9clj_value5value5ValueB*_EEINtB*_18SpecFromIterNestedB*_NtB*_7MapIterE9from_iterB*_*)
    *(.text*._RNCINvNtCs*_8clj_eval6vm_ops2xsNtB*_3KstNtB*_3NthNtB*_7AsValueE0B*_*)
    *(.text*._RNvNtCs*_8clj_eval8classemu9parse_nfe*)
    *(.text*._RINvNtCs*_8clj_eval6vm_ops6shape1NtB*_3NegNtB*_6AsTestEB*_*)
    *(.text*._RNvMs*_NtCs*_8clj_eval4evalNtB*_9Evaluator11throw_value*)
    *(.text*._RINvNtCs*_4core3ptr9drop_glueNtNtCs*_8clj_eval4expr5CatchEB*_*)
    *(.text*._RNCNvMs*_NtCs*_8clj_eval2vmNtB*_8Compiler17compile_data_form0B*_*)
    *(.text*._RNvNtCs*_8clj_eval4core14native_ex_info*)
    *(.text*._RNvNtCs*_8clj_eval4core14divide_by_zero*)
    *(.text*._RNvNtCs*_8clj_eval14builtin_expand12expand_letfn*)
    *(.text*._RNCINvNtCs*_8clj_eval6vm_ops2s1NtB*_3RegNtB*_3DecNtB*_7AsValueE0B*_*)
    *(.text*._RINvNtCs*_4core3ptr9drop_glueNCNvNtCs*_8clj_eval4seqs11native_fnil0EB*_*)
    *(.text*._RNvMs*_NtCs*_5alloc7raw_vecINtB*_6RawVecTNtNtCs*_9clj_value5value5ValueNtNtCs*_8clj_eval4expr4ExprEE8grow_oneB*_*)
    *(.text*._RNCNvNtCs*_8clj_eval4coll8nth_walk0B*_*)
    *(.text*._RINvNtCs*_8clj_eval6vm_ops6shape2NtB*_2GtNtB*_6AsTestEB*_*)
    *(.text*._RINvNtCs*_4core3ptr9drop_glueINtNtCs*_5alloc3vec3VecTNtNtB*_6string6StringNtNtCs*_9clj_value5value5ValueEEECs*_8clj_eval*)
    *(.text*._RINvNtCs*_8clj_eval6vm_ops6shape1NtB*_3DecNtB*_7AsValueEB*_*)
    *(.text*._RINvNtCs*_8clj_eval6vm_ops6shape1NtB*_3PosNtB*_6AsTestEB*_*)
    *(.text*._RINvNtCs*_4core3ptr9drop_glueINtNtCs*_5alloc3vec3VecNtNtCs*_8clj_eval4expr10KeyBindingEEB*_*)
    *(.text*._RNvNtCs*_8clj_eval4lazy15rest_chunk_tail*)
    *(.text*._RINvNtCs*_8clj_eval6vm_ops6shape2NtB*_5NumEqNtB*_6AsTestEB*_*)
    *(.text*._RINvNtCs*_4core3ptr9drop_glueNtNtCs*_8clj_eval3ext8NativeFnEB*_*)
    *(.text*._RNvNtCs*_8clj_eval4seqs17native_complement*)
    *(.text*._RNCNvNtCs*_8clj_eval4seqs11native_fnil0B*_*)
    *(.text*._RNvNtCs*_8clj_eval4core17native_trampoline*)
    *(.text*._RNvXs*_NtCs*_8clj_eval3extNtB*_8NativeFnNtNtCs*_9clj_value9extension14ExtensionValue10class_name*)
    *(.text*._RNvNtCs*_8clj_eval3ext5munge*)
    *(.text*._RNvMs*_NtCs*_8clj_eval3envNtB*_3Env3set*)
    *(.text*._RNvNtCs*_8clj_eval4seqs18call_checked_owned*)
    *(.text*._RNCNvMs*_NtCs*_8clj_eval2vmNtB*_8Compiler12compile_cases*_0B*_*)
    *(.text*._RNvNtCs*_8clj_eval4seqs11native_fnil*)
    *(.text*._RNCINvNtCs*_8clj_eval6vm_ops2s1NtB*_2UpNtB*_3DecNtB*_7AsValueE0B*_*)
    *(.text*._RNvNtCs*_8clj_eval4seqs17native_constantly*)
    *(.text*._RNvXs*_NtCs*_8clj_eval2vmNtB*_8CompilerNtNtB*_9vm_scalar4Host5reads*)
    *(.text*._RNCINvNtCs*_8clj_eval6vm_ops2xxNtB*_3SubNtB*_7AsValueE0B*_*)
    *(.text*._RNvMs*_NtCs*_5alloc7raw_vecINtB*_6RawVecTlNtNtCs*_8clj_eval4expr4ExprB*_EE8grow_oneB*_*)
    *(.text*._RNvNtCs*_8clj_eval8fx4_form9seq_items*)
    *(.text*._RNvNtCs*_9clj_value5value12map_value_eq*)
    *(.text*._RNvNtCs*_8clj_eval4seqs11native_comp*)
    *(.text*._RNvNtCs*_8clj_eval4seqs14native_partial*)
    *(.text*._RINvNtCs*_4core3ptr9drop_glueNCNvNtCs*_8clj_eval4seqs14native_partial0EB*_*)
    *(.text*._RNCNvNtCs*_8clj_eval4seqs11native_juxt0B*_*)
    *(.text*._RNCINvNtCs*_8clj_eval6vm_ops2ssNtB*_3KstB*_NtB*_2GtNtB*_6AsTestE0B*_*)
    *(.text*._RINvNtCs*_4core3ptr9drop_glueSNtNtCs*_8clj_eval4expr9LetFnInitEB*_*)
    *(.text*._RNCNvNtCs*_8clj_eval4seqs11native_comp0B*_*)
    *(.text*._RNCINvNtCs*_8clj_eval6vm_ops2s1NtB*_3RegNtB*_3PosNtB*_6AsTestE0B*_*)
    *(.text*._RNvNtCs*_8clj_eval4coll12contains_map*)
    *(.text*._RNvNtCs*_8clj_eval4lazy13is_always_seq*)
    *(.text*._RINvNtCs*_4core3ptr9drop_glueTlINtNtCs*_5alloc5boxed3BoxDG1_INtNtNtB*_3ops8function2FnTQL2_NtNtCs*_8clj_eval4eval9EvaluatorQL1_INtNtB*_2vm5FrameL0_EEEp6OutputINtNtB*_6result6ResultNtNtCs*_9clj_value5value5ValueNtNtB*_5error6SignalENtNtB*_6marker4SendNtB*_4SyncEL_EB*_EEB*_*)
    *(.text*._RINvNtCs*_4core3ptr9drop_glueNCNvNtCs*_8clj_eval4seqs11native_comp0EB*_*)
    *(.text*._RNvNtCs*_8clj_eval4seqs11native_juxt*)
    *(.text*._RNvNtCs*_8clj_eval4seqs15native_identity*)
    *(.text*._RNvNtCs*_9clj_value5value17seq_ext_with_meta*)
    *(.text*._RNvYNtNtCs*_9clj_value3seq10CycleValueNtNtB*_9extension14ExtensionValue8java_strB*_*)
    *(.text*._RNvXs*_NtCs*_8clj_eval3extNtB*_8NativeFnNtNtCs*_9clj_value9extension14ExtensionValue5print*)
    *(.text*._RINvNtCs*_4core3ptr9drop_glueNCNvMs*_NtCs*_8clj_eval2vmNtB*_8Compiler9bind_step0EB*_*)
    *(.text*._RNvNtCs*_8clj_eval11core_macros18expand_thread_last*)
    *(.text*._RNvNtCs*_8clj_eval4core10native_lte*)
    *(.text*._RNvYNCNvNtCs*_8clj_eval4core10native_ltes*_0INtNtNtCs*_4core3ops8function6FnOnceTxxEE9call_onceB*_*)
    *(.text*._RNCNvNtCs*_8clj_eval4seqs17native_complement0B*_*)
    *(.text*._RINvNtCs*_4core3ptr9drop_glueNtNtCs*_8clj_eval4expr10MapPatternEB*_*)
    *(.text*._RNvMs*_NtCs*_8clj_eval3envNtB*_3Env16extend_patchable*)
    *(.text*._RINvNtCs*_4core3ptr9drop_glueNCNvMs*_NtCs*_8clj_eval2vmNtB*_8Compiler12compile_cases*_0EB*_*)
    *(.text*._RNCNvNtCs*_8clj_eval4seqs14native_partial0B*_*)
    *(.text*._RNvNtCs*_8clj_eval4core10native_min*)
    *(.text*._RNvMs*_NtCs*_8clj_eval4evalNtB*_9Evaluator7seq_opt*)
    *(.text*._RNvNtCs*_8clj_eval4core15native_integerp*)
    *(.text*._RNCINvNtCs*_8clj_eval6vm_ops2xxNtB*_2LtNtB*_7AsValueE0B*_*)
    *(.text*._RNCINvNtCs*_8clj_eval6vm_ops2ssNtB*_2UpNtB*_3RegNtB*_3MulNtB*_7AsValueE0B*_*)
    *(.text*._RNvMs*_Cs*_8smallvecINtB*_8SmallVecAINtNtNtCs*_4rpds3map13hash_trie_map16IterStackElementNtNtCs*_9clj_value5value5ValueB*_NtNtNtNtCs*_7archery14shared_pointer4kind4arct5ArcTKEj4_E21reserve_one_uncheckedB*_*)
    *(.text*._RNvNtCs*_8clj_eval4coll16native_list_star*)
    *(.text*._RNCINvNtCs*_8clj_eval6vm_ops2x1NtB*_5SeqOpNtB*_7AsValueE0B*_*)
    *(.text*._RNvNtCs*_8clj_eval4coll10native_pop*)
    *(.text*._RNvNtCs*_8clj_eval4lazy15step_cons_value*)
    *(.text*._RINvMs*_NtCs*_9hashbrown3rawINtB*_8RawTableTTINtNtCs*_5alloc4sync3ArceEB*_EIB*_NtNtCs*_9clj_value7keyword11KeywordDataEEE14reserve_rehashNCINvNtB*_3map11make_hasherB*_B*_INtNtCs*_4core4hash18BuildHasherDefaultNtCs*_10rustc_hash8FxHasherEE0EB*_*)
    *(.text*._RNvNtCs*_8clj_eval4core12native_listp*)
    *(.text*._RNvNtCs*_8clj_eval4coll11native_peek*)
    *(.text*._RNvNtCs*_8clj_eval4lazy11native_cons*)
    *(.text*._RNvXs*_NtCs*_9clj_value3seqNtB*_9ConsValueNtNtB*_9extension14ExtensionValue6as_any*)
    *(.text*._RNvXNtCs*_4core3anyNtNtCs*_9clj_value3seq9ConsValueNtB*_3Any7type_idB*_*)
    *(.text*._RINvYINtNtCs*_4core4hash18BuildHasherDefaultNtCs*_10rustc_hash8FxHasherENtB*_11BuildHasher8hash_oneRTINtNtCs*_5alloc4sync3ArceEB*_EECs*_9clj_value*)
    *(.text*._RNvNtCs*_8clj_eval8classemu19static_call_integer*)
    *(.text*._RNvNtCs*_8clj_eval4core16parse_double_str*)
    *(.text*._RNvNtCs*_8clj_eval8classemu16static_math_ceil*)
    *(.text*._RNCINvNtCs*_8clj_eval6vm_ops2ssNtB*_3KstB*_NtB*_6BitAndNtB*_7AsValueE0B*_*)
    *(.text*._RNvNtCs*_8clj_eval4core16native_add_prime*)
    *(.text*._RNvNtCs*_8clj_eval4core18native_rationalize*)
    *(.text*._RNvXs*_NtCs*_10num_bigint7biguintNtB*_7BigUintNtNtCs*_4core3cmp9PartialEq2eq*)
    *(.text*._RNvNtCs*_8clj_eval8classemu15static_math_exp*)
    *(.text*._RNCINvNtCs*_8clj_eval6vm_ops2s1NtB*_3KstNtB*_3NegNtB*_7AsValueE0B*_*)
    *(.text*._RNvNtCs*_8clj_eval4core10native_num*)
    *(.text*._RNvXs*_NtCs*_4core3fmtRINtNtCs*_5alloc4sync3ArcNtNtCs*_10num_bigint6bigint6BigIntENtB*_7Display3fmtCs*_9clj_value*)
    *(.text*._RINvNtCs*_8clj_eval6vm_ops6shape1NtB*_9ParseLongNtB*_7AsValueEB*_*)
    *(.text*.floor)
    *(.text*._RINvNtCs*_8clj_eval6vm_ops6shape2NtB*_6BitXorNtB*_7AsValueEB*_*)
    *(.text*._RNCNvNtCs*_8clj_eval4core9add_prime0B*_*)
    *(.text*._RNCNvNtCs*_8clj_eval4core9mul_prime0B*_*)
    *(.text*._RNvMNtCs*_9clj_value5towerNtB*_6BigDec12value_of_f64*)
    *(.text*.trunc)
    *(.text*._RNvNtCs*_8clj_eval8classemu15static_math_sin*)
    *(.text*._RNCINvNtCs*_8clj_eval6vm_ops2s1NtB*_3KstNtB*_3PosNtB*_7AsValueE0B*_*)
    *(.text*._RNCINvNtCs*_8clj_eval6vm_ops2s1NtB*_3KstNtB*_9ParseLongNtB*_7AsValueE0B*_*)
    *(.text*._RNvNtCs*_8clj_eval8classemu15math_double_arg*)
    *(.text*._RNvNtCs*_8clj_eval8classemu15static_math_pow*)
    *(.text*._RNCINvNtCs*_8clj_eval6vm_ops2ssNtB*_3KstB*_NtB*_5BitOrNtB*_7AsValueE0B*_*)
    *(.text*._RNvNtCs*_8clj_eval4core9add_prime*)
    *(.text*._RNvXs*_NtNtCs*_10num_bigint6bigint8additionNtB*_6BigIntNtNtNtCs*_4core3ops5arith3Add3add*)
    *(.text*._RNvNtCs*_8clj_eval4core9mul_prime*)
    *(.text*._RNCINvNtCs*_8clj_eval6vm_ops2s1NtB*_3KstNtB*_3IncNtB*_7AsValueE0B*_*)
    *(.text*._RNvXs*_NtNtCs*_10num_bigint6bigint8additionNtB*_6BigIntINtNtNtCs*_4core3ops5arith3AddlE3add*)
    *(.text*._RNvMNtCs*_9clj_value5towerNtB*_6BigDec11to_rational*)
    *(.text*._RINvNtCs*_8clj_eval6vm_ops6shape2NtB*_3MaxNtB*_7AsValueEB*_*)
    *(.text*._RNCINvNtCs*_8clj_eval6vm_ops2ssNtB*_3KstB*_NtB*_3MaxNtB*_7AsValueE0B*_*)
    *(.text*._RNCINvNtCs*_8clj_eval6vm_ops2s1NtB*_3KstNtB*_4ZeroNtB*_7AsValueE0B*_*)
    *(.text*._RNvNtCs*_8clj_eval4core19native_parse_double*)
    *(.text*._RNvNtCs*_8clj_eval8classemu17native_static_mid*)
    *(.text*._RNCINvNtCs*_8clj_eval6vm_ops2ssNtB*_3KstB*_NtB*_3ShrNtB*_7AsValueE0B*_*)
    *(.text*._RNCINvNtCs*_8clj_eval6vm_ops2ssNtB*_3KstB*_NtB*_3MulNtB*_7AsValueE0B*_*)
    *(.text*._RNvNtCs*_8clj_eval4core16native_mul_prime*)
    *(.text*._RNvMNtCs*_9clj_value5towerNtB*_6BigDec5parse*)
    *(.text*._RNvNtCs*_8clj_eval8classemu15static_math_log*)
    *(.text*._RINvNtCs*_8clj_eval6vm_ops6shape1NtB*_4ZeroNtB*_7AsValueEB*_*)
    *(.text*._RINvNtCs*_8clj_eval6vm_ops6shape1NtB*_3PosNtB*_7AsValueEB*_*)
    *(.text*._RINvNtCs*_8clj_eval6vm_ops6shape1NtB*_3NegNtB*_7AsValueEB*_*)
    *(.text*._RINvNtCs*_8clj_eval6vm_ops6shape1NtB*_3OddNtB*_7AsValueEB*_*)
    *(.text*._RINvNtCs*_8clj_eval6vm_ops6shape2NtB*_6BitAndNtB*_7AsValueEB*_*)
    *(.text*._RINvNtCs*_8clj_eval6vm_ops6shape2NtB*_3ShlNtB*_7AsValueEB*_*)
    *(.text*._RNCINvNtCs*_8clj_eval6vm_ops2ssNtB*_3KstB*_NtB*_4QuotNtB*_7AsValueE0B*_*)
    *(.text*._RNCINvNtCs*_8clj_eval6vm_ops2ssNtB*_3KstB*_NtB*_6BitXorNtB*_7AsValueE0B*_*)
    *(.text*._RNvXs*_NtNtCs*_10num_bigint7biguint8additionNtB*_7BigUintINtNtNtCs*_4core3ops5arith3AddmE3add*)
    *(.text*._RNvXs*_NtNtCs*_10num_bigint7biguint14multiplicationRNtB*_7BigUintNtNtNtCs*_4core3ops5arith3Mul3mul*)
    *(.text*._RNvNtCs*_8clj_eval8classemu18static_call_double*)
    *(.text*._RNvNtCs*_8clj_eval8classemu17static_math_round*)
    *(.text*._RINvNtCs*_8clj_eval6vm_ops6shape2NtB*_4QuotNtB*_7AsValueEB*_*)
    *(.text*._RNvXs*_NtNtCs*_10num_bigint7biguint5powerNtB*_7BigUintINtNtCs*_10num_traits3pow3PowmE3pow*)
    *(.text*._RINvNtCs*_8clj_eval6vm_ops6shape2NtB*_3MinNtB*_7AsValueEB*_*)
    *(.text*._RINvNtCs*_8clj_eval6vm_ops6shape1NtB*_8LongCastNtB*_7AsValueEB*_*)
    *(.text*._RNvNtCs*_8clj_eval4core10native_abs*)
    *(.text*._RNvNtCs*_8clj_eval8classemu15static_math_cos*)
    *(.text*._RNCINvNtCs*_8clj_eval6vm_ops2s1NtB*_3KstNtB*_3OddNtB*_7AsValueE0B*_*)
    *(.text*._RNvNtCs*_8clj_eval8classemu15static_math_abs*)
    *(.text*._RNCINvNtCs*_8clj_eval6vm_ops2ssNtB*_3KstB*_NtB*_3ModNtB*_7AsValueE0B*_*)
    *(.text*._RNCINvNtCs*_8clj_eval6vm_ops2ssNtB*_3KstB*_NtB*_3ShlNtB*_7AsValueE0B*_*)
    *(.text*._RNvXs*_NtCs*_8clj_eval4coreNtB*_3NumNtNtCs*_4core5clone5Clone5clone*)
    *(.text*._RNvNtCs*_8clj_eval8classemu16static_math_sqrt*)
    *(.text*._RINvNtCs*_8clj_eval6vm_ops6shape2NtB*_3RemNtB*_7AsValueEB*_*)
    *(.text*._RINvNtCs*_8clj_eval6vm_ops6shape2NtB*_5BitOrNtB*_7AsValueEB*_*)
    *(.text*._RINvNtCs*_8clj_eval6vm_ops6shape2NtB*_3ShrNtB*_7AsValueEB*_*)
    *(.text*._RNCINvNtCs*_8clj_eval6vm_ops2ssNtB*_3KstB*_NtB*_3RemNtB*_7AsValueE0B*_*)
    *(.text*._RNCINvNtCs*_8clj_eval6vm_ops2ssNtB*_3KstB*_NtB*_3AddNtB*_7AsValueE0B*_*)
    *(.text*._RNvXs*_NtNtCs*_10num_bigint7biguint8additionNtB*_7BigUintINtNtNtCs*_4core3ops5arith9AddAssignRB*_E10add_assign*)
    *(.text*._RNCINvNtCs*_8clj_eval6vm_ops2s1NtB*_3KstNtB*_8LongCastNtB*_7AsValueE0B*_*)
    *(.text*._RNvMs*_NtCs*_5alloc4syncINtB*_3ArcNtNtCs*_10num_bigint6bigint6BigIntE9drop_slowCs*_9clj_value*)
    *(.text*._RNvNtCs*_8clj_eval8classemu17static_math_floor*)
    *(.text*._RNvNtCs*_8clj_eval4core13native_bigint*)
    *(.text*._RNCINvNtCs*_8clj_eval6vm_ops2ssNtB*_3KstB*_NtB*_3MinNtB*_7AsValueE0B*_*)
    *(.text*._RNCINvNtCs*_8clj_eval6vm_ops2s1NtB*_3KstNtB*_4EvenNtB*_7AsValueE0B*_*)
    *(.text*._RNvNtCs*_8clj_eval4core12pr_print_str*)
    *(.text*.__udivti3)
    *(.text*._RNvNtCs*_8clj_eval2io10native_prn*)
    *(.text*._RNvMs*_NtCs*_5alloc4syncINtB*_3ArcShE15copy_from_sliceCs*_8clj_eval*)
    *(.text*._RINvNtCs*_4core3ptr9drop_glueINtNtCs*_5alloc3vec3VecTNtNtCs*_9clj_value9extension3VarNtNtCs*_8clj_eval4expr4ExprEEEB*_*)
    *(.text*._RNvNtCs*_8clj_eval4core13native_double*)
    *(.text*._RNvNtCs*_8clj_eval4core13native_pr_str*)
    *(.text*._RNvXs*_NtNtCs*_10num_bigint6bigint8divisionNtB*_6BigIntNtNtNtCs*_4core3ops5arith3Div3div.724*)
    *(.text*._RNvNtCs*_8clj_eval8printsys11set_default*)
    *(.text*._RNvNtCs*_8clj_eval2io15writer_contents*)
    *(.text*._RNvNtCs*_9clj_value5tower12ratio_to_f64*)
    *(.text*._RNCINvNtCs*_8clj_eval6vm_ops2s1NtB*_3RegNtB*_10DoubleCastNtB*_7AsValueE0B*_*)
    *(.text*._RNvMs*_NtCs*_8clj_eval4evalNtB*_9Evaluator12eval_binding*)
    *(.text*._RNvMs*_NtCs*_5alloc4syncINtB*_3ArcINtNtNtNtCs*_3std4sync6poison5mutex5MutexNtNtB*_6string6StringEE9drop_slowCs*_8clj_eval*)
    *(.text*._RNvNtCs*_8clj_eval2io13string_writer*)
    *(.text*._RINvNtCs*_4core3ptr9drop_glueNtNtCs*_8clj_eval2io6WriterEB*_*)
    *(.text*._RNvYNtNtNtNtCs*_3std3sys5stdio4unix6StdoutNtNtNtCs*_4core2io5write5Write9write_allB*_*)
    *(.text*._RNvNtCs*_8clj_eval4core14native_symbolp*)
    *(.text*._RINvMs*_NtCs*_9hashbrown3rawINtB*_8RawTableTINtNtCs*_5alloc4sync3ArceEINtNtB*_3vec3VecNtNtCs*_9clj_value4host10HostMethodEEE14reserve_rehashNCINvNtB*_3map11make_hasherB*_B*_NtNtNtCs*_3std4hash6random11RandomStateE0ECs*_8clj_eval*)
    *(.text*._RNvNtCs*_8clj_eval11core_macros13expand_if_not*)
    *(.text*._RNvNtCs*_8clj_eval5types11define_type*)
    *(.text*._RINvNtCs*_4core3ptr9drop_glueINtNtCs*_5alloc3vec3VecINtNtB*_4sync3ArcNtNtCs*_9clj_value4host7HostDefEEECs*_8clj_eval*)
    *(.text*._RNvNtCs*_8clj_eval5multi16native_defmethod*)
    *(.text*._RNvNtCs*_8clj_eval5multi15install_updated*)
    *(.text*._RNvMs*_NtCs*_5alloc4syncINtB*_3ArcNtNtCs*_9clj_value4host7HostValE9drop_slowB*_*)
    *(.text*._RNvNtCs*_8clj_eval8printsys17write_record_body*)
    *(.text*._RNvNtCs*_9clj_value9hierarchy12isa_with_map*)
    *(.text*._RNvNtCs*_8clj_eval4core14native_recordp*)
    *(.text*._RNvMs*_NtCs*_5alloc4syncINtB*_3ArcNtNtCs*_9clj_value7multifn7MultiFnE9drop_slowB*_*)
    *(.text*._RNvNtCs*_8clj_eval5types7str_arg*)
    *(.text*._RNvNtCs*_8clj_eval5types10parse_sigs*)
    *(.text*._RNvMs*_Cs*_8smallvecINtB*_8SmallVecANtNtCs*_9clj_value5value5Valuej8_E8try_growCs*_8clj_eval*)
    *(.text*._RNvXs*_NtNtCs*_5alloc3vec21spec_from_iter_nestedINtB*_3VecINtNtB*_4sync3ArceEEINtB*_18SpecFromIterNestedB*_INtNtNtNtCs*_4core4iter8adapters3map3MapINtNtNtB*_5slice4iter4IterIB*_NtNtCs*_9clj_value4host7HostDefEENCNvNtCs*_8clj_eval5types11define_type0EE9from_iterB*_*)
    *(.text*._RNvNtCs*_9clj_value4host10class_name*)
    *(.text*._RNvNtCs*_9clj_value9hierarchy14class_pair_hit*)
    *(.text*._RNvNtCs*_9clj_value9hierarchy8hier_key*)
    *(.text*._RNvNtCs*_8clj_eval5types15hostdef_by_name*)
    *(.text*._RNvXs*_NtCs*_8clj_eval3extNtB*_8NsHandleNtNtCs*_9clj_value9extension14ExtensionValue8java_str*)
    *(.text*._RNvNtCs*_8clj_eval4core16native_namespace*)
    *(.text*._RNvNtCs*_8clj_eval4core14native_stringp*)
    *(.text*._RNvNtCs*_8clj_eval2ns14native_ns_name*)
    *(.text*._RNvMs*_NtCs*_9hashbrown3mapINtB*_7HashMapINtNtCs*_5alloc4sync3ArceEINtNtB*_3vec3VecjENtNtNtCs*_3std4hash6random11RandomStateE6insertCs*_8clj_eval*)
    *(.text*._RNvNtCs*_8clj_eval8protocol15native_protocol*)
    *(.text*._RINvMs*_NtCs*_9hashbrown3rawINtB*_8RawTableTyNtNtCs*_8clj_eval13typeinternals14ProtocolFnInfoEE14reserve_rehashNCINvNtB*_3map11make_hasheryB*_INtNtCs*_4core4hash18BuildHasherDefaultNtCs*_10rustc_hash8FxHasherEE0EB*_*)
    *(.text*._RINvNtCs*_8clj_eval6vm_ops6shape2NtB*_5NotEqNtB*_6AsTestEB*_*)
    *(.text*._RNvNtCs*_8clj_eval8protocol15as_protocol_map*)
    *(.text*._RNvNtCs*_8clj_eval5multi14native_multifn*)
    *(.text*._RNvNtCs*_8clj_eval8protocol9proto_ref*)
    *(.text*._RNvNtCs*_8clj_eval8protocol11proto_parts*)
    *(.text*._RNCNvMs*_NtCs*_8clj_eval2vmNtB*_8Compiler30compile_literal_keyword_invoke0B*_*)
    *(.text*._RNvNtCs*_8clj_eval8printsys14record_default*)
    *(.text*._RNvNtCs*_8clj_eval5types15hostdef_of_root*)
    *(.text*._RNvNtCs*_8clj_eval11core_macros9expand_or*)
    *(.text*._RINvNtCs*_8clj_eval6vm_ops6shape1NtB*_8IsStringNtB*_6AsTestEB*_*)
    *(.text*._RNvNtCs*_8clj_eval4core10native_dec*)
    *(.text*._RNvNtCs*_8clj_eval4core14native_keyword*)
    *(.text*._RNvNtCs*_8clj_eval4core11native_mapp*)
    *(.text*._RNvNtCs*_8clj_eval4core22native_namespace_munge*)
    *(.text*._RNvNtCs*_8clj_eval5types13check_methods*)
    *(.text*._RNvXs*_NtCs*_5alloc4syncINtB*_3ArceEINtNtCs*_4core7convert4FromNtNtB*_6string6StringE4from*)
    *(.text*._RNvMs*_NtCs*_8clj_eval3envNtB*_14SharedRegistry18lock_var_for_alter*)
    *(.text*._RNvNtCs*_8clj_eval5types11new_via_def*)
    *(.text*._RNvNtCs*_8clj_eval5types11call_method*)
    *(.text*._RNvMs*_NtCs*_8clj_eval2vmNtB*_7Operand4read*)
    *(.text*._RNvNtCs*_8clj_eval5types14rewrap_maplike*)
    *(.text*._RNvNtCs*_9clj_value9hierarchy10as_map_opt*)
    *(.text*._RNCINvNtCs*_8clj_eval6vm_ops2s1NtB*_3RegNtB*_6EmptyPNtB*_6AsTestE0B*_*)
    *(.text*._RNvMs*_NtCs*_9clj_value4trieINtB*_6PackedNtNtB*_5value5ValueE4pushB*_*)
    *(.text*._RNvNtCs*_8clj_eval5types13native_record*)
    *(.text*._RNvNtCs*_8clj_eval5types17resolve_iface_sym*)
    *(.text*._RNvNtCs*_8clj_eval8protocol14method_argcnts*)
    *(.text*._RNvNtCs*_8clj_eval8protocol19invoke_unregistered*)
    *(.text*._RNvNtCs*_8clj_eval8classemu13hostdef_class*)
    *(.text*._RNCINvNtCs*_8clj_eval6vm_ops2x1NtB*_5SeqOpNtB*_6AsTestE0B*_*)
    *(.text*._RNvNtCs*_8clj_eval13typeinternals22native_protocol_method*)
    *(.text*._RINvNtCs*_8clj_eval6vm_ops6shape1NtB*_6EmptyPNtB*_6AsTestEB*_*)
    *(.text*._RNCINvNtCs*_8clj_eval6vm_ops2x1NtB*_8IsStringNtB*_6AsTestE0B*_*)
    *(.text*._RNCINvNtCs*_8clj_eval6vm_ops2x1NtB*_5IsNilNtB*_7AsValueE0B*_*)
    *(.text*._RNvNtCs*_8clj_eval4core15native_keywordp*)
    *(.text*._RNvNtCs*_8clj_eval5types13parse_methods*)
    *(.text*._RNvNtCs*_8clj_eval5types12native_field*)
    *(.text*._RNvNtCs*_8clj_eval4core7dec_one*)
    *(.text*._RNvNtCs*_8clj_eval5types16native_interface*)
    *(.text*._RINvNtCs*_8clj_eval6vm_ops6shape1NtB*_5IsNilNtB*_7AsValueEB*_*)
    *(.text*._RNvNtCs*_8clj_eval4core11native_name*)
    *(.text*._RNvNtCs*_8clj_eval4core13native_not_eq*)
    *(.text*._RNCINvNtCs*_8clj_eval6vm_ops2sxNtB*_3RegNtB*_2EqNtB*_6AsTestE0B*_*)
    *(.text*._RNvNtCs*_8clj_eval5types17native_record_map*)
    *(.text*._RNvNtCs*_8clj_eval8protocol22native_protocol_invoke*)
    *(.text*._RNvNtCs*_9clj_value4host11find_method*)
    *(.text*._RNvYNCINvNtCs*_8clj_eval6vm_ops6fold_nNtB*_3MulNtB*_7AsValueE0INtNtNtCs*_4core3ops8function6FnOnceTRSRNtNtCs*_9clj_value5value5ValueEE9call_onceB*_*)
    *(.text*._RNvNtCs*_9clj_value9hierarchy6isa_in*)
    *(.text*._RNvNtCs*_9clj_value9hierarchy9vec_items*)
    *(.text*._RNvNtCs*_8clj_eval4core13native_symbol*)
    *(.text*._RNCINvNtCs*_8clj_eval6vm_ops2s1NtB*_3RegNtB*_5SeqOpNtB*_6AsTestE0B*_*)
    *(.text*._RINvMs*_NtNtCs*_3std6thread5localINtB*_8LocalKeyINtNtCs*_4core4cell4CellTyyEEE4withNCNvMNtNtB*_4hash6randomNtB*_11RandomState3new0B*_ECs*_8clj_eval*)
    *(.text*._RNvNtCs*_8clj_eval8protocol10type_entry*)
    *(.text*._RNvMs*_NtCs*_9clj_value5valueNtB*_3Map4size*)
    *(.text*._RNvNtCs*_9clj_value9hierarchy8class_of*)
    *(.text*._RINvNtCs*_4core3ptr9drop_glueNCNvMs*_NtCs*_8clj_eval2vmNtB*_8Compiler30compile_literal_keyword_invoke0EB*_*)
    *(.text*._RNCNvMs*_NtCs*_8clj_eval2vmNtB*_8Compiler18short_circuit_tests*_0B*_*)
    *(.text*._RNCINvNtCs*_8clj_eval6vm_ops2s1NtB*_3RegNtB*_8IsStringNtB*_6AsTestE0B*_*)
    *(.text*._RNvNtCs*_9clj_value4host8munge_ns*)
    *(.text*._RNvMs*_NtCs*_8clj_eval4evalNtB*_9Evaluator9deref_var*)
    *(.text*._RNCINvNtCs*_8clj_eval6vm_ops2xsNtB*_3RegNtB*_5NotEqNtB*_6AsTestE0B*_*)
    *(.text*._RINvNtCs*_8clj_eval6vm_ops6fold_nNtB*_3MulNtB*_7AsValueEB*_*)
    *(.text*._RNvNtCs*_8clj_eval5multi9multi_ref*)
    *(.text*._RINvNtCs*_4core3ptr9drop_glueNtNtCs*_9clj_value4host8HostInstEB*_*)
    *(.text*._RNvMs*_NtNtNtCs*_14regex_automata3nfa8thompson8compilerNtB*_8Compiler3new*)
    *(.text*._RNvMs*_NtNtNtCs*_14regex_automata3nfa8thompson8compilerNtB*_12Utf8Compiler3new*)
    *(.text*._RNvMs*_NtNtNtCs*_14regex_automata3nfa8thompson8compilerNtB*_12Utf8Compiler12compile_from*)
    *(.text*._RNvMs*_NtNtNtCs*_14regex_automata3nfa8thompson8compilerNtB*_12Utf8Compiler7compile*)
    *(.text*._RNvMs*_NtNtCs*_14regex_automata6hybrid3dfaNtB*_7Builder14build_from_nfa*)
    *(.text*._RNvMs*_NtNtNtCs*_14regex_automata4util11determinize5stateNtB*_19StateBuilderMatches8into_nfa*)
    *(.text*._RNvMs*_NtNtCs*_14regex_automata4meta5regexNtB*_5Regex15create_captures*)
    *(.text*._RINvMs*_NtCs*_9hashbrown3rawINtB*_8RawTableTNtNtNtNtCs*_14regex_automata4util11determinize5state5StateNtNtNtB*_6hybrid2id11LazyStateIDEE14reserve_rehashNCINvNtB*_3map11make_hasherB*_B*_NtNtNtCs*_3std4hash6random11RandomStateE0EB*_*)
    *(.text*._RNvNtNtCs*_14regex_automata6hybrid6search8find_rev*)
    *(.text*._RNvMs*_NtNtCs*_14regex_automata3dfa7onepassNtB*_15InternalBuilder27add_dfa_state_for_nfa_state*)
    *(.text*._RNvMs*_NtCs*_12regex_syntax3hirNtB*_3Hir5class*)
    *(.text*._RNvMs*_NtNtNtCs*_14regex_automata3nfa8thompson8compilerNtB*_12Utf8Compiler3add*)
    *(.text*._RNvMs*_NtNtNtCs*_14regex_automata3nfa8thompson3nfaNtB*_5Inner3add*)
    *(.text*._RNvNtNtCs*_14regex_automata6hybrid6search8find_fwd*)
    *(.text*._RINvMs*_NtCs*_9hashbrown3mapINtB*_7HashMapNtNtNtNtCs*_14regex_automata4util11determinize5state5StateNtNtNtB*_6hybrid2id11LazyStateIDNtNtNtCs*_3std4hash6random11RandomStateE3getShEB*_*)
    *(.text*._RINvMNtNtCs*_12regex_syntax3ast5parseNtB*_9Primitive18into_class_literalQNtB*_6ParserEB*_*)
    *(.text*._RNvMs*_NtNtCs*_14regex_automata3dfa7onepassNtB*_15InternalBuilder14shuffle_states*)
    *(.text*._RNvMs*_NtNtCs*_14regex_automata6hybrid3dfaNtB*_3DFA10next_state*)
    *(.text*._RNvMs*_NtNtCs*_12regex_syntax3hir9translateNtB*_11TranslatorI27convert_unicode_class_error*)
    *(.text*._RNvMs*_NtCs*_5alloc7raw_vecINtB*_6RawVecNtNtNtNtCs*_14regex_automata3nfa8thompson7builder5StateE8grow_oneB*_*)
    *(.text*._RNvNtNtCs*_14regex_automata6hybrid3dfa22minimum_cache_capacity*)
    *(.text*._RNvXs*_NtNtCs*_14regex_automata4meta8strategyNtB*_4CoreNtB*_8Strategy12create_cache*)
    *(.text*._RNvMs*_NtNtCs*_14regex_automata6hybrid3dfaNtB*_5Cache3new*)
    *(.text*._RNvMs*_NtNtCs*_12regex_syntax3ast5parseINtB*_7ParserIQNtB*_6ParserE9pop_groupB*_*)
    *(.text*._RNvMs*_NtCs*_12regex_syntax3hirNtB*_3Hir10repetition*)
    *(.text*._RNvMs*_NtNtCs*_14regex_automata3dfa7onepassNtB*_3DFA20try_search_slots_imp*)
    *(.text*._RNvXs*_NtNtNtCs*_14regex_automata4util9prefilter6memchrNtB*_7Memchr2NtB*_10PrefilterI7is_fast*)
    *(.text*._RINvNtCs*_4core3ptr9drop_glueNtNtNtCs*_14regex_automata4meta8strategy4CoreEB*_*)
    *(.text*._RNvNtCs*_8clj_eval2re14native_re_find*)
    *(.text*._RNvMs*_NtNtCs*_12regex_syntax3ast5parseINtB*_7ParserIQNtB*_6ParserE12parse_escapeB*_*)
    *(.text*._RINvMs*_NtNtNtCs*_14regex_automata3nfa8thompson8compilerNtB*_8Compiler19build_many_from_hirRNtNtCs*_12regex_syntax3hir3HirEB*_*)
    *(.text*._RNvMs*_NtCs*_12regex_syntax4utf8NtB*_13Utf8Sequences3new*)
    *(.text*._RNvMs*_NtNtNtCs*_14regex_automata4util11determinize5stateNtB*_5State4dead*)
    *(.text*._RNvMs*_NtNtCs*_14regex_automata6hybrid3dfaNtB*_4Lazy10init_cache*)
    *(.text*._RNvMs*_NtNtCs*_14regex_automata6hybrid3dfaNtB*_4Lazy17cache_start_group*)
    *(.text*._RNvNtCs*_8clj_eval2re12groups_value*)
    *(.text*._RNCNvXs*_NtNtCs*_14regex_automata4meta5regexNtB*_15CapturesMatchesNtNtNtNtCs*_4core4iter6traits8iterator8Iterator4next0Cs*_8clj_eval*)
    *(.text*._RNvMs*_NtCs*_5alloc7raw_vecINtB*_6RawVecNtNtCs*_12regex_syntax3hir17ClassUnicodeRangeE8grow_oneB*_*)
    *(.text*._RINvNtCs*_4core3ptr9drop_glueNtNtNtCs*_14regex_automata6hybrid5regex5RegexEB*_*)
    *(.text*._RINvNtCs*_4core3ptr9drop_glueNtNtNtCs*_14regex_automata6hybrid3dfa5CacheECs*_8clj_eval*)
    *(.text*._RINvNtCs*_4core3ptr9drop_glueNtNtNtNtCs*_14regex_automata3nfa8thompson7builder7BuilderEB*_*)
    *(.text*._RINvNtCs*_4core3ptr9drop_glueNtNtNtNtCs*_14regex_automata3nfa8thompson6pikevm7BuilderEB*_*)
    *(.text*._RINvNtCs*_4core3ptr9drop_glueINtNtB*_4cell7RefCellNtNtNtNtCs*_14regex_automata3nfa8thompson8compiler9Utf8StateEEB*_*)
    *(.text*._RINvYNtNtNtCs*_3std4hash6random11RandomStateNtNtCs*_4core4hash11BuildHasher8hash_oneRNtNtNtNtCs*_14regex_automata4util11determinize5state5StateEB*_*)
    *(.text*._RNvXs*_NtNtCs*_14regex_automata4meta8strategyNtB*_4CoreNtB*_8Strategy12search_slots*)
    *(.text*._RNvNtNtCs*_14regex_automata4util11determinize15epsilon_closure*)
    *(.text*._RNvMs*_NtNtCs*_14regex_automata3dfa7onepassNtB*_15InternalBuilder18compile_transition*)
    *(.text*._RNvXs*_NtNtCs*_5regex5regex6stringNtB*_14CaptureMatchesNtNtNtNtCs*_4core4iter6traits8iterator8Iterator4next*)
    *(.text*._RNvCs*_12regex_syntax23is_escapeable_character*)
    *(.text*._RNvNtCs*_8clj_eval4lazy17step_repeat_value*)
    *(.text*._RNvMs*_NtCs*_5alloc4syncINtB*_3ArcNtNtNtNtCs*_14regex_automata3nfa8thompson3nfa5InnerE9drop_slowB*_*)
    *(.text*._RNvMNtNtNtCs*_14regex_automata3nfa8thompson10range_trieNtB*_9RangeTrie9add_empty*)
    *(.text*._RNvMs*_NtNtNtCs*_14regex_automata3nfa8thompson7builderNtB*_7Builder5patch*)
    *(.text*._RNvMs*_NtNtNtCs*_14regex_automata3nfa8thompson8compilerNtB*_8Compiler5c_cap*)
    *(.text*._RNvXs*_NtCs*_12regex_syntax4utf8NtB*_13Utf8SequencesNtNtNtNtCs*_4core4iter6traits8iterator8Iterator4next*)
    *(.text*._RNvMs*_NtNtNtCs*_14regex_automata3nfa8thompson8compilerNtB*_12Utf8Compiler6finish*)
    *(.text*._RINvNtCs*_4core3ptr9drop_glueNtNtNtNtCs*_14regex_automata3nfa8thompson10range_trie9RangeTrieEB*_*)
    *(.text*._RNvMs*_NtNtCs*_14regex_automata6hybrid3dfaNtB*_7Builder9configure*)
    *(.text*._RINvNtCs*_4core3ptr9drop_glueINtNtCs*_5alloc5boxed3BoxNtNtCs*_12regex_syntax3hir3HirEECs*_14regex_automata*)
    *(.text*._RNvMs*_NtNtCs*_5regex5regex6stringNtB*_5Regex11captures_at*)
    *(.text*._RNvNtNtCs*_14regex_automata4util11determinize14add_nfa_states*)
    *(.text*._RNvMs*_NtNtCs*_14regex_automata6hybrid3dfaNtB*_4Lazy16cache_next_state*)
    *(.text*._RNvMs*_NtNtCs*_12regex_syntax3ast5parseINtB*_7ParserIQNtB*_6ParserE11parse_groupB*_*)
    *(.text*._RNvMs*_NtNtCs*_14regex_automata3dfa7onepassNtB*_15InternalBuilder10stack_push*)
    *(.text*._RNvNtNtCs*_14regex_automata4meta13reverse_inner7flatten*)
    *(.text*._RNvMs*_NtCs*_12regex_syntax3hirNtB*_3Hir9into_kind*)
    *(.text*._RNvMs*_NtNtCs*_14regex_automata4meta8strategyNtB*_4Core19search_slots_nofail*)
    *(.text*._RNvMs*_NtNtCs*_14regex_automata3dfa7onepassNtB*_3DFA16try_search_slots*)
    *(.text*._RNCINvNtCs*_8clj_eval6vm_ops2ssNtB*_3KstB*_NtB*_9ReMatchesNtB*_7AsValueE0B*_*)
    *(.text*._RNvNtCs*_8clj_eval2re12re_matches_2*)
    *(.text*._RINvXNtNtCs*_5alloc3vec14spec_from_elemNtNtNtNtCs*_14regex_automata3nfa8thompson3map16Utf8BoundedEntryNtB*_12SpecFromElem9from_elemNtNtB*_5alloc6GlobalEB*_*)
    *(.text*._RNvXs*_NtNtCs*_14regex_automata4meta8strategyNtB*_4CoreNtB*_8Strategy10group_info*)
    *(.text*._RNvMs*_NtNtCs*_14regex_automata6hybrid3dfaNtB*_4Lazy14set_transition*)
    *(.text*._RNvNtCs*_8clj_eval2re13native_re_seq*)
    *(.text*._RNvMs*_NtNtCs*_14regex_automata3dfa7onepassNtB*_15InternalBuilder15add_empty_state*)
    *(.text*._RINvNtCs*_4core3ptr9drop_glueNtNtCs*_3std7process6OutputECs*_8clj_eval*)
    *(.text*._RNvMs*_NtNtCs*_14regex_automata6hybrid3dfaNtB*_3DFA13match_pattern*)
    *(.text*._RNvMs*_NtNtCs*_14regex_automata3dfa7onepassNtB*_5Cache14explicit_slots*)
    *(.text*._RNvNtCs*_8clj_eval2re15fast_re_matches*)
    *(.text*._RNvNtCs*_5alloc5boxed14box_new_uninit.2246*)
    *(.text*._RNvMNtNtCs*_14regex_automata4util9prefilterNtB*_9Prefilter11from_choice*)
    *(.text*._RINvNtCs*_8clj_eval6vm_ops6shape2NtB*_9ReMatchesNtB*_7AsValueEB*_*)
    *(.text*._RNvMs*_NtNtCs*_12regex_syntax3ast5parseINtB*_7ParserIQNtB*_6ParserE16parse_perl_classB*_*)
    *(.text*._RNvMs*_NtNtCs*_12regex_syntax3hir9translateNtB*_11TranslatorI22hir_perl_unicode_class*)
    *(.text*._RNvMs*_NtNtNtCs*_14regex_automata3nfa8thompson8compilerNtB*_8Compiler10c_at_least*)
    *(.text*._RNvMs*_NtNtNtCs*_14regex_automata3nfa8thompson7builderNtB*_7Builder3add*)
    *(.text*._RNvMs*_NtNtNtCs*_14regex_automata3nfa8thompson8compilerNtB*_8Compiler1c*)
    *(.text*._RNvXs*_NtNtNtCs*_4core4iter8adapters3mapINtB*_3MapINtNtNtB*_5slice4iter4IterRNtNtCs*_12regex_syntax3hir3HirENCINvMs*_NtNtNtCs*_14regex_automata3nfa8thompson8compilerNtB*_8Compiler7compileB*_Es*_0ENtNtNtB*_6traits8iterator8Iterator4nextB*_*)
    *(.text*._RINvNtCs*_4core3ptr9drop_glueNtNtNtNtCs*_14regex_automata3nfa8thompson9backtrack7BuilderEB*_*)
    *(.text*._RINvNtCs*_4core3ptr9drop_glueNtNtNtCs*_14regex_automata6hybrid3dfa7BuilderEB*_*)
    *(.text*._RNvNtCs*_8clj_eval2re10match_text*)
    *(.text*._RNvMs*_NtCs*_12regex_syntax3astNtB*_3Ast5empty*)
    *(.text*._RNvNtCs*_8clj_eval2re17native_re_pattern*)
    *(.text*._RNvMs*_NtCs*_5alloc7raw_vecINtB*_6RawVecNtNtNtCs*_12regex_syntax3ast5parse10GroupStateE8grow_oneB*_*)
    *(.text*._RNvMs*_NtNtCs*_14regex_automata4util10sparse_setNtB*_9SparseSet6resize*)
    *(.text*._RNvMs*_NtCs*_9hashbrown3mapINtB*_7HashMapNtNtNtNtCs*_14regex_automata4util11determinize5state5StateNtNtNtB*_6hybrid2id11LazyStateIDNtNtNtCs*_3std4hash6random11RandomStateE6insertB*_*)
    *(.text*._RNvMs*_NtNtCs*_14regex_automata6hybrid5regexNtB*_5Regex10try_search*)
    *(.text*._RNvMs*_NtCs*_5alloc7raw_vecINtB*_6RawVechE8grow_oneB*_*)
    *(.text*._RNvMs*_NtNtCs*_14regex_automata6hybrid3dfaNtB*_3DFA14next_eoi_state*)
    *(.text*._RNvMs*_NtNtCs*_12regex_syntax3ast5parseINtB*_7ParserIQNtB*_6ParserE10peek_spaceB*_*)
    *(.text*._RNvMs*_NtNtCs*_12regex_syntax3ast5parseINtB*_7ParserIQNtB*_6ParserE4peekB*_*)
    *(.text*._RNvMs*_NtNtCs*_12regex_syntax3ast5parseINtB*_7ParserIQNtB*_6ParserE10push_groupB*_*)
    *(.text*._RNvNtNtCs*_14regex_automata4meta13reverse_inner23prefilter_with_literals*)
    *(.text*._RNvMs*_NtNtCs*_12regex_syntax3ast5parseINtB*_7ParserIQNtB*_6ParserE11parse_flagsB*_*)
    *(.text*._RNvXs*_NtNtNtCs*_14regex_automata4util9prefilter6memchrNtB*_6MemchrNtB*_10PrefilterI4find*)
    *(.text*._RINvNtCs*_4core3ptr9drop_glueINtNtCs*_5alloc3vec3VecNtNtNtNtCs*_14regex_automata3nfa8thompson3nfa5StateEEB*_*)
    *(.text*._RINvNtCs*_8clj_eval6vm_ops6shape1NtB*_6EmptyPNtB*_7AsValueEB*_*)
    *(.text*._RNvNtCs*_8clj_eval4seqs20native_butlast_owned*)
    *(.text*._RNvNtCs*_8clj_eval4lazy18step_iterate_value*)
    *(.text*._RNvNtCs*_8clj_eval4core14native_numberp*)
    *(.text*._RNCINvNtCs*_8clj_eval6vm_ops2ssNtB*_3RegNtB*_3KstNtB*_2GtNtB*_7AsValueE0B*_*)
    *(.text*._RNvNtCs*_8clj_eval4lazy11idrop_shift*)
    *(.text*._RNvNtCs*_8clj_eval4seqs12native_cycle*)
    *(.text*._RNvXNtCs*_4core3anyNtNtCs*_9clj_value3seq10CycleValueNtB*_3Any7type_idB*_*)
    *(.text*._RNvNtCs*_8clj_eval4core10native_neg*)
    *(.text*._RNvNtCs*_8clj_eval4lazy12iterate_seed*)
    *(.text*._RNvYNtNtCs*_9clj_value3seq10CycleValueNtNtB*_9extension14ExtensionValue10as_any_mutB*_*)
    *(.text*._RNvMs*_NtCs*_5alloc4syncINtB*_3ArcSIB*_SNtNtCs*_9clj_value5value5ValueEE9drop_slowB*_*)
    *(.text*._RNvNtCs*_8clj_eval4core12idrop_coerce*)
    *(.text*._RNvNtCs*_8clj_eval4seqs15native_take_nth*)
    *(.text*._RNCINvNtCs*_8clj_eval6vm_ops2s1NtB*_3KstNtB*_5SeqOpNtB*_7AsValueE0B*_*)
    *(.text*._RNvNtCs*_8clj_eval4lazy7seq_str*)
    *(.text*._RINvNtCs*_4core3ptr9drop_glueTNtNtCs*_9clj_value3seq8RangeNumB*_bEECs*_8clj_eval*)
    *(.text*._RNCINvNtCs*_8clj_eval6vm_ops2ssNtB*_2UpNtB*_3RegNtB*_2LtNtB*_6AsTestE0B*_*)
    *(.text*._RNvNtCs*_8clj_eval4coll16native_not_empty*)
    *(.text*._RNvNtCs*_8clj_eval4seqs20native_partition_all*)
    *(.text*._RNCINvNtCs*_8clj_eval6vm_ops2ssNtB*_3RegNtB*_3KstNtB*_2LtNtB*_7AsValueE0B*_*)
    *(.text*._RNvXs*_NtCs*_9clj_value3seqNtB*_10CycleValueNtNtB*_9extension14ExtensionValue6as_any*)
    *(.text*._RNvNtCs*_8clj_eval4seqs18native_doall_owned*)
    *(.text*._RNvNtCs*_8clj_eval13vm_intrinsics6nth_of*)
    *(.text*._RNvXs*_NtCs*_9clj_value3seqNtB*_12IterateValueNtNtB*_9extension14ExtensionValue6as_any*)
    *(.text*._RNvXNtCs*_4core3anyNtNtCs*_9clj_value3seq12IterateValueNtB*_3Any7type_idB*_*)
    *(.text*._RINvNtCs*_4core3ptr9drop_glueNtNtCs*_9clj_value3seq12IterateValueECs*_8clj_eval*)
    *(.text*._RNCINvNtCs*_8clj_eval6vm_ops2s1NtB*_3KstNtB*_6EmptyPNtB*_7AsValueE0B*_*)
    *(.text*._RINvNtCs*_8clj_eval6vm_ops6shape2NtB*_2GtNtB*_7AsValueEB*_*)
    *(.text*._RNvNtCs*_8clj_eval4seqs11native_keep*)
    *(.text*._RNvNtCs*_8clj_eval4seqs18native_map_indexed*)
    *(.text*._RNvNtCs*_8clj_eval4lazy16step_map_indexed*)
    *(.text*._RNvNtCs*_8clj_eval4seqs17native_split_with*)
    *(.text*._RNvNtCs*_8clj_eval4seqs17native_interleave*)
    *(.text*._RNvNtCs*_8clj_eval4seqs15native_distinct*)
    *(.text*._RNvNtCs*_8clj_eval4seqs14native_iterate*)
    *(.text*._RNvNtCs*_8clj_eval4lazy16step_cycle_value*)
    *(.text*._RNCINvNtCs*_8clj_eval6vm_ops2s1NtB*_3RegNtB*_3OddNtB*_6AsTestE0B*_*)
    *(.text*._RNvNtCs*_8clj_eval4seqs13native_remove*)
    *(.text*._RNCINvNtCs*_8clj_eval6vm_ops2xxNtB*_2LtNtB*_6AsTestE0B*_*)
    *(.text*._RNvYNCINvNtCs*_8clj_eval6vm_ops6fold_nNtB*_3AddNtB*_7AsValueE0INtNtNtCs*_4core3ops8function6FnOnceTRSRNtNtCs*_9clj_value5value5ValueEE9call_onceB*_*)
    *(.text*._RNvNtCs*_8clj_eval4coll12update_in_up*)
    *(.text*._RINvNtCs*_4core3ptr9drop_glueNCNvMs*_NtCs*_8clj_eval2vmNtB*_8Compiler13compile_arity0EB*_*)
    *(.text*._RNvNtCs*_8clj_eval4coll19native_update_owned*)
    *(.text*._RNCINvNtCs*_8clj_eval6vm_ops2ssNtB*_3RegNtB*_3KstNtB*_3GetNtB*_7AsValueE0B*_*)
    *(.text*._RNvNtCs*_8clj_eval4coll10native_key*)
    *(.text*._RNvNtCs*_8clj_eval4coll18native_select_keys*)
    *(.text*._RNvMs*_NtCs*_8clj_eval2vmNtB*_8Compiler13compile_recur*)
    *(.text*._RINvXs*_NtCs*_9clj_value5valueNtB*_3MapNtNtCs*_4core4hash4Hash4hashNtCs*_10rustc_hash8FxHasherEB*_*)
    *(.text*._RNvNtCs*_8clj_eval4coll22native_update_in_owned*)
    *(.text*._RINvXs*_NtCs*_9clj_value5valueNtB*_5ValueNtNtCs*_4core4hash4Hash4hashNtNtNtCs*_3std4hash6random13DefaultHasherEB*_*)
    *(.text*._RNvNtCs*_8clj_eval4coll11assoc_in_up*)
    *(.text*._RINvNtCs*_4core3ptr9drop_glueNCINvNtCs*_8clj_eval6vm_ops4naryNtB*_6AsTestE0EB*_*)
    *(.text*._RINvNtCs*_8clj_eval6vm_ops6shape2NtB*_3GetNtB*_7AsValueEB*_*)
    *(.text*._RINvNtCs*_8clj_eval6vm_ops6shape1NtB*_3NotNtB*_6AsTestEB*_*)
    *(.text*._RINvNtCs*_8clj_eval6vm_ops6fold_nNtB*_3AddNtB*_7AsValueEB*_*)
    *(.text*._RINvNtCs*_8clj_eval6vm_ops6shape1NtB*_6NegateNtB*_7AsValueEB*_*)
    *(.text*._RINvNtCs*_8clj_eval6vm_ops6shape2NtB*_3LteNtB*_6AsTestEB*_*)
    *(.text*._RNCNvNtCs*_8clj_eval2vm6recur20B*_*)
    *(.text*._RNvNtCs*_8clj_eval4coll21native_assoc_in_owned*)
    *(.text*._RNCINvNtCs*_8clj_eval6vm_ops2s1NtB*_3RegNtB*_4EvenNtB*_7AsValueE0B*_*)
    *(.text*._RNvNtCs*_8clj_eval11core_macros14expand_comment*)
    *(.text*._RNvNtCs*_8clj_eval4coll11take_lookup*)
    *(.text*._RNvNtCs*_8clj_eval9vm_scalar6misses*)
    *(.text*._RINvNtCs*_4core3ptr9drop_glueINtNtCs*_5alloc5boxed3BoxSINtNtB*_6option6OptionNtNtCs*_8clj_eval9vm_scalar5IExprEEEB*_*)
    *(.text*._RINvNtCs*_8clj_eval6vm_ops6shape2NtB*_3LteNtB*_7AsValueEB*_*)
    *(.text*._RNvNtCs*_9clj_value5value10coll_equiv*)
    *(.text*._RNvNtCs*_9clj_value5value14map_coll_equiv*)
    *(.text*._RINvNtNtNtCs*_4core5slice4sort6stable14driftsort_mainjNCINvMNtCs*_5alloc5sliceSj7sort_byNCNvNtCs*_8clj_eval4seqs13sort_by_index0E0INtNtB*_3vec3VecjEEB*_*)
    *(.text*._RINvNtNtNtNtCs*_4core5slice4sort6stable5drift4sortjNCINvMNtCs*_5alloc5sliceSj7sort_byNCNvNtCs*_8clj_eval4seqs13sort_by_index0E0EB*_*)
    *(.text*._RINvNtNtNtNtCs*_4core5slice4sort6shared9smallsort12sort4_stablejNCINvMNtCs*_5alloc5sliceSj7sort_byNCNvNtCs*_8clj_eval4seqs13sort_by_index0E0EB*_*)
    *(.text*._RINvNtNtNtNtCs*_4core5slice4sort6stable9quicksort9quicksortjNCINvMNtCs*_5alloc5sliceSj7sort_byNCNvNtCs*_8clj_eval4seqs13sort_by_index0E0EB*_*)
    *(.text*._RNvNtCs*_8clj_eval4seqs8cmp_ints*)
    *(.text*._RINvNtNtNtNtCs*_4core5slice4sort6shared5pivot11median3_recjNCINvMNtCs*_5alloc5sliceSj7sort_byNCNvNtCs*_8clj_eval4seqs13sort_by_index0E0EB*_*)
    *(.text*._RINvNtNtNtNtCs*_4core5slice4sort6shared9smallsort19bidirectional_mergejNCINvMNtCs*_5alloc5sliceSj7sort_byNCNvNtCs*_8clj_eval4seqs13sort_by_index0E0EB*_*)
    *(.text*._RNvNtCs*_8clj_eval4coll17native_sorted_set*)
    *(.text*._RNvNtCs*_8clj_eval4coll15sorted_map_from*)
    *(.text*._RNvMs*_NtCs*_9clj_value5valueNtB*_3Map12ordered_keys*)
    *(.text*._RNvNtCs*_8clj_eval4core9native_lt*)
    *(.text*._RNvYNCNvNtCs*_8clj_eval4core9native_lts*_0INtNtNtCs*_4core3ops8function6FnOnceTxxEE9call_onceB*_*)
    *(.text*._RNvNtCs*_8clj_eval4coll13bound_include*)
    *(.text*._RINvNtCs*_8clj_eval6vm_ops6shape2NtB*_6DissocNtB*_7AsValueEB*_*)
    *(.text*._RNCINvMNtCs*_5alloc5sliceSNtNtCs*_9clj_value5value5Value7sort_byNCINvNtCs*_8clj_eval4seqs15sort_by_checkedNCNvB*_17native_sort_owned0E0E0B*_*)
    *(.text*._RNvNtCs*_8clj_eval4coll20sorted_subseq_source*)
    *(.text*._RNvNtCs*_8clj_eval4coll14native_rsubseq*)
    *(.text*._RNCINvNtCs*_8clj_eval6vm_ops2xsNtB*_3KstNtB*_6DissocNtB*_7AsValueE0B*_*)
    *(.text*._RINvNtNtNtNtCs*_4core5slice4sort6shared9smallsort25insertion_sort_shift_leftNtNtCs*_9clj_value5value5ValueNCINvMNtCs*_5alloc5sliceSB*_7sort_byNCINvNtCs*_8clj_eval4seqs15sort_by_checkedNCNvB*_17native_sort_owned0E0E0EB*_*)
    *(.text*._RNvNtCs*_8clj_eval4coll15sorted_set_from*)
    *(.text*._RNvNtCs*_8clj_eval4core10native_sub*)
    *(.text*._RNvNtCs*_8clj_eval4core13compare_utf16*)
    *(.text*._RNvNtCs*_8clj_eval4coll17native_sorted_map*)
    *(.text*._RNvNtCs*_8clj_eval4coll16sorted_assoc_map*)
    *(.text*._RNvNtCs*_8clj_eval4coll11subseq_walk*)
    *(.text*._RNvNtCs*_8clj_eval4coll13native_subseq*)
    *(.text*._RINvXNvMNtCs*_5alloc5sliceSp9to_vec_inNtNtCs*_9clj_value5value5ValueNtB*_10ConvertVec6to_vecNtNtB*_5alloc6GlobalECs*_8clj_eval*)
    *(.text*._RNvXs*_NtCs*_5alloc6stringlNtB*_12SpecToString14spec_to_string.918*)
    *(.text*._RNvNtCs*_8clj_eval4core17native_parse_long*)
    *(.text*._RNCINvMs*_NtNtCs*_3std4sync4onceNtB*_4Once15call_once_forceNCINvMNtB*_9once_lockINtB*_8OnceLockINtNtCs*_5alloc3vec3VecINtNtB*_4sync3ArceEEE10initializeNCINvB*_11get_or_initNCNvNtCs*_9clj_value3seq14cached_num_strs*_0E0zE0E0B*_*)
    *(.text*._RNCINvMNtNtCs*_4core3ops9try_traitINtB*_17NeverShortCircuituE10wrap_mut_2ulNCINvNtNtNtB*_4iter8adapters3map8map_foldlINtNtCs*_5alloc4sync3ArceEuNCNCNvNtCs*_9clj_value3seq14cached_num_strs*_00NCINvNvNtNtNtB*_6traits8iterator8Iterator8for_each4callB*_NCINvMs*_NtB*_3vecINtB*_3VecB*_E14extend_trustedINtB*_3MapINtNtB*_5range14RangeInclusivelEB*_EE0E0E0E0B*_*)
    *(.text*._RINvNtCs*_4core3ptr9drop_glueNtNtCs*_9clj_value3seq13SplitVecValueECs*_8clj_eval*)
    *(.text*._RINvMNtNtCs*_3std4sync9once_lockINtB*_8OnceLockNtNtCs*_9clj_value3seq14SubVectorValueE10initializeNCINvB*_11get_or_initNCNvMs*_B*_NtB*_13SplitVecValue4view0E0zEB*_*)
    *(.text*._RNvXs*_NtNtCs*_5alloc3vec21spec_from_iter_nestedINtB*_3VecNtNtCs*_9clj_value5value5ValueEINtB*_18SpecFromIterNestedB*_INtNtNtNtCs*_4core4iter8adapters3map3MapINtNtNtB*_5slice4iter4IterTmmEENCNvMs*_NtB*_3seqNtB*_13SplitVecValue4iter0EE9from_iterB*_*)
    *(.text*._RNvNtCs*_8clj_eval4lazy19step_subvector_unit*)
    *(.text*._RNvXs*_NtCs*_9clj_value3seqNtB*_13SplitVecValueNtNtB*_9extension14ExtensionValue6as_any*)
    *(.text*._RNvXNtCs*_4core3anyNtNtCs*_9clj_value3seq13SplitVecValueNtB*_3Any7type_idB*_*)
    *(.text*._RNCINvMs*_NtNtCs*_3std4sync4onceNtB*_4Once15call_once_forceNCINvMNtB*_9once_lockINtB*_8OnceLockNtNtCs*_9clj_value3seq14SubVectorValueE10initializeNCINvB*_11get_or_initNCNvMs*_B*_NtB*_13SplitVecValue4view0E0zE0E0B*_*)
    *(.text*._RINvMNtNtCs*_3std4sync9once_lockINtB*_8OnceLockINtNtCs*_5alloc3vec3VecINtNtB*_4sync3ArceEEE10initializeNCINvB*_11get_or_initNCNvNtCs*_9clj_value3seq14cached_num_strs*_0E0zEB*_*)
    *(.text*._RNvNtCs*_8clj_eval11concurrency15native_volatile*)
    *(.text*._RINvMs*_NtCs*_9hashbrown3rawINtB*_8RawTableTNtNtCs*_9clj_value5value5ValueB*_EE14reserve_rehashNCINvNtB*_3map11make_hasherB*_B*_INtNtCs*_4core4hash18BuildHasherDefaultNtCs*_10rustc_hash8FxHasherEE0EB*_*)
    *(.text*._RINvNtCs*_4core3ptr9drop_glueNtNtCs*_9clj_value9transient12TransientSetEB*_*)
    *(.text*._RNvNtCs*_8clj_eval11concurrency13native_vreset*)
    *(.text*._RINvNtCs*_4core3ptr9drop_glueNCINvNtCs*_8clj_eval6vm_ops2sxNtB*_2UpNtB*_10ConjBangFxNtB*_7AsValueE0EB*_*)
    *(.text*._RINvNtCs*_4core3ptr9drop_glueNtNtCs*_8clj_eval2vm4StepEB*_*)
    *(.text*._RNvMs*_NtCs*_9clj_value4trieINtB*_6PackedxE8into_vecB*_*)
    *(.text*._RINvMs*_NtCs*_9hashbrown3rawINtB*_8RawTableTNtNtCs*_9clj_value5value5ValueuEE14reserve_rehashNCINvNtB*_3map11make_hasherB*_uINtNtCs*_4core4hash18BuildHasherDefaultNtCs*_10rustc_hash8FxHasherEE0EB*_*)
    *(.text*._RINvNtCs*_4core3ptr9drop_glueINtNtB*_4cell10UnsafeCellNtNtCs*_9clj_value4atom9AtomStateEEB*_*)
    *(.text*._RNvMs*_NtCs*_5alloc4syncINtB*_3ArcINtNtNtNtCs*_3std4sync6poison5mutex5MutexNtNtCs*_9clj_value5value5ValueEE9drop_slowB*_*)
    *(.text*._RNCINvNtCs*_8clj_eval6vm_ops2x1NtB*_3IncNtB*_7AsValueE0B*_*)
    *(.text*._RNvMs*_NtCs*_9clj_value9transientNtB*_9Transient9with_meta*)
    *(.text*._RNvMs*_NtCs*_5alloc4syncINtB*_3ArcNtNtCs*_9clj_value9transient13TransientLockE9drop_slowB*_*)
    *(.text*._RINvNtCs*_4core3ptr9drop_glueNtNtCs*_9clj_value9transient15TransientVectorEB*_*)
    *(.text*._RNvMs*_NtCs*_9clj_value9transientNtB*_12TransientMap5assoc*)
    *(.text*._RNvNtCs*_8clj_eval4coll22native_transient_owned*)
    *(.text*._RNvNtCs*_8clj_eval4coll23native_persistent_owned*)
    *(.text*._RNvMs*_NtCs*_5alloc4syncINtB*_3ArcINtNtNtNtCs*_3std4sync6poison5mutex5MutexNtNtCs*_9clj_value4atom9AtomStateEE9drop_slowB*_*)
    *(.text*._RNCINvNtCs*_8clj_eval6vm_ops2sxNtB*_3RegNtB*_3SubNtB*_7AsValueE0B*_*)
    *(.text*._RNvNtCs*_8clj_eval4coll16native_conj_bang*)
    *(.text*._RNvMs*_NtCs*_9hashbrown3mapINtB*_7HashMapNtNtCs*_9clj_value5value5ValueB*_INtNtCs*_4core4hash18BuildHasherDefaultNtCs*_10rustc_hash8FxHasherEE6insertB*_*)
    *(.text*._RNvNtCs*_8clj_eval11concurrency12native_reset*)
    *(.text*._RNCINvNtCs*_8clj_eval6vm_ops3sssNtB*_3RegB*_B*_NtB*_9AssocBangE0B*_*)
    *(.text*._RINvNtCs*_4core3ptr9drop_glueNCINvNtCs*_8clj_eval6vm_ops2xxNtB*_10ConjBangFxNtB*_7AsValueE0EB*_*)
    *(.text*._RINvNtCs*_4core3ptr9drop_glueNCINvNtCs*_8clj_eval6vm_ops3sssNtB*_3RegB*_B*_NtB*_11AssocBangFxE0EB*_*)
    *(.text*._RNvNtCs*_8clj_eval14builtin_expand12expand_vswap*)
    *(.text*._RNCINvNtCs*_8clj_eval6vm_ops2ssNtB*_3RegB*_NtB*_2LtNtB*_6AsTestE0B*_*)
    *(.text*._RINvNtCs*_4core3ptr9drop_glueINtNtNtNtCs*_3std11collections4hash3map8IntoIterNtNtCs*_9clj_value5value5ValueB*_EEB*_*)
    *(.text*._RNvMs*_NtCs*_9hashbrown3mapINtB*_7HashMapNtNtCs*_9clj_value5value5ValueuINtNtCs*_4core4hash18BuildHasherDefaultNtCs*_10rustc_hash8FxHasherEE6insertB*_*)
    *(.text*._RNvMs*_NtCs*_5alloc7raw_vecINtB*_6RawVecNtNtCs*_8clj_eval4coll12StrScanEntryE8grow_oneB*_*)
    *(.text*._RINvNtNtNtNtCs*_3std3sys12thread_local6native5eager7destroyINtNtCs*_4core4cell7RefCellTAINtNtB*_6option6OptionTINtNtCs*_5alloc4sync4WeakeENtNtCs*_8clj_eval4coll7StrScanEEj4_jEEEB*_*)
    *(.text*._RNvNtCs*_8clj_eval4coll12memoize_scan*)
    *(.text*._RNvNtCs*_8clj_eval4coll8str_scan*)
    *(.text*._RNvNtCs*_8clj_eval14stdlib_natives11native_trim*)
    *(.text*._RNCINvNtCs*_8clj_eval6vm_ops2xsNtB*_3KstNtB*_2LtNtB*_6AsTestE0B*_*)
    *(.text*._RNvXs*_NtCs*_5alloc6stringNtB*_6StringNtNtCs*_4core3fmt5Write9write_str.2213*)
    *(.text*._RNvMs*_NtCs*_5alloc7raw_vecINtB*_6RawVecNtNtNtCs*_12aho_corasick3nfa13noncontiguous10TransitionE8grow_oneB*_*)
    *(.text*._RNvMs*_NtCs*_5alloc7raw_vecINtB*_6RawVecNtNtNtCs*_12aho_corasick3nfa13noncontiguous5MatchE8grow_oneB*_*)
    *(.text*._RNvMs*_NtNtCs*_12aho_corasick4util9prefilterNtB*_7Builder5build*)
    *(.text*._RINvNtCs*_4core3ptr9drop_glueNtNtNtCs*_12aho_corasick4util9prefilter7BuilderECs*_14regex_automata*)
    *(.text*._RNvXs*_NtNtCs*_14regex_automata4meta8strategyINtB*_3PreNtNtNtNtB*_4util9prefilter5teddy5TeddyENtB*_8Strategy12create_cacheB*_*)
    *(.text*._RNvMNtNtCs*_12aho_corasick6packed9rabinkarpNtB*_9RabinKarp7find_at*)
    *(.text*._RINvNtCs*_4core3ptr9drop_glueINtNtNtCs*_14regex_automata4meta8strategy3PreNtNtNtNtB*_4util9prefilter5teddy5TeddyEEB*_*)
    *(.text*._RINvMs*_NtCs*_5alloc3stre7replaceReECs*_8clj_eval*)
    *(.text*._RNvNtCs*_8clj_eval8collmisc17native_re_matcher*)
    *(.text*._RNvMs*_NtNtCs*_12aho_corasick3nfa13noncontiguousNtB*_8Compiler3new*)
    *(.text*._RNvMs*_NtNtCs*_12aho_corasick3nfa13noncontiguousNtB*_3NFA15init_full_state*)
    *(.text*._RNvMs*_NtNtCs*_12aho_corasick3nfa13noncontiguousNtB*_3NFA12copy_matches*)
    *(.text*._RINvNvMs*_NtCs*_5alloc7raw_vecINtB*_11RawVecInnerpE7reserve21do_reserve_and_handleNtNtB*_5alloc6GlobalECs*_12aho_corasick*)
    *(.text*._RNvXNtCs*_4core3anyNtNtCs*_8clj_eval8collmisc13MatcherHandleNtB*_3Any7type_idB*_*)
    *(.text*._RNvXs*_NtNtCs*_14regex_automata4meta8strategyINtB*_3PreNtNtNtNtB*_4util9prefilter5teddy5TeddyENtB*_8Strategy6searchB*_*)
    *(.text*._RNvMs*_NtCs*_5alloc7raw_vecINtB*_6RawVeccE8grow_oneCs*_12regex_syntax*)
    *(.text*._RINvMs*_NtCs*_9hashbrown3rawINtB*_8RawTableTReuEE14reserve_rehashNCINvNtB*_3map11make_hasherB*_uNtNtNtCs*_3std4hash6random11RandomStateE0ECs*_8clj_eval*)
    *(.text*._RNvMs*_NtNtCs*_12aho_corasick3nfa13noncontiguousNtB*_8Compiler24set_anchored_start_state*)
    *(.text*._RNvMs*_NtCs*_5alloc4syncINtB*_3ArcINtNtNtNtCs*_3std4sync6poison5mutex5MutexNtNtCs*_8clj_eval8collmisc12MatcherStateEE9drop_slowB*_*)
    *(.text*._RNCINvNtCs*_8clj_eval6vm_ops2xsNtB*_3RegNtB*_2EqNtB*_6AsTestE0B*_*)
    *(.text*._RNvMs*_NtCs*_5alloc4syncINtB*_3ArcNtNtNtCs*_12aho_corasick6packed7pattern8PatternsE9drop_slowB*_*)
    *(.text*._RNvNtCs*_8clj_eval14stdlib_natives18native_starts_with*)
    *(.text*._RNvMs*_NtNtNtNtCs*_12aho_corasick6packed5teddy7builder6x86_64INtB*_8SlimAVX2Kj1_E3new*)
    *(.text*._RNvMs*_NtNtNtNtCs*_12aho_corasick6packed5teddy7builder6x86_64INtB*_8SlimAVX2Kj1_E13new_unchecked*)
    *(.text*._RNvMs*_NtCs*_5alloc7raw_vecINtB*_6RawVecNtNtNtCs*_12aho_corasick3nfa13noncontiguous5StateE8grow_oneB*_*)
    *(.text*._RINvMs*_NtNtCs*_12aho_corasick3nfa13noncontiguousNtB*_8Compiler10build_trieRSNtNtNtCs*_12regex_syntax3hir7literal7LiteralRB*_ECs*_14regex_automata*)
    *(.text*._RNvMs*_NtNtCs*_12aho_corasick3nfa13noncontiguousNtB*_8Compiler31add_unanchored_start_state_loop*)
    *(.text*._RNvMs*_NtNtCs*_5alloc11collections9vec_dequeINtB*_8VecDequeNtNtNtCs*_12aho_corasick4util10primitives7StateIDE4growB*_*)
    *(.text*._RNvMNtNtCs*_12aho_corasick6packed9rabinkarpNtB*_9RabinKarp6verify*)
    *(.text*._RNvNtCs*_8clj_eval4core20native_unchecked_inc*)
    *(.text*._RNvNtCs*_8clj_eval4core20native_unchecked_dec*)
    *(.text*._RINvNtCs*_4core3ptr9drop_glueNtNtCs*_12aho_corasick3dfa3DFAECs*_14regex_automata*)
    *(.text*._RNvNtCs*_8clj_eval11core_macros13expand_dotdot*)
    *(.text*._RNCNvNtNtCs*_4core3str7pattern13simd_containss*_0Cs*_8clj_eval*)
    *(.text*._RNvMs*_NtCs*_5alloc7raw_vecINtB*_6RawVecINtNtB*_3vec3VechEE8grow_oneCs*_3std*)
    *(.text*._RNvMs*_NtCs*_5alloc7raw_vecINtB*_6RawVecTjNtNtNtCs*_12aho_corasick4util10primitives9PatternIDEE8grow_oneB*_*)
    *(.text*._RINvMs*_NtNtCs*_12aho_corasick3nfa13noncontiguousNtB*_7Builder5buildRSNtNtNtCs*_12regex_syntax3hir7literal7LiteralRB*_ECs*_14regex_automata*)
    *(.text*._RNvMs*_NtNtCs*_12aho_corasick4util8alphabetNtB*_12ByteClassSet12byte_classes*)
    *(.text*._RNvMs*_NtNtCs*_12aho_corasick3nfa13noncontiguousNtB*_8Compiler7shuffle*)
    *(.text*._RNvNtCs*_8clj_eval14stdlib_natives18native_split_lines*)
    *(.text*._RINvNtCs*_4core3ptr9drop_glueNtNtNtCs*_12aho_corasick6packed3api8SearcherECs*_14regex_automata*)
    *(.text*._RINvNtCs*_4core3ptr9drop_glueINtNtNtNtNtCs*_12aho_corasick6packed5teddy7builder6x86_648SlimAVX2Kj1_EEB*_*)
    *(.text*._RNvNtCs*_8clj_eval4core11native_subs*)
    *(.text*._RNvNtCs*_8clj_eval14stdlib_natives16native_ends_with*)
    *(.text*._RNvNtCs*_8clj_eval8classemu21str_last_index_search*)
    *(.text*._RNvMs*_NtCs*_5alloc7raw_vecINtB*_6RawVecNtNtNtCs*_12regex_syntax3hir7literal7LiteralE8grow_oneB*_*)
    *(.text*._RNvMNtNtCs*_12aho_corasick6packed7patternNtB*_8Patterns3add*)
    *(.text*._RNvMs*_NtCs*_5alloc7raw_vecINtB*_6RawVecNtNtNtCs*_12aho_corasick4util10primitives7StateIDE8grow_oneB*_*)
    *(.text*._RNvMs*_NtNtCs*_12aho_corasick3nfa13noncontiguousNtB*_3NFA14add_transition*)
    *(.text*._RNvMs*_NtNtCs*_12aho_corasick3nfa13noncontiguousNtB*_3NFA9add_match*)
    *(.text*._RNvMs*_NtNtCs*_12aho_corasick3nfa13noncontiguousNtB*_8Compiler7densify*)
    *(.text*._RNvMNtNtCs*_14regex_automata4meta8strategyINtB*_3PreNtNtNtNtB*_4util9prefilter5teddy5TeddyE3newB*_*)
    *(.text*._RNvNtCs*_8clj_eval14stdlib_natives15native_includes*)
    *(.text*._RINvMs*_NtCs*_9hashbrown3rawINtB*_8RawTableTReINtNtCs*_5alloc4sync3ArcINtNtNtNtCs*_3std11collections4hash3set7HashSetB*_EEEE14reserve_rehashNCINvNtB*_3map11make_hasherB*_B*_NtNtNtB*_4hash6random11RandomStateE0ECs*_8clj_eval*)
    *(.text*._RNvMs*_NtCs*_5alloc7raw_vecNtB*_11RawVecInner11finish_growCs*_12aho_corasick*)
    *(.text*._RNvMs*_NtNtCs*_12aho_corasick3nfa13noncontiguousNtB*_8Compiler24fill_failure_transitions*)
    *(.text*._RNvMs*_NtNtCs*_12aho_corasick3nfa13noncontiguousNtB*_9QueuedSet6insert*)
    *(.text*._RNvMs*_NtNtCs*_12aho_corasick3nfa13noncontiguousNtB*_8Compiler35close_start_state_loop_for_leftmost*)
    *(.text*._RINvNtCs*_4core3ptr9drop_glueNtNtCs*_12regex_syntax3ast8ClassSetECs*_14regex_automata*)
    *(.text*._RNvXs*_NtCs*_8clj_eval8collmiscNtB*_13MatcherHandleNtNtCs*_9clj_value9extension14ExtensionValue6as_any*)
    *(.text*._RNvXs*_NtNtNtCs*_14regex_automata4util9prefilter5teddyNtB*_5TeddyNtB*_10PrefilterI4find*)
    *(.text*._RINvYNtNtNtCs*_4core3str4iter5CharsNtNtNtNtB*_4iter6traits8iterator8Iterator8try_folduNCINvNvB*_3all5checkcNvNtCs*_8clj_eval8classemu18java_is_whitespaceE0INtNtNtB*_3ops12control_flow11ControlFlowuEEB*_*)
    *(.text*._RNCINvNtCs*_8clj_eval6vm_ops2ssNtB*_3RegB*_NtB*_2EqNtB*_6AsTestE0B*_*)
    *(.text*._RNvNtCs*_10clj_reader8metaform20assoc_unless_present*)
    *(.text*._RINvXNtNtCs*_5alloc3vec14spec_from_elemINtB*_3VecNtNtNtCs*_12aho_corasick4util10primitives9PatternIDENtB*_12SpecFromElem9from_elemNtNtB*_5alloc6GlobalEB*_*)
    *(.text*._RNvMs*_NtNtNtCs*_5alloc11collections5btree3mapINtB*_8BTreeMapINtNtB*_5boxed3BoxShEjE6insertCs*_12aho_corasick*)
    *(.text*._RNvMs*_NtNtCs*_12aho_corasick3nfa13noncontiguousNtB*_8Compiler27init_unanchored_start_state*)
    *(.text*._RINvNtCs*_4core3ptr9drop_glueNtNtNtCs*_12aho_corasick3nfa13noncontiguous9QueuedSetEB*_*)
    *(.text*._RINvMs*_NtCs*_12aho_corasick3dfaNtB*_3DFA11set_matchesINtNtNtNtCs*_4core4iter7sources7from_fn6FromFnNCNvMs*_NtNtB*_3nfa13noncontiguousNtB*_3NFA12iter_matches0EEB*_*)
    *(.text*._RNvXs*_NtNtCs*_5alloc3vec5drainINtB*_5DrainNtNtCs*_12regex_syntax3ast12ClassSetItemENtNtNtCs*_4core3ops4drop4Drop4dropB*_*)
    *(.text*._RNvXs*_NtNtNtNtCs*_12aho_corasick6packed5teddy7builder6x86_64INtB*_8SlimAVX2Kj1_ENtB*_9SearcherT4find*)
    *(.text*._RINvXs*_NtCs*_5alloc6stringNtB*_6StringINtNtNtNtCs*_4core4iter6traits7collect12FromIteratorcE9from_iterINtNtNtB*_8adapters3rev3RevNtNtNtB*_3str4iter5CharsEECs*_8clj_eval*)
    *(.text*._RINvMNtNtCs*_3std4sync9once_lockINtB*_8OnceLockINtNtNtB*_6poison5mutex5MutexINtNtNtNtB*_11collections4hash3map7HashMapReINtNtCs*_5alloc4sync3ArcINtNtB*_3set7HashSetB*_EEEEE10initializeNCINvB*_11get_or_initNvYB*_NtNtCs*_4core7default7Default7defaultE0zECs*_8clj_eval*)
    *(.text*._RNvMs*_NtNtCs*_12aho_corasick6packed3apiNtB*_7Builder5build*)
    *(.text*._RNvMs*_NtNtNtCs*_12aho_corasick6packed5teddy7genericINtB*_5TeddyKj8_E3newB*_*)
    *(.text*._RNvMs*_NtCs*_12aho_corasick3dfaNtB*_7Builder24build_from_noncontiguous*)
    *(.text*._RINvNtCs*_4core3ptr9drop_glueNtNtNtCs*_12aho_corasick3nfa13noncontiguous3NFAECs*_14regex_automata*)
    *(.text*._RINvNtCs*_4core3ptr9drop_glueNtNtCs*_8clj_eval8collmisc13MatcherHandleEB*_*)
    *(.text*._RNvNtCs*_8clj_eval14stdlib_natives12native_blank*)
    *(.text*._RNvMNtNtCs*_12regex_syntax3hir7literalNtB*_9Extractor5union*)
    *(.text*._RINvNtCs*_4core3ptr9drop_glueAINtNtCs*_5alloc3vec3VecNtNtNtCs*_12aho_corasick4util10primitives9PatternIDEj8_EB*_*)
    *(.text*._RNvCs*_7___rustc19___rust_alloc_zeroed*)
    *(.text*._RINvNtCs*_9clj_value4trie8new_pathxEB*_*)
    *(.text*._RNvMs*_NtCs*_9clj_value4trieINtB*_4PVecxE13push_back_mutB*_*)
    *(.text*._RNvMs*_NtCs*_5alloc4syncINtB*_3ArcINtNtCs*_9clj_value4trie4NodecEE9drop_slowB*_*)
    *(.text*._RNvMs*_NtCs*_5alloc4syncINtB*_3ArcINtNtCs*_9clj_value4trie4NodexEE8make_mutB*_*)
    *(.text*._RINvYNtNtCs*_9clj_value5value10VectorIterNtNtNtNtCs*_4core4iter6traits8iterator8Iterator8try_foldINtNtNtB*_3num7nonzero7NonZerojENCNvXs*_NvB*_10advance_byB*_NtB*_13SpecAdvanceBy15spec_advance_by0INtNtB*_6option6OptionB*_EECs*_8clj_eval*)
    *(.text*._RINvNtNtCs*_4core4iter8adapters11try_processINtNtB*_3map3MapINtNtNtB*_3ops5range5RangexENCNvNtCs*_8clj_eval4lazy14collect_directs*_0ExINtNtB*_6option6OptionNtNtB*_7convert10InfallibleENCINvXs*_B*_IB*_INtNtCs*_5alloc3vec3VecxEEINtNtNtB*_6traits7collect12FromIteratorIB*_xEE9from_iterB*_E0B*_EB*_*)
    *(.text*._RNvMs*_NtCs*_9clj_value4trieINtB*_6PackedNtNtB*_5value5ValueE3setB*_*)
    *(.text*._RNvNtCs*_8clj_eval4seqs11native_rseq*)
    *(.text*._RNvNtCs*_9clj_value5print16print_sequential*)
    *(.text*._RNvXs*_NtCs*_9clj_value3seqNtB*_14SubVectorValueNtNtB*_9extension14ExtensionValue10class_name*)
    *(.text*._RNvNtCs*_8clj_eval4seqs20native_filterv_owned*)
    *(.text*._RNvNtCs*_8clj_eval8printsys14subvec_default*)
    *(.text*._RNCINvNtCs*_8clj_eval6vm_ops4upd1NtB*_4NextE0B*_*)
    *(.text*._RNvNtCs*_8clj_eval6arrays16native_vector_of*)
    *(.text*._RNvNtCs*_8clj_eval4coll12native_empty*)
    *(.text*._RNvMs*_NtCs*_5alloc4syncINtB*_3ArcNtNtCs*_9clj_value4pvec19PrimitiveVectorDataE8make_mutB*_*)
    *(.text*._RNvNtCs*_8clj_eval4coll7subvec3*)
    *(.text*._RNvMs*_NtCs*_9clj_value5valueNtB*_6Vector15drop_last_owned*)
    *(.text*._RNcNtNtNtCs*_9clj_value5value5Value3Int0*)
    *(.text*._RNvXNtCs*_4core3anyNtNtCs*_9clj_value3seq14SubVectorValueNtB*_3Any7type_idB*_*)
    *(.text*._RNvNtCs*_8clj_eval6arrays13vector_coerce*)
    *(.text*._RNvXs*_NtCs*_9clj_value3seqNtB*_14SubVectorValueNtNtB*_9extension14ExtensionValue6as_any*)
    *(.text*._RNvMs*_NtCs*_9clj_value4pvecNtB*_15PrimitiveVector9with_meta*)
    *(.text*._RNvMs*_NtCs*_5alloc4syncINtB*_3ArcNtNtCs*_9clj_value4pvec19PrimitiveVectorDataE9drop_slowB*_*)
    *(.text*._RINvNtCs*_4core3ptr9drop_glueNtNtCs*_9clj_value3seq14SubVectorValueECs*_8clj_eval*)
    *(.text*._RNvNtCs*_8clj_eval4coll13native_subvec*)
    *(.text*._RNvYNtNtCs*_9clj_value5value10VectorIterNtNtNtNtCs*_4core4iter6traits8iterator8Iterator3nthB*_*)
    *(.text*._RNvNtCs*_8clj_eval4core11native_even*)
    *(.text*._RNvNtCs*_8clj_eval4lazy22realize_subvector_deep*)
    *(.text*._RNvNtCs*_8clj_eval6arrays14longstop_value*)
  }
}
INSERT BEFORE .text;
